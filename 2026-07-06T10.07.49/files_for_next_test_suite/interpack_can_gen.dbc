VERSION "created by canmatrix"

NS_ :

BS_:

BU_: Pack01BMSLeader Pack02BMS Pack03BMS Pack04BMS Pack05BMS Pack06BMS Pack07BMS Pack08BMS Pack09BMS Pack10BMS Pack11BMS Pack12BMS Pack13BMS Pack14BMS Pack15BMS Pack16BMS

BO_ 2566852809 PropB_16_INTERPACK_Pack01BMSLead: 227 Pack01BMSLeader
 SG_ Remaining_Capacity : 0|8@1+ (1,0) [0|255] "Ah" Vector__XXX
 SG_ Date_of_Manufacture_0 : 8|8@1+ (1,0) [0|255] "" Vector__XXX
 SG_ Date_of_Manufacture_1 : 16|8@1+ (1,0) [0|255] "" Vector__XXX
 SG_ Date_of_Manufacture_2 : 24|8@1+ (1,0) [0|255] "" Vector__XXX
 SG_ Date_of_Manufacture_3 : 32|8@1+ (1,0) [0|255] "" Vector__XXX
 SG_ Date_of_Manufacture_4 : 40|8@1+ (1,0) [0|255] "" Vector__XXX
 SG_ Date_of_Manufacture_5 : 48|8@1+ (1,0) [0|255] "" Vector__XXX
 SG_ Date_of_Manufacture_6 : 56|8@1+ (1,0) [0|255] "" Vector__XXX
 SG_ Date_of_Putting_Into_Service_0 : 64|8@1+ (1,0) [0|255] "" Vector__XXX
 SG_ Date_of_Putting_Into_Service_1 : 72|8@1+ (1,0) [0|255] "" Vector__XXX
 SG_ Date_of_Putting_Into_Service_2 : 80|8@1+ (1,0) [0|255] "" Vector__XXX
 SG_ Date_of_Putting_Into_Service_3 : 88|8@1+ (1,0) [0|255] "" Vector__XXX
 SG_ Date_of_Putting_Into_Service_4 : 96|8@1+ (1,0) [0|255] "" Vector__XXX
 SG_ Date_of_Putting_Into_Service_5 : 104|8@1+ (1,0) [0|255] "" Vector__XXX
 SG_ Date_of_Putting_Into_Service_6 : 112|8@1+ (1,0) [0|255] "" Vector__XXX
 SG_ Charge_Energy_Throughput : 120|24@1+ (1,0) [0|16777215] "kWh" Vector__XXX
 SG_ Discharge_Energy_Throughput : 144|24@1+ (1,0) [0|16777215] "kWh" Vector__XXX
 SG_ Total_Energy_Throughput : 168|24@1+ (1,0) [0|16777215] "kWh" Vector__XXX
 SG_ Charged_Capacity_Throughput : 192|24@1+ (1,0) [0|16777215] "Ah" Vector__XXX
 SG_ Discharged_Capacity_Throughput : 216|24@1+ (1,0) [0|16777215] "Ah" Vector__XXX
 SG_ Total_Capacity_Throughput : 240|24@1+ (1,0) [0|16777215] "Ah" Vector__XXX
 SG_ Number_of_Full_Equivalent_Charge0 : 264|16@1+ (1,0) [0|65535] "cycles" Vector__XXX
 SG_ Number_of_Full_Equivalent_Discha : 280|16@1+ (1,0) [0|65535] "cycles" Vector__XXX
 SG_ Number_of_Full_Equivalent_Charge1 : 296|16@1+ (1,0) [0|65535] "cycles" Vector__XXX
 SG_ Temperature_Histogram_0 : 312|32@1+ (1,0) [0|4294967295] "s" Vector__XXX
 SG_ Temperature_Histogram_1 : 344|32@1+ (1,0) [0|4294967295] "s" Vector__XXX
 SG_ Temperature_Histogram_2 : 376|32@1+ (1,0) [0|4294967295] "s" Vector__XXX
 SG_ Temperature_Histogram_3 : 408|32@1+ (1,0) [0|4294967295] "s" Vector__XXX
 SG_ Temperature_Histogram_4 : 440|32@1+ (1,0) [0|4294967295] "s" Vector__XXX
 SG_ Temperature_Histogram_5 : 472|32@1+ (1,0) [0|4294967295] "s" Vector__XXX
 SG_ Temperature_Histogram_6 : 504|32@1+ (1,0) [0|4294967295] "s" Vector__XXX
 SG_ Temperature_Histogram_7 : 536|32@1+ (1,0) [0|4294967295] "s" Vector__XXX
 SG_ Temperature_Histogram_8 : 568|32@1+ (1,0) [0|4294967295] "s" Vector__XXX
 SG_ Temperature_Histogram_9 : 600|32@1+ (1,0) [0|4294967295] "s" Vector__XXX
 SG_ Temperature_Histogram_10 : 632|32@1+ (1,0) [0|4294967295] "s" Vector__XXX
 SG_ Temperature_Histogram_11 : 664|32@1+ (1,0) [0|4294967295] "s" Vector__XXX
 SG_ Temperature_Histogram_12 : 696|32@1+ (1,0) [0|4294967295] "s" Vector__XXX
 SG_ Temperature_Histogram_13 : 728|32@1+ (1,0) [0|4294967295] "s" Vector__XXX
 SG_ Temperature_Histogram_14 : 760|32@1+ (1,0) [0|4294967295] "s" Vector__XXX
 SG_ Temperature_Histogram_15 : 792|32@1+ (1,0) [0|4294967295] "s" Vector__XXX
 SG_ Temperature_Histogram_16 : 824|32@1+ (1,0) [0|4294967295] "s" Vector__XXX
 SG_ Temperature_Histogram_17 : 856|32@1+ (1,0) [0|4294967295] "s" Vector__XXX
 SG_ Temperature_Histogram_18 : 888|32@1+ (1,0) [0|4294967295] "s" Vector__XXX
 SG_ Temperature_Histogram_19 : 920|32@1+ (1,0) [0|4294967295] "s" Vector__XXX
 SG_ Temperature_Histogram_20 : 952|32@1+ (1,0) [0|4294967295] "s" Vector__XXX
 SG_ Temperature_Histogram_21 : 984|32@1+ (1,0) [0|4294967295] "s" Vector__XXX
 SG_ Temperature_Histogram_22 : 1016|32@1+ (1,0) [0|4294967295] "s" Vector__XXX
 SG_ Temperature_Histogram_23 : 1048|32@1+ (1,0) [0|4294967295] "s" Vector__XXX
 SG_ Time_Spent_in_Extreme_Temperatur0 : 1080|32@1+ (1,0) [0|4294967295] "s" Vector__XXX
 SG_ Time_Spent_in_Extreme_Temperatur1 : 1112|32@1+ (1,0) [0|4294967295] "s" Vector__XXX
 SG_ Number_of_Deep_Discharge_Events : 1144|8@1+ (1,0) [0|255] "count" Vector__XXX
 SG_ Time_Spent_Charging_In_Extreme_T : 1152|8@1+ (1,0) [0|255] "s" Vector__XXX
 SG_ State_of_Charge : 1160|16@1+ (0.0015625,0) [0|102.3984375] "%" Vector__XXX
 SG_ State_of_Charge_Histogram_0 : 1176|32@1+ (1,0) [0|4294967295] "s" Vector__XXX
 SG_ State_of_Charge_Histogram_1 : 1208|32@1+ (1,0) [0|4294967295] "s" Vector__XXX
 SG_ State_of_Charge_Histogram_2 : 1240|32@1+ (1,0) [0|4294967295] "s" Vector__XXX
 SG_ State_of_Charge_Histogram_3 : 1272|32@1+ (1,0) [0|4294967295] "s" Vector__XXX
 SG_ State_of_Charge_Histogram_4 : 1304|32@1+ (1,0) [0|4294967295] "s" Vector__XXX
 SG_ State_of_Charge_Histogram_5 : 1336|32@1+ (1,0) [0|4294967295] "s" Vector__XXX
 SG_ State_of_Charge_Histogram_6 : 1368|32@1+ (1,0) [0|4294967295] "s" Vector__XXX
 SG_ State_of_Charge_Histogram_7 : 1400|32@1+ (1,0) [0|4294967295] "s" Vector__XXX
 SG_ State_of_Charge_Histogram_8 : 1432|32@1+ (1,0) [0|4294967295] "s" Vector__XXX
 SG_ State_of_Charge_Histogram_9 : 1464|32@1+ (1,0) [0|4294967295] "s" Vector__XXX
 SG_ State_of_Charge_Histogram_10 : 1496|32@1+ (1,0) [0|4294967295] "s" Vector__XXX
 SG_ State_of_Charge_Histogram_11 : 1528|32@1+ (1,0) [0|4294967295] "s" Vector__XXX
 SG_ State_of_Charge_Histogram_12 : 1560|32@1+ (1,0) [0|4294967295] "s" Vector__XXX
 SG_ State_of_Charge_Histogram_13 : 1592|32@1+ (1,0) [0|4294967295] "s" Vector__XXX
 SG_ State_of_Charge_Histogram_14 : 1624|32@1+ (1,0) [0|4294967295] "s" Vector__XXX
 SG_ State_of_Charge_Histogram_15 : 1656|32@1+ (1,0) [0|4294967295] "s" Vector__XXX
 SG_ State_of_Charge_Histogram_16 : 1688|32@1+ (1,0) [0|4294967295] "s" Vector__XXX
 SG_ State_of_Charge_Histogram_17 : 1720|32@1+ (1,0) [0|4294967295] "s" Vector__XXX
 SG_ State_of_Charge_Histogram_18 : 1752|32@1+ (1,0) [0|4294967295] "s" Vector__XXX
 SG_ State_of_Charge_Histogram_19 : 1784|32@1+ (1,0) [0|4294967295] "s" Vector__XXX

BO_ 2566852810 PropB_16_INTERPACK_Pack02BMS: 227 Pack02BMS
 SG_ Remaining_Capacity : 0|8@1+ (1,0) [0|255] "Ah" Vector__XXX
 SG_ Date_of_Manufacture_0 : 8|8@1+ (1,0) [0|255] "" Vector__XXX
 SG_ Date_of_Manufacture_1 : 16|8@1+ (1,0) [0|255] "" Vector__XXX
 SG_ Date_of_Manufacture_2 : 24|8@1+ (1,0) [0|255] "" Vector__XXX
 SG_ Date_of_Manufacture_3 : 32|8@1+ (1,0) [0|255] "" Vector__XXX
 SG_ Date_of_Manufacture_4 : 40|8@1+ (1,0) [0|255] "" Vector__XXX
 SG_ Date_of_Manufacture_5 : 48|8@1+ (1,0) [0|255] "" Vector__XXX
 SG_ Date_of_Manufacture_6 : 56|8@1+ (1,0) [0|255] "" Vector__XXX
 SG_ Date_of_Putting_Into_Service_0 : 64|8@1+ (1,0) [0|255] "" Vector__XXX
 SG_ Date_of_Putting_Into_Service_1 : 72|8@1+ (1,0) [0|255] "" Vector__XXX
 SG_ Date_of_Putting_Into_Service_2 : 80|8@1+ (1,0) [0|255] "" Vector__XXX
 SG_ Date_of_Putting_Into_Service_3 : 88|8@1+ (1,0) [0|255] "" Vector__XXX
 SG_ Date_of_Putting_Into_Service_4 : 96|8@1+ (1,0) [0|255] "" Vector__XXX
 SG_ Date_of_Putting_Into_Service_5 : 104|8@1+ (1,0) [0|255] "" Vector__XXX
 SG_ Date_of_Putting_Into_Service_6 : 112|8@1+ (1,0) [0|255] "" Vector__XXX
 SG_ Charge_Energy_Throughput : 120|24@1+ (1,0) [0|16777215] "kWh" Vector__XXX
 SG_ Discharge_Energy_Throughput : 144|24@1+ (1,0) [0|16777215] "kWh" Vector__XXX
 SG_ Total_Energy_Throughput : 168|24@1+ (1,0) [0|16777215] "kWh" Vector__XXX
 SG_ Charged_Capacity_Throughput : 192|24@1+ (1,0) [0|16777215] "Ah" Vector__XXX
 SG_ Discharged_Capacity_Throughput : 216|24@1+ (1,0) [0|16777215] "Ah" Vector__XXX
 SG_ Total_Capacity_Throughput : 240|24@1+ (1,0) [0|16777215] "Ah" Vector__XXX
 SG_ Number_of_Full_Equivalent_Charge0 : 264|16@1+ (1,0) [0|65535] "cycles" Vector__XXX
 SG_ Number_of_Full_Equivalent_Discha : 280|16@1+ (1,0) [0|65535] "cycles" Vector__XXX
 SG_ Number_of_Full_Equivalent_Charge1 : 296|16@1+ (1,0) [0|65535] "cycles" Vector__XXX
 SG_ Temperature_Histogram_0 : 312|32@1+ (1,0) [0|4294967295] "s" Vector__XXX
 SG_ Temperature_Histogram_1 : 344|32@1+ (1,0) [0|4294967295] "s" Vector__XXX
 SG_ Temperature_Histogram_2 : 376|32@1+ (1,0) [0|4294967295] "s" Vector__XXX
 SG_ Temperature_Histogram_3 : 408|32@1+ (1,0) [0|4294967295] "s" Vector__XXX
 SG_ Temperature_Histogram_4 : 440|32@1+ (1,0) [0|4294967295] "s" Vector__XXX
 SG_ Temperature_Histogram_5 : 472|32@1+ (1,0) [0|4294967295] "s" Vector__XXX
 SG_ Temperature_Histogram_6 : 504|32@1+ (1,0) [0|4294967295] "s" Vector__XXX
 SG_ Temperature_Histogram_7 : 536|32@1+ (1,0) [0|4294967295] "s" Vector__XXX
 SG_ Temperature_Histogram_8 : 568|32@1+ (1,0) [0|4294967295] "s" Vector__XXX
 SG_ Temperature_Histogram_9 : 600|32@1+ (1,0) [0|4294967295] "s" Vector__XXX
 SG_ Temperature_Histogram_10 : 632|32@1+ (1,0) [0|4294967295] "s" Vector__XXX
 SG_ Temperature_Histogram_11 : 664|32@1+ (1,0) [0|4294967295] "s" Vector__XXX
 SG_ Temperature_Histogram_12 : 696|32@1+ (1,0) [0|4294967295] "s" Vector__XXX
 SG_ Temperature_Histogram_13 : 728|32@1+ (1,0) [0|4294967295] "s" Vector__XXX
 SG_ Temperature_Histogram_14 : 760|32@1+ (1,0) [0|4294967295] "s" Vector__XXX
 SG_ Temperature_Histogram_15 : 792|32@1+ (1,0) [0|4294967295] "s" Vector__XXX
 SG_ Temperature_Histogram_16 : 824|32@1+ (1,0) [0|4294967295] "s" Vector__XXX
 SG_ Temperature_Histogram_17 : 856|32@1+ (1,0) [0|4294967295] "s" Vector__XXX
 SG_ Temperature_Histogram_18 : 888|32@1+ (1,0) [0|4294967295] "s" Vector__XXX
 SG_ Temperature_Histogram_19 : 920|32@1+ (1,0) [0|4294967295] "s" Vector__XXX
 SG_ Temperature_Histogram_20 : 952|32@1+ (1,0) [0|4294967295] "s" Vector__XXX
 SG_ Temperature_Histogram_21 : 984|32@1+ (1,0) [0|4294967295] "s" Vector__XXX
 SG_ Temperature_Histogram_22 : 1016|32@1+ (1,0) [0|4294967295] "s" Vector__XXX
 SG_ Temperature_Histogram_23 : 1048|32@1+ (1,0) [0|4294967295] "s" Vector__XXX
 SG_ Time_Spent_in_Extreme_Temperatur0 : 1080|32@1+ (1,0) [0|4294967295] "s" Vector__XXX
 SG_ Time_Spent_in_Extreme_Temperatur1 : 1112|32@1+ (1,0) [0|4294967295] "s" Vector__XXX
 SG_ Number_of_Deep_Discharge_Events : 1144|8@1+ (1,0) [0|255] "count" Vector__XXX
 SG_ Time_Spent_Charging_In_Extreme_T : 1152|8@1+ (1,0) [0|255] "s" Vector__XXX
 SG_ State_of_Charge : 1160|16@1+ (0.0015625,0) [0|102.3984375] "%" Vector__XXX
 SG_ State_of_Charge_Histogram_0 : 1176|32@1+ (1,0) [0|4294967295] "s" Vector__XXX
 SG_ State_of_Charge_Histogram_1 : 1208|32@1+ (1,0) [0|4294967295] "s" Vector__XXX
 SG_ State_of_Charge_Histogram_2 : 1240|32@1+ (1,0) [0|4294967295] "s" Vector__XXX
 SG_ State_of_Charge_Histogram_3 : 1272|32@1+ (1,0) [0|4294967295] "s" Vector__XXX
 SG_ State_of_Charge_Histogram_4 : 1304|32@1+ (1,0) [0|4294967295] "s" Vector__XXX
 SG_ State_of_Charge_Histogram_5 : 1336|32@1+ (1,0) [0|4294967295] "s" Vector__XXX
 SG_ State_of_Charge_Histogram_6 : 1368|32@1+ (1,0) [0|4294967295] "s" Vector__XXX
 SG_ State_of_Charge_Histogram_7 : 1400|32@1+ (1,0) [0|4294967295] "s" Vector__XXX
 SG_ State_of_Charge_Histogram_8 : 1432|32@1+ (1,0) [0|4294967295] "s" Vector__XXX
 SG_ State_of_Charge_Histogram_9 : 1464|32@1+ (1,0) [0|4294967295] "s" Vector__XXX
 SG_ State_of_Charge_Histogram_10 : 1496|32@1+ (1,0) [0|4294967295] "s" Vector__XXX
 SG_ State_of_Charge_Histogram_11 : 1528|32@1+ (1,0) [0|4294967295] "s" Vector__XXX
 SG_ State_of_Charge_Histogram_12 : 1560|32@1+ (1,0) [0|4294967295] "s" Vector__XXX
 SG_ State_of_Charge_Histogram_13 : 1592|32@1+ (1,0) [0|4294967295] "s" Vector__XXX
 SG_ State_of_Charge_Histogram_14 : 1624|32@1+ (1,0) [0|4294967295] "s" Vector__XXX
 SG_ State_of_Charge_Histogram_15 : 1656|32@1+ (1,0) [0|4294967295] "s" Vector__XXX
 SG_ State_of_Charge_Histogram_16 : 1688|32@1+ (1,0) [0|4294967295] "s" Vector__XXX
 SG_ State_of_Charge_Histogram_17 : 1720|32@1+ (1,0) [0|4294967295] "s" Vector__XXX
 SG_ State_of_Charge_Histogram_18 : 1752|32@1+ (1,0) [0|4294967295] "s" Vector__XXX
 SG_ State_of_Charge_Histogram_19 : 1784|32@1+ (1,0) [0|4294967295] "s" Vector__XXX

BO_ 2566852811 PropB_16_INTERPACK_Pack03BMS: 227 Pack03BMS
 SG_ Remaining_Capacity : 0|8@1+ (1,0) [0|255] "Ah" Vector__XXX
 SG_ Date_of_Manufacture_0 : 8|8@1+ (1,0) [0|255] "" Vector__XXX
 SG_ Date_of_Manufacture_1 : 16|8@1+ (1,0) [0|255] "" Vector__XXX
 SG_ Date_of_Manufacture_2 : 24|8@1+ (1,0) [0|255] "" Vector__XXX
 SG_ Date_of_Manufacture_3 : 32|8@1+ (1,0) [0|255] "" Vector__XXX
 SG_ Date_of_Manufacture_4 : 40|8@1+ (1,0) [0|255] "" Vector__XXX
 SG_ Date_of_Manufacture_5 : 48|8@1+ (1,0) [0|255] "" Vector__XXX
 SG_ Date_of_Manufacture_6 : 56|8@1+ (1,0) [0|255] "" Vector__XXX
 SG_ Date_of_Putting_Into_Service_0 : 64|8@1+ (1,0) [0|255] "" Vector__XXX
 SG_ Date_of_Putting_Into_Service_1 : 72|8@1+ (1,0) [0|255] "" Vector__XXX
 SG_ Date_of_Putting_Into_Service_2 : 80|8@1+ (1,0) [0|255] "" Vector__XXX
 SG_ Date_of_Putting_Into_Service_3 : 88|8@1+ (1,0) [0|255] "" Vector__XXX
 SG_ Date_of_Putting_Into_Service_4 : 96|8@1+ (1,0) [0|255] "" Vector__XXX
 SG_ Date_of_Putting_Into_Service_5 : 104|8@1+ (1,0) [0|255] "" Vector__XXX
 SG_ Date_of_Putting_Into_Service_6 : 112|8@1+ (1,0) [0|255] "" Vector__XXX
 SG_ Charge_Energy_Throughput : 120|24@1+ (1,0) [0|16777215] "kWh" Vector__XXX
 SG_ Discharge_Energy_Throughput : 144|24@1+ (1,0) [0|16777215] "kWh" Vector__XXX
 SG_ Total_Energy_Throughput : 168|24@1+ (1,0) [0|16777215] "kWh" Vector__XXX
 SG_ Charged_Capacity_Throughput : 192|24@1+ (1,0) [0|16777215] "Ah" Vector__XXX
 SG_ Discharged_Capacity_Throughput : 216|24@1+ (1,0) [0|16777215] "Ah" Vector__XXX
 SG_ Total_Capacity_Throughput : 240|24@1+ (1,0) [0|16777215] "Ah" Vector__XXX
 SG_ Number_of_Full_Equivalent_Charge0 : 264|16@1+ (1,0) [0|65535] "cycles" Vector__XXX
 SG_ Number_of_Full_Equivalent_Discha : 280|16@1+ (1,0) [0|65535] "cycles" Vector__XXX
 SG_ Number_of_Full_Equivalent_Charge1 : 296|16@1+ (1,0) [0|65535] "cycles" Vector__XXX
 SG_ Temperature_Histogram_0 : 312|32@1+ (1,0) [0|4294967295] "s" Vector__XXX
 SG_ Temperature_Histogram_1 : 344|32@1+ (1,0) [0|4294967295] "s" Vector__XXX
 SG_ Temperature_Histogram_2 : 376|32@1+ (1,0) [0|4294967295] "s" Vector__XXX
 SG_ Temperature_Histogram_3 : 408|32@1+ (1,0) [0|4294967295] "s" Vector__XXX
 SG_ Temperature_Histogram_4 : 440|32@1+ (1,0) [0|4294967295] "s" Vector__XXX
 SG_ Temperature_Histogram_5 : 472|32@1+ (1,0) [0|4294967295] "s" Vector__XXX
 SG_ Temperature_Histogram_6 : 504|32@1+ (1,0) [0|4294967295] "s" Vector__XXX
 SG_ Temperature_Histogram_7 : 536|32@1+ (1,0) [0|4294967295] "s" Vector__XXX
 SG_ Temperature_Histogram_8 : 568|32@1+ (1,0) [0|4294967295] "s" Vector__XXX
 SG_ Temperature_Histogram_9 : 600|32@1+ (1,0) [0|4294967295] "s" Vector__XXX
 SG_ Temperature_Histogram_10 : 632|32@1+ (1,0) [0|4294967295] "s" Vector__XXX
 SG_ Temperature_Histogram_11 : 664|32@1+ (1,0) [0|4294967295] "s" Vector__XXX
 SG_ Temperature_Histogram_12 : 696|32@1+ (1,0) [0|4294967295] "s" Vector__XXX
 SG_ Temperature_Histogram_13 : 728|32@1+ (1,0) [0|4294967295] "s" Vector__XXX
 SG_ Temperature_Histogram_14 : 760|32@1+ (1,0) [0|4294967295] "s" Vector__XXX
 SG_ Temperature_Histogram_15 : 792|32@1+ (1,0) [0|4294967295] "s" Vector__XXX
 SG_ Temperature_Histogram_16 : 824|32@1+ (1,0) [0|4294967295] "s" Vector__XXX
 SG_ Temperature_Histogram_17 : 856|32@1+ (1,0) [0|4294967295] "s" Vector__XXX
 SG_ Temperature_Histogram_18 : 888|32@1+ (1,0) [0|4294967295] "s" Vector__XXX
 SG_ Temperature_Histogram_19 : 920|32@1+ (1,0) [0|4294967295] "s" Vector__XXX
 SG_ Temperature_Histogram_20 : 952|32@1+ (1,0) [0|4294967295] "s" Vector__XXX
 SG_ Temperature_Histogram_21 : 984|32@1+ (1,0) [0|4294967295] "s" Vector__XXX
 SG_ Temperature_Histogram_22 : 1016|32@1+ (1,0) [0|4294967295] "s" Vector__XXX
 SG_ Temperature_Histogram_23 : 1048|32@1+ (1,0) [0|4294967295] "s" Vector__XXX
 SG_ Time_Spent_in_Extreme_Temperatur0 : 1080|32@1+ (1,0) [0|4294967295] "s" Vector__XXX
 SG_ Time_Spent_in_Extreme_Temperatur1 : 1112|32@1+ (1,0) [0|4294967295] "s" Vector__XXX
 SG_ Number_of_Deep_Discharge_Events : 1144|8@1+ (1,0) [0|255] "count" Vector__XXX
 SG_ Time_Spent_Charging_In_Extreme_T : 1152|8@1+ (1,0) [0|255] "s" Vector__XXX
 SG_ State_of_Charge : 1160|16@1+ (0.0015625,0) [0|102.3984375] "%" Vector__XXX
 SG_ State_of_Charge_Histogram_0 : 1176|32@1+ (1,0) [0|4294967295] "s" Vector__XXX
 SG_ State_of_Charge_Histogram_1 : 1208|32@1+ (1,0) [0|4294967295] "s" Vector__XXX
 SG_ State_of_Charge_Histogram_2 : 1240|32@1+ (1,0) [0|4294967295] "s" Vector__XXX
 SG_ State_of_Charge_Histogram_3 : 1272|32@1+ (1,0) [0|4294967295] "s" Vector__XXX
 SG_ State_of_Charge_Histogram_4 : 1304|32@1+ (1,0) [0|4294967295] "s" Vector__XXX
 SG_ State_of_Charge_Histogram_5 : 1336|32@1+ (1,0) [0|4294967295] "s" Vector__XXX
 SG_ State_of_Charge_Histogram_6 : 1368|32@1+ (1,0) [0|4294967295] "s" Vector__XXX
 SG_ State_of_Charge_Histogram_7 : 1400|32@1+ (1,0) [0|4294967295] "s" Vector__XXX
 SG_ State_of_Charge_Histogram_8 : 1432|32@1+ (1,0) [0|4294967295] "s" Vector__XXX
 SG_ State_of_Charge_Histogram_9 : 1464|32@1+ (1,0) [0|4294967295] "s" Vector__XXX
 SG_ State_of_Charge_Histogram_10 : 1496|32@1+ (1,0) [0|4294967295] "s" Vector__XXX
 SG_ State_of_Charge_Histogram_11 : 1528|32@1+ (1,0) [0|4294967295] "s" Vector__XXX
 SG_ State_of_Charge_Histogram_12 : 1560|32@1+ (1,0) [0|4294967295] "s" Vector__XXX
 SG_ State_of_Charge_Histogram_13 : 1592|32@1+ (1,0) [0|4294967295] "s" Vector__XXX
 SG_ State_of_Charge_Histogram_14 : 1624|32@1+ (1,0) [0|4294967295] "s" Vector__XXX
 SG_ State_of_Charge_Histogram_15 : 1656|32@1+ (1,0) [0|4294967295] "s" Vector__XXX
 SG_ State_of_Charge_Histogram_16 : 1688|32@1+ (1,0) [0|4294967295] "s" Vector__XXX
 SG_ State_of_Charge_Histogram_17 : 1720|32@1+ (1,0) [0|4294967295] "s" Vector__XXX
 SG_ State_of_Charge_Histogram_18 : 1752|32@1+ (1,0) [0|4294967295] "s" Vector__XXX
 SG_ State_of_Charge_Histogram_19 : 1784|32@1+ (1,0) [0|4294967295] "s" Vector__XXX

BO_ 2566852812 PropB_16_INTERPACK_Pack04BMS: 227 Pack04BMS
 SG_ Remaining_Capacity : 0|8@1+ (1,0) [0|255] "Ah" Vector__XXX
 SG_ Date_of_Manufacture_0 : 8|8@1+ (1,0) [0|255] "" Vector__XXX
 SG_ Date_of_Manufacture_1 : 16|8@1+ (1,0) [0|255] "" Vector__XXX
 SG_ Date_of_Manufacture_2 : 24|8@1+ (1,0) [0|255] "" Vector__XXX
 SG_ Date_of_Manufacture_3 : 32|8@1+ (1,0) [0|255] "" Vector__XXX
 SG_ Date_of_Manufacture_4 : 40|8@1+ (1,0) [0|255] "" Vector__XXX
 SG_ Date_of_Manufacture_5 : 48|8@1+ (1,0) [0|255] "" Vector__XXX
 SG_ Date_of_Manufacture_6 : 56|8@1+ (1,0) [0|255] "" Vector__XXX
 SG_ Date_of_Putting_Into_Service_0 : 64|8@1+ (1,0) [0|255] "" Vector__XXX
 SG_ Date_of_Putting_Into_Service_1 : 72|8@1+ (1,0) [0|255] "" Vector__XXX
 SG_ Date_of_Putting_Into_Service_2 : 80|8@1+ (1,0) [0|255] "" Vector__XXX
 SG_ Date_of_Putting_Into_Service_3 : 88|8@1+ (1,0) [0|255] "" Vector__XXX
 SG_ Date_of_Putting_Into_Service_4 : 96|8@1+ (1,0) [0|255] "" Vector__XXX
 SG_ Date_of_Putting_Into_Service_5 : 104|8@1+ (1,0) [0|255] "" Vector__XXX
 SG_ Date_of_Putting_Into_Service_6 : 112|8@1+ (1,0) [0|255] "" Vector__XXX
 SG_ Charge_Energy_Throughput : 120|24@1+ (1,0) [0|16777215] "kWh" Vector__XXX
 SG_ Discharge_Energy_Throughput : 144|24@1+ (1,0) [0|16777215] "kWh" Vector__XXX
 SG_ Total_Energy_Throughput : 168|24@1+ (1,0) [0|16777215] "kWh" Vector__XXX
 SG_ Charged_Capacity_Throughput : 192|24@1+ (1,0) [0|16777215] "Ah" Vector__XXX
 SG_ Discharged_Capacity_Throughput : 216|24@1+ (1,0) [0|16777215] "Ah" Vector__XXX
 SG_ Total_Capacity_Throughput : 240|24@1+ (1,0) [0|16777215] "Ah" Vector__XXX
 SG_ Number_of_Full_Equivalent_Charge0 : 264|16@1+ (1,0) [0|65535] "cycles" Vector__XXX
 SG_ Number_of_Full_Equivalent_Discha : 280|16@1+ (1,0) [0|65535] "cycles" Vector__XXX
 SG_ Number_of_Full_Equivalent_Charge1 : 296|16@1+ (1,0) [0|65535] "cycles" Vector__XXX
 SG_ Temperature_Histogram_0 : 312|32@1+ (1,0) [0|4294967295] "s" Vector__XXX
 SG_ Temperature_Histogram_1 : 344|32@1+ (1,0) [0|4294967295] "s" Vector__XXX
 SG_ Temperature_Histogram_2 : 376|32@1+ (1,0) [0|4294967295] "s" Vector__XXX
 SG_ Temperature_Histogram_3 : 408|32@1+ (1,0) [0|4294967295] "s" Vector__XXX
 SG_ Temperature_Histogram_4 : 440|32@1+ (1,0) [0|4294967295] "s" Vector__XXX
 SG_ Temperature_Histogram_5 : 472|32@1+ (1,0) [0|4294967295] "s" Vector__XXX
 SG_ Temperature_Histogram_6 : 504|32@1+ (1,0) [0|4294967295] "s" Vector__XXX
 SG_ Temperature_Histogram_7 : 536|32@1+ (1,0) [0|4294967295] "s" Vector__XXX
 SG_ Temperature_Histogram_8 : 568|32@1+ (1,0) [0|4294967295] "s" Vector__XXX
 SG_ Temperature_Histogram_9 : 600|32@1+ (1,0) [0|4294967295] "s" Vector__XXX
 SG_ Temperature_Histogram_10 : 632|32@1+ (1,0) [0|4294967295] "s" Vector__XXX
 SG_ Temperature_Histogram_11 : 664|32@1+ (1,0) [0|4294967295] "s" Vector__XXX
 SG_ Temperature_Histogram_12 : 696|32@1+ (1,0) [0|4294967295] "s" Vector__XXX
 SG_ Temperature_Histogram_13 : 728|32@1+ (1,0) [0|4294967295] "s" Vector__XXX
 SG_ Temperature_Histogram_14 : 760|32@1+ (1,0) [0|4294967295] "s" Vector__XXX
 SG_ Temperature_Histogram_15 : 792|32@1+ (1,0) [0|4294967295] "s" Vector__XXX
 SG_ Temperature_Histogram_16 : 824|32@1+ (1,0) [0|4294967295] "s" Vector__XXX
 SG_ Temperature_Histogram_17 : 856|32@1+ (1,0) [0|4294967295] "s" Vector__XXX
 SG_ Temperature_Histogram_18 : 888|32@1+ (1,0) [0|4294967295] "s" Vector__XXX
 SG_ Temperature_Histogram_19 : 920|32@1+ (1,0) [0|4294967295] "s" Vector__XXX
 SG_ Temperature_Histogram_20 : 952|32@1+ (1,0) [0|4294967295] "s" Vector__XXX
 SG_ Temperature_Histogram_21 : 984|32@1+ (1,0) [0|4294967295] "s" Vector__XXX
 SG_ Temperature_Histogram_22 : 1016|32@1+ (1,0) [0|4294967295] "s" Vector__XXX
 SG_ Temperature_Histogram_23 : 1048|32@1+ (1,0) [0|4294967295] "s" Vector__XXX
 SG_ Time_Spent_in_Extreme_Temperatur0 : 1080|32@1+ (1,0) [0|4294967295] "s" Vector__XXX
 SG_ Time_Spent_in_Extreme_Temperatur1 : 1112|32@1+ (1,0) [0|4294967295] "s" Vector__XXX
 SG_ Number_of_Deep_Discharge_Events : 1144|8@1+ (1,0) [0|255] "count" Vector__XXX
 SG_ Time_Spent_Charging_In_Extreme_T : 1152|8@1+ (1,0) [0|255] "s" Vector__XXX
 SG_ State_of_Charge : 1160|16@1+ (0.0015625,0) [0|102.3984375] "%" Vector__XXX
 SG_ State_of_Charge_Histogram_0 : 1176|32@1+ (1,0) [0|4294967295] "s" Vector__XXX
 SG_ State_of_Charge_Histogram_1 : 1208|32@1+ (1,0) [0|4294967295] "s" Vector__XXX
 SG_ State_of_Charge_Histogram_2 : 1240|32@1+ (1,0) [0|4294967295] "s" Vector__XXX
 SG_ State_of_Charge_Histogram_3 : 1272|32@1+ (1,0) [0|4294967295] "s" Vector__XXX
 SG_ State_of_Charge_Histogram_4 : 1304|32@1+ (1,0) [0|4294967295] "s" Vector__XXX
 SG_ State_of_Charge_Histogram_5 : 1336|32@1+ (1,0) [0|4294967295] "s" Vector__XXX
 SG_ State_of_Charge_Histogram_6 : 1368|32@1+ (1,0) [0|4294967295] "s" Vector__XXX
 SG_ State_of_Charge_Histogram_7 : 1400|32@1+ (1,0) [0|4294967295] "s" Vector__XXX
 SG_ State_of_Charge_Histogram_8 : 1432|32@1+ (1,0) [0|4294967295] "s" Vector__XXX
 SG_ State_of_Charge_Histogram_9 : 1464|32@1+ (1,0) [0|4294967295] "s" Vector__XXX
 SG_ State_of_Charge_Histogram_10 : 1496|32@1+ (1,0) [0|4294967295] "s" Vector__XXX
 SG_ State_of_Charge_Histogram_11 : 1528|32@1+ (1,0) [0|4294967295] "s" Vector__XXX
 SG_ State_of_Charge_Histogram_12 : 1560|32@1+ (1,0) [0|4294967295] "s" Vector__XXX
 SG_ State_of_Charge_Histogram_13 : 1592|32@1+ (1,0) [0|4294967295] "s" Vector__XXX
 SG_ State_of_Charge_Histogram_14 : 1624|32@1+ (1,0) [0|4294967295] "s" Vector__XXX
 SG_ State_of_Charge_Histogram_15 : 1656|32@1+ (1,0) [0|4294967295] "s" Vector__XXX
 SG_ State_of_Charge_Histogram_16 : 1688|32@1+ (1,0) [0|4294967295] "s" Vector__XXX
 SG_ State_of_Charge_Histogram_17 : 1720|32@1+ (1,0) [0|4294967295] "s" Vector__XXX
 SG_ State_of_Charge_Histogram_18 : 1752|32@1+ (1,0) [0|4294967295] "s" Vector__XXX
 SG_ State_of_Charge_Histogram_19 : 1784|32@1+ (1,0) [0|4294967295] "s" Vector__XXX

BO_ 2566852813 PropB_16_INTERPACK_Pack05BMS: 227 Pack05BMS
 SG_ Remaining_Capacity : 0|8@1+ (1,0) [0|255] "Ah" Vector__XXX
 SG_ Date_of_Manufacture_0 : 8|8@1+ (1,0) [0|255] "" Vector__XXX
 SG_ Date_of_Manufacture_1 : 16|8@1+ (1,0) [0|255] "" Vector__XXX
 SG_ Date_of_Manufacture_2 : 24|8@1+ (1,0) [0|255] "" Vector__XXX
 SG_ Date_of_Manufacture_3 : 32|8@1+ (1,0) [0|255] "" Vector__XXX
 SG_ Date_of_Manufacture_4 : 40|8@1+ (1,0) [0|255] "" Vector__XXX
 SG_ Date_of_Manufacture_5 : 48|8@1+ (1,0) [0|255] "" Vector__XXX
 SG_ Date_of_Manufacture_6 : 56|8@1+ (1,0) [0|255] "" Vector__XXX
 SG_ Date_of_Putting_Into_Service_0 : 64|8@1+ (1,0) [0|255] "" Vector__XXX
 SG_ Date_of_Putting_Into_Service_1 : 72|8@1+ (1,0) [0|255] "" Vector__XXX
 SG_ Date_of_Putting_Into_Service_2 : 80|8@1+ (1,0) [0|255] "" Vector__XXX
 SG_ Date_of_Putting_Into_Service_3 : 88|8@1+ (1,0) [0|255] "" Vector__XXX
 SG_ Date_of_Putting_Into_Service_4 : 96|8@1+ (1,0) [0|255] "" Vector__XXX
 SG_ Date_of_Putting_Into_Service_5 : 104|8@1+ (1,0) [0|255] "" Vector__XXX
 SG_ Date_of_Putting_Into_Service_6 : 112|8@1+ (1,0) [0|255] "" Vector__XXX
 SG_ Charge_Energy_Throughput : 120|24@1+ (1,0) [0|16777215] "kWh" Vector__XXX
 SG_ Discharge_Energy_Throughput : 144|24@1+ (1,0) [0|16777215] "kWh" Vector__XXX
 SG_ Total_Energy_Throughput : 168|24@1+ (1,0) [0|16777215] "kWh" Vector__XXX
 SG_ Charged_Capacity_Throughput : 192|24@1+ (1,0) [0|16777215] "Ah" Vector__XXX
 SG_ Discharged_Capacity_Throughput : 216|24@1+ (1,0) [0|16777215] "Ah" Vector__XXX
 SG_ Total_Capacity_Throughput : 240|24@1+ (1,0) [0|16777215] "Ah" Vector__XXX
 SG_ Number_of_Full_Equivalent_Charge0 : 264|16@1+ (1,0) [0|65535] "cycles" Vector__XXX
 SG_ Number_of_Full_Equivalent_Discha : 280|16@1+ (1,0) [0|65535] "cycles" Vector__XXX
 SG_ Number_of_Full_Equivalent_Charge1 : 296|16@1+ (1,0) [0|65535] "cycles" Vector__XXX
 SG_ Temperature_Histogram_0 : 312|32@1+ (1,0) [0|4294967295] "s" Vector__XXX
 SG_ Temperature_Histogram_1 : 344|32@1+ (1,0) [0|4294967295] "s" Vector__XXX
 SG_ Temperature_Histogram_2 : 376|32@1+ (1,0) [0|4294967295] "s" Vector__XXX
 SG_ Temperature_Histogram_3 : 408|32@1+ (1,0) [0|4294967295] "s" Vector__XXX
 SG_ Temperature_Histogram_4 : 440|32@1+ (1,0) [0|4294967295] "s" Vector__XXX
 SG_ Temperature_Histogram_5 : 472|32@1+ (1,0) [0|4294967295] "s" Vector__XXX
 SG_ Temperature_Histogram_6 : 504|32@1+ (1,0) [0|4294967295] "s" Vector__XXX
 SG_ Temperature_Histogram_7 : 536|32@1+ (1,0) [0|4294967295] "s" Vector__XXX
 SG_ Temperature_Histogram_8 : 568|32@1+ (1,0) [0|4294967295] "s" Vector__XXX
 SG_ Temperature_Histogram_9 : 600|32@1+ (1,0) [0|4294967295] "s" Vector__XXX
 SG_ Temperature_Histogram_10 : 632|32@1+ (1,0) [0|4294967295] "s" Vector__XXX
 SG_ Temperature_Histogram_11 : 664|32@1+ (1,0) [0|4294967295] "s" Vector__XXX
 SG_ Temperature_Histogram_12 : 696|32@1+ (1,0) [0|4294967295] "s" Vector__XXX
 SG_ Temperature_Histogram_13 : 728|32@1+ (1,0) [0|4294967295] "s" Vector__XXX
 SG_ Temperature_Histogram_14 : 760|32@1+ (1,0) [0|4294967295] "s" Vector__XXX
 SG_ Temperature_Histogram_15 : 792|32@1+ (1,0) [0|4294967295] "s" Vector__XXX
 SG_ Temperature_Histogram_16 : 824|32@1+ (1,0) [0|4294967295] "s" Vector__XXX
 SG_ Temperature_Histogram_17 : 856|32@1+ (1,0) [0|4294967295] "s" Vector__XXX
 SG_ Temperature_Histogram_18 : 888|32@1+ (1,0) [0|4294967295] "s" Vector__XXX
 SG_ Temperature_Histogram_19 : 920|32@1+ (1,0) [0|4294967295] "s" Vector__XXX
 SG_ Temperature_Histogram_20 : 952|32@1+ (1,0) [0|4294967295] "s" Vector__XXX
 SG_ Temperature_Histogram_21 : 984|32@1+ (1,0) [0|4294967295] "s" Vector__XXX
 SG_ Temperature_Histogram_22 : 1016|32@1+ (1,0) [0|4294967295] "s" Vector__XXX
 SG_ Temperature_Histogram_23 : 1048|32@1+ (1,0) [0|4294967295] "s" Vector__XXX
 SG_ Time_Spent_in_Extreme_Temperatur0 : 1080|32@1+ (1,0) [0|4294967295] "s" Vector__XXX
 SG_ Time_Spent_in_Extreme_Temperatur1 : 1112|32@1+ (1,0) [0|4294967295] "s" Vector__XXX
 SG_ Number_of_Deep_Discharge_Events : 1144|8@1+ (1,0) [0|255] "count" Vector__XXX
 SG_ Time_Spent_Charging_In_Extreme_T : 1152|8@1+ (1,0) [0|255] "s" Vector__XXX
 SG_ State_of_Charge : 1160|16@1+ (0.0015625,0) [0|102.3984375] "%" Vector__XXX
 SG_ State_of_Charge_Histogram_0 : 1176|32@1+ (1,0) [0|4294967295] "s" Vector__XXX
 SG_ State_of_Charge_Histogram_1 : 1208|32@1+ (1,0) [0|4294967295] "s" Vector__XXX
 SG_ State_of_Charge_Histogram_2 : 1240|32@1+ (1,0) [0|4294967295] "s" Vector__XXX
 SG_ State_of_Charge_Histogram_3 : 1272|32@1+ (1,0) [0|4294967295] "s" Vector__XXX
 SG_ State_of_Charge_Histogram_4 : 1304|32@1+ (1,0) [0|4294967295] "s" Vector__XXX
 SG_ State_of_Charge_Histogram_5 : 1336|32@1+ (1,0) [0|4294967295] "s" Vector__XXX
 SG_ State_of_Charge_Histogram_6 : 1368|32@1+ (1,0) [0|4294967295] "s" Vector__XXX
 SG_ State_of_Charge_Histogram_7 : 1400|32@1+ (1,0) [0|4294967295] "s" Vector__XXX
 SG_ State_of_Charge_Histogram_8 : 1432|32@1+ (1,0) [0|4294967295] "s" Vector__XXX
 SG_ State_of_Charge_Histogram_9 : 1464|32@1+ (1,0) [0|4294967295] "s" Vector__XXX
 SG_ State_of_Charge_Histogram_10 : 1496|32@1+ (1,0) [0|4294967295] "s" Vector__XXX
 SG_ State_of_Charge_Histogram_11 : 1528|32@1+ (1,0) [0|4294967295] "s" Vector__XXX
 SG_ State_of_Charge_Histogram_12 : 1560|32@1+ (1,0) [0|4294967295] "s" Vector__XXX
 SG_ State_of_Charge_Histogram_13 : 1592|32@1+ (1,0) [0|4294967295] "s" Vector__XXX
 SG_ State_of_Charge_Histogram_14 : 1624|32@1+ (1,0) [0|4294967295] "s" Vector__XXX
 SG_ State_of_Charge_Histogram_15 : 1656|32@1+ (1,0) [0|4294967295] "s" Vector__XXX
 SG_ State_of_Charge_Histogram_16 : 1688|32@1+ (1,0) [0|4294967295] "s" Vector__XXX
 SG_ State_of_Charge_Histogram_17 : 1720|32@1+ (1,0) [0|4294967295] "s" Vector__XXX
 SG_ State_of_Charge_Histogram_18 : 1752|32@1+ (1,0) [0|4294967295] "s" Vector__XXX
 SG_ State_of_Charge_Histogram_19 : 1784|32@1+ (1,0) [0|4294967295] "s" Vector__XXX

BO_ 2566852814 PropB_16_INTERPACK_Pack06BMS: 227 Pack06BMS
 SG_ Remaining_Capacity : 0|8@1+ (1,0) [0|255] "Ah" Vector__XXX
 SG_ Date_of_Manufacture_0 : 8|8@1+ (1,0) [0|255] "" Vector__XXX
 SG_ Date_of_Manufacture_1 : 16|8@1+ (1,0) [0|255] "" Vector__XXX
 SG_ Date_of_Manufacture_2 : 24|8@1+ (1,0) [0|255] "" Vector__XXX
 SG_ Date_of_Manufacture_3 : 32|8@1+ (1,0) [0|255] "" Vector__XXX
 SG_ Date_of_Manufacture_4 : 40|8@1+ (1,0) [0|255] "" Vector__XXX
 SG_ Date_of_Manufacture_5 : 48|8@1+ (1,0) [0|255] "" Vector__XXX
 SG_ Date_of_Manufacture_6 : 56|8@1+ (1,0) [0|255] "" Vector__XXX
 SG_ Date_of_Putting_Into_Service_0 : 64|8@1+ (1,0) [0|255] "" Vector__XXX
 SG_ Date_of_Putting_Into_Service_1 : 72|8@1+ (1,0) [0|255] "" Vector__XXX
 SG_ Date_of_Putting_Into_Service_2 : 80|8@1+ (1,0) [0|255] "" Vector__XXX
 SG_ Date_of_Putting_Into_Service_3 : 88|8@1+ (1,0) [0|255] "" Vector__XXX
 SG_ Date_of_Putting_Into_Service_4 : 96|8@1+ (1,0) [0|255] "" Vector__XXX
 SG_ Date_of_Putting_Into_Service_5 : 104|8@1+ (1,0) [0|255] "" Vector__XXX
 SG_ Date_of_Putting_Into_Service_6 : 112|8@1+ (1,0) [0|255] "" Vector__XXX
 SG_ Charge_Energy_Throughput : 120|24@1+ (1,0) [0|16777215] "kWh" Vector__XXX
 SG_ Discharge_Energy_Throughput : 144|24@1+ (1,0) [0|16777215] "kWh" Vector__XXX
 SG_ Total_Energy_Throughput : 168|24@1+ (1,0) [0|16777215] "kWh" Vector__XXX
 SG_ Charged_Capacity_Throughput : 192|24@1+ (1,0) [0|16777215] "Ah" Vector__XXX
 SG_ Discharged_Capacity_Throughput : 216|24@1+ (1,0) [0|16777215] "Ah" Vector__XXX
 SG_ Total_Capacity_Throughput : 240|24@1+ (1,0) [0|16777215] "Ah" Vector__XXX
 SG_ Number_of_Full_Equivalent_Charge0 : 264|16@1+ (1,0) [0|65535] "cycles" Vector__XXX
 SG_ Number_of_Full_Equivalent_Discha : 280|16@1+ (1,0) [0|65535] "cycles" Vector__XXX
 SG_ Number_of_Full_Equivalent_Charge1 : 296|16@1+ (1,0) [0|65535] "cycles" Vector__XXX
 SG_ Temperature_Histogram_0 : 312|32@1+ (1,0) [0|4294967295] "s" Vector__XXX
 SG_ Temperature_Histogram_1 : 344|32@1+ (1,0) [0|4294967295] "s" Vector__XXX
 SG_ Temperature_Histogram_2 : 376|32@1+ (1,0) [0|4294967295] "s" Vector__XXX
 SG_ Temperature_Histogram_3 : 408|32@1+ (1,0) [0|4294967295] "s" Vector__XXX
 SG_ Temperature_Histogram_4 : 440|32@1+ (1,0) [0|4294967295] "s" Vector__XXX
 SG_ Temperature_Histogram_5 : 472|32@1+ (1,0) [0|4294967295] "s" Vector__XXX
 SG_ Temperature_Histogram_6 : 504|32@1+ (1,0) [0|4294967295] "s" Vector__XXX
 SG_ Temperature_Histogram_7 : 536|32@1+ (1,0) [0|4294967295] "s" Vector__XXX
 SG_ Temperature_Histogram_8 : 568|32@1+ (1,0) [0|4294967295] "s" Vector__XXX
 SG_ Temperature_Histogram_9 : 600|32@1+ (1,0) [0|4294967295] "s" Vector__XXX
 SG_ Temperature_Histogram_10 : 632|32@1+ (1,0) [0|4294967295] "s" Vector__XXX
 SG_ Temperature_Histogram_11 : 664|32@1+ (1,0) [0|4294967295] "s" Vector__XXX
 SG_ Temperature_Histogram_12 : 696|32@1+ (1,0) [0|4294967295] "s" Vector__XXX
 SG_ Temperature_Histogram_13 : 728|32@1+ (1,0) [0|4294967295] "s" Vector__XXX
 SG_ Temperature_Histogram_14 : 760|32@1+ (1,0) [0|4294967295] "s" Vector__XXX
 SG_ Temperature_Histogram_15 : 792|32@1+ (1,0) [0|4294967295] "s" Vector__XXX
 SG_ Temperature_Histogram_16 : 824|32@1+ (1,0) [0|4294967295] "s" Vector__XXX
 SG_ Temperature_Histogram_17 : 856|32@1+ (1,0) [0|4294967295] "s" Vector__XXX
 SG_ Temperature_Histogram_18 : 888|32@1+ (1,0) [0|4294967295] "s" Vector__XXX
 SG_ Temperature_Histogram_19 : 920|32@1+ (1,0) [0|4294967295] "s" Vector__XXX
 SG_ Temperature_Histogram_20 : 952|32@1+ (1,0) [0|4294967295] "s" Vector__XXX
 SG_ Temperature_Histogram_21 : 984|32@1+ (1,0) [0|4294967295] "s" Vector__XXX
 SG_ Temperature_Histogram_22 : 1016|32@1+ (1,0) [0|4294967295] "s" Vector__XXX
 SG_ Temperature_Histogram_23 : 1048|32@1+ (1,0) [0|4294967295] "s" Vector__XXX
 SG_ Time_Spent_in_Extreme_Temperatur0 : 1080|32@1+ (1,0) [0|4294967295] "s" Vector__XXX
 SG_ Time_Spent_in_Extreme_Temperatur1 : 1112|32@1+ (1,0) [0|4294967295] "s" Vector__XXX
 SG_ Number_of_Deep_Discharge_Events : 1144|8@1+ (1,0) [0|255] "count" Vector__XXX
 SG_ Time_Spent_Charging_In_Extreme_T : 1152|8@1+ (1,0) [0|255] "s" Vector__XXX
 SG_ State_of_Charge : 1160|16@1+ (0.0015625,0) [0|102.3984375] "%" Vector__XXX
 SG_ State_of_Charge_Histogram_0 : 1176|32@1+ (1,0) [0|4294967295] "s" Vector__XXX
 SG_ State_of_Charge_Histogram_1 : 1208|32@1+ (1,0) [0|4294967295] "s" Vector__XXX
 SG_ State_of_Charge_Histogram_2 : 1240|32@1+ (1,0) [0|4294967295] "s" Vector__XXX
 SG_ State_of_Charge_Histogram_3 : 1272|32@1+ (1,0) [0|4294967295] "s" Vector__XXX
 SG_ State_of_Charge_Histogram_4 : 1304|32@1+ (1,0) [0|4294967295] "s" Vector__XXX
 SG_ State_of_Charge_Histogram_5 : 1336|32@1+ (1,0) [0|4294967295] "s" Vector__XXX
 SG_ State_of_Charge_Histogram_6 : 1368|32@1+ (1,0) [0|4294967295] "s" Vector__XXX
 SG_ State_of_Charge_Histogram_7 : 1400|32@1+ (1,0) [0|4294967295] "s" Vector__XXX
 SG_ State_of_Charge_Histogram_8 : 1432|32@1+ (1,0) [0|4294967295] "s" Vector__XXX
 SG_ State_of_Charge_Histogram_9 : 1464|32@1+ (1,0) [0|4294967295] "s" Vector__XXX
 SG_ State_of_Charge_Histogram_10 : 1496|32@1+ (1,0) [0|4294967295] "s" Vector__XXX
 SG_ State_of_Charge_Histogram_11 : 1528|32@1+ (1,0) [0|4294967295] "s" Vector__XXX
 SG_ State_of_Charge_Histogram_12 : 1560|32@1+ (1,0) [0|4294967295] "s" Vector__XXX
 SG_ State_of_Charge_Histogram_13 : 1592|32@1+ (1,0) [0|4294967295] "s" Vector__XXX
 SG_ State_of_Charge_Histogram_14 : 1624|32@1+ (1,0) [0|4294967295] "s" Vector__XXX
 SG_ State_of_Charge_Histogram_15 : 1656|32@1+ (1,0) [0|4294967295] "s" Vector__XXX
 SG_ State_of_Charge_Histogram_16 : 1688|32@1+ (1,0) [0|4294967295] "s" Vector__XXX
 SG_ State_of_Charge_Histogram_17 : 1720|32@1+ (1,0) [0|4294967295] "s" Vector__XXX
 SG_ State_of_Charge_Histogram_18 : 1752|32@1+ (1,0) [0|4294967295] "s" Vector__XXX
 SG_ State_of_Charge_Histogram_19 : 1784|32@1+ (1,0) [0|4294967295] "s" Vector__XXX

BO_ 2566852815 PropB_16_INTERPACK_Pack07BMS: 227 Pack07BMS
 SG_ Remaining_Capacity : 0|8@1+ (1,0) [0|255] "Ah" Vector__XXX
 SG_ Date_of_Manufacture_0 : 8|8@1+ (1,0) [0|255] "" Vector__XXX
 SG_ Date_of_Manufacture_1 : 16|8@1+ (1,0) [0|255] "" Vector__XXX
 SG_ Date_of_Manufacture_2 : 24|8@1+ (1,0) [0|255] "" Vector__XXX
 SG_ Date_of_Manufacture_3 : 32|8@1+ (1,0) [0|255] "" Vector__XXX
 SG_ Date_of_Manufacture_4 : 40|8@1+ (1,0) [0|255] "" Vector__XXX
 SG_ Date_of_Manufacture_5 : 48|8@1+ (1,0) [0|255] "" Vector__XXX
 SG_ Date_of_Manufacture_6 : 56|8@1+ (1,0) [0|255] "" Vector__XXX
 SG_ Date_of_Putting_Into_Service_0 : 64|8@1+ (1,0) [0|255] "" Vector__XXX
 SG_ Date_of_Putting_Into_Service_1 : 72|8@1+ (1,0) [0|255] "" Vector__XXX
 SG_ Date_of_Putting_Into_Service_2 : 80|8@1+ (1,0) [0|255] "" Vector__XXX
 SG_ Date_of_Putting_Into_Service_3 : 88|8@1+ (1,0) [0|255] "" Vector__XXX
 SG_ Date_of_Putting_Into_Service_4 : 96|8@1+ (1,0) [0|255] "" Vector__XXX
 SG_ Date_of_Putting_Into_Service_5 : 104|8@1+ (1,0) [0|255] "" Vector__XXX
 SG_ Date_of_Putting_Into_Service_6 : 112|8@1+ (1,0) [0|255] "" Vector__XXX
 SG_ Charge_Energy_Throughput : 120|24@1+ (1,0) [0|16777215] "kWh" Vector__XXX
 SG_ Discharge_Energy_Throughput : 144|24@1+ (1,0) [0|16777215] "kWh" Vector__XXX
 SG_ Total_Energy_Throughput : 168|24@1+ (1,0) [0|16777215] "kWh" Vector__XXX
 SG_ Charged_Capacity_Throughput : 192|24@1+ (1,0) [0|16777215] "Ah" Vector__XXX
 SG_ Discharged_Capacity_Throughput : 216|24@1+ (1,0) [0|16777215] "Ah" Vector__XXX
 SG_ Total_Capacity_Throughput : 240|24@1+ (1,0) [0|16777215] "Ah" Vector__XXX
 SG_ Number_of_Full_Equivalent_Charge0 : 264|16@1+ (1,0) [0|65535] "cycles" Vector__XXX
 SG_ Number_of_Full_Equivalent_Discha : 280|16@1+ (1,0) [0|65535] "cycles" Vector__XXX
 SG_ Number_of_Full_Equivalent_Charge1 : 296|16@1+ (1,0) [0|65535] "cycles" Vector__XXX
 SG_ Temperature_Histogram_0 : 312|32@1+ (1,0) [0|4294967295] "s" Vector__XXX
 SG_ Temperature_Histogram_1 : 344|32@1+ (1,0) [0|4294967295] "s" Vector__XXX
 SG_ Temperature_Histogram_2 : 376|32@1+ (1,0) [0|4294967295] "s" Vector__XXX
 SG_ Temperature_Histogram_3 : 408|32@1+ (1,0) [0|4294967295] "s" Vector__XXX
 SG_ Temperature_Histogram_4 : 440|32@1+ (1,0) [0|4294967295] "s" Vector__XXX
 SG_ Temperature_Histogram_5 : 472|32@1+ (1,0) [0|4294967295] "s" Vector__XXX
 SG_ Temperature_Histogram_6 : 504|32@1+ (1,0) [0|4294967295] "s" Vector__XXX
 SG_ Temperature_Histogram_7 : 536|32@1+ (1,0) [0|4294967295] "s" Vector__XXX
 SG_ Temperature_Histogram_8 : 568|32@1+ (1,0) [0|4294967295] "s" Vector__XXX
 SG_ Temperature_Histogram_9 : 600|32@1+ (1,0) [0|4294967295] "s" Vector__XXX
 SG_ Temperature_Histogram_10 : 632|32@1+ (1,0) [0|4294967295] "s" Vector__XXX
 SG_ Temperature_Histogram_11 : 664|32@1+ (1,0) [0|4294967295] "s" Vector__XXX
 SG_ Temperature_Histogram_12 : 696|32@1+ (1,0) [0|4294967295] "s" Vector__XXX
 SG_ Temperature_Histogram_13 : 728|32@1+ (1,0) [0|4294967295] "s" Vector__XXX
 SG_ Temperature_Histogram_14 : 760|32@1+ (1,0) [0|4294967295] "s" Vector__XXX
 SG_ Temperature_Histogram_15 : 792|32@1+ (1,0) [0|4294967295] "s" Vector__XXX
 SG_ Temperature_Histogram_16 : 824|32@1+ (1,0) [0|4294967295] "s" Vector__XXX
 SG_ Temperature_Histogram_17 : 856|32@1+ (1,0) [0|4294967295] "s" Vector__XXX
 SG_ Temperature_Histogram_18 : 888|32@1+ (1,0) [0|4294967295] "s" Vector__XXX
 SG_ Temperature_Histogram_19 : 920|32@1+ (1,0) [0|4294967295] "s" Vector__XXX
 SG_ Temperature_Histogram_20 : 952|32@1+ (1,0) [0|4294967295] "s" Vector__XXX
 SG_ Temperature_Histogram_21 : 984|32@1+ (1,0) [0|4294967295] "s" Vector__XXX
 SG_ Temperature_Histogram_22 : 1016|32@1+ (1,0) [0|4294967295] "s" Vector__XXX
 SG_ Temperature_Histogram_23 : 1048|32@1+ (1,0) [0|4294967295] "s" Vector__XXX
 SG_ Time_Spent_in_Extreme_Temperatur0 : 1080|32@1+ (1,0) [0|4294967295] "s" Vector__XXX
 SG_ Time_Spent_in_Extreme_Temperatur1 : 1112|32@1+ (1,0) [0|4294967295] "s" Vector__XXX
 SG_ Number_of_Deep_Discharge_Events : 1144|8@1+ (1,0) [0|255] "count" Vector__XXX
 SG_ Time_Spent_Charging_In_Extreme_T : 1152|8@1+ (1,0) [0|255] "s" Vector__XXX
 SG_ State_of_Charge : 1160|16@1+ (0.0015625,0) [0|102.3984375] "%" Vector__XXX
 SG_ State_of_Charge_Histogram_0 : 1176|32@1+ (1,0) [0|4294967295] "s" Vector__XXX
 SG_ State_of_Charge_Histogram_1 : 1208|32@1+ (1,0) [0|4294967295] "s" Vector__XXX
 SG_ State_of_Charge_Histogram_2 : 1240|32@1+ (1,0) [0|4294967295] "s" Vector__XXX
 SG_ State_of_Charge_Histogram_3 : 1272|32@1+ (1,0) [0|4294967295] "s" Vector__XXX
 SG_ State_of_Charge_Histogram_4 : 1304|32@1+ (1,0) [0|4294967295] "s" Vector__XXX
 SG_ State_of_Charge_Histogram_5 : 1336|32@1+ (1,0) [0|4294967295] "s" Vector__XXX
 SG_ State_of_Charge_Histogram_6 : 1368|32@1+ (1,0) [0|4294967295] "s" Vector__XXX
 SG_ State_of_Charge_Histogram_7 : 1400|32@1+ (1,0) [0|4294967295] "s" Vector__XXX
 SG_ State_of_Charge_Histogram_8 : 1432|32@1+ (1,0) [0|4294967295] "s" Vector__XXX
 SG_ State_of_Charge_Histogram_9 : 1464|32@1+ (1,0) [0|4294967295] "s" Vector__XXX
 SG_ State_of_Charge_Histogram_10 : 1496|32@1+ (1,0) [0|4294967295] "s" Vector__XXX
 SG_ State_of_Charge_Histogram_11 : 1528|32@1+ (1,0) [0|4294967295] "s" Vector__XXX
 SG_ State_of_Charge_Histogram_12 : 1560|32@1+ (1,0) [0|4294967295] "s" Vector__XXX
 SG_ State_of_Charge_Histogram_13 : 1592|32@1+ (1,0) [0|4294967295] "s" Vector__XXX
 SG_ State_of_Charge_Histogram_14 : 1624|32@1+ (1,0) [0|4294967295] "s" Vector__XXX
 SG_ State_of_Charge_Histogram_15 : 1656|32@1+ (1,0) [0|4294967295] "s" Vector__XXX
 SG_ State_of_Charge_Histogram_16 : 1688|32@1+ (1,0) [0|4294967295] "s" Vector__XXX
 SG_ State_of_Charge_Histogram_17 : 1720|32@1+ (1,0) [0|4294967295] "s" Vector__XXX
 SG_ State_of_Charge_Histogram_18 : 1752|32@1+ (1,0) [0|4294967295] "s" Vector__XXX
 SG_ State_of_Charge_Histogram_19 : 1784|32@1+ (1,0) [0|4294967295] "s" Vector__XXX

BO_ 2566852816 PropB_16_INTERPACK_Pack08BMS: 227 Pack08BMS
 SG_ Remaining_Capacity : 0|8@1+ (1,0) [0|255] "Ah" Vector__XXX
 SG_ Date_of_Manufacture_0 : 8|8@1+ (1,0) [0|255] "" Vector__XXX
 SG_ Date_of_Manufacture_1 : 16|8@1+ (1,0) [0|255] "" Vector__XXX
 SG_ Date_of_Manufacture_2 : 24|8@1+ (1,0) [0|255] "" Vector__XXX
 SG_ Date_of_Manufacture_3 : 32|8@1+ (1,0) [0|255] "" Vector__XXX
 SG_ Date_of_Manufacture_4 : 40|8@1+ (1,0) [0|255] "" Vector__XXX
 SG_ Date_of_Manufacture_5 : 48|8@1+ (1,0) [0|255] "" Vector__XXX
 SG_ Date_of_Manufacture_6 : 56|8@1+ (1,0) [0|255] "" Vector__XXX
 SG_ Date_of_Putting_Into_Service_0 : 64|8@1+ (1,0) [0|255] "" Vector__XXX
 SG_ Date_of_Putting_Into_Service_1 : 72|8@1+ (1,0) [0|255] "" Vector__XXX
 SG_ Date_of_Putting_Into_Service_2 : 80|8@1+ (1,0) [0|255] "" Vector__XXX
 SG_ Date_of_Putting_Into_Service_3 : 88|8@1+ (1,0) [0|255] "" Vector__XXX
 SG_ Date_of_Putting_Into_Service_4 : 96|8@1+ (1,0) [0|255] "" Vector__XXX
 SG_ Date_of_Putting_Into_Service_5 : 104|8@1+ (1,0) [0|255] "" Vector__XXX
 SG_ Date_of_Putting_Into_Service_6 : 112|8@1+ (1,0) [0|255] "" Vector__XXX
 SG_ Charge_Energy_Throughput : 120|24@1+ (1,0) [0|16777215] "kWh" Vector__XXX
 SG_ Discharge_Energy_Throughput : 144|24@1+ (1,0) [0|16777215] "kWh" Vector__XXX
 SG_ Total_Energy_Throughput : 168|24@1+ (1,0) [0|16777215] "kWh" Vector__XXX
 SG_ Charged_Capacity_Throughput : 192|24@1+ (1,0) [0|16777215] "Ah" Vector__XXX
 SG_ Discharged_Capacity_Throughput : 216|24@1+ (1,0) [0|16777215] "Ah" Vector__XXX
 SG_ Total_Capacity_Throughput : 240|24@1+ (1,0) [0|16777215] "Ah" Vector__XXX
 SG_ Number_of_Full_Equivalent_Charge0 : 264|16@1+ (1,0) [0|65535] "cycles" Vector__XXX
 SG_ Number_of_Full_Equivalent_Discha : 280|16@1+ (1,0) [0|65535] "cycles" Vector__XXX
 SG_ Number_of_Full_Equivalent_Charge1 : 296|16@1+ (1,0) [0|65535] "cycles" Vector__XXX
 SG_ Temperature_Histogram_0 : 312|32@1+ (1,0) [0|4294967295] "s" Vector__XXX
 SG_ Temperature_Histogram_1 : 344|32@1+ (1,0) [0|4294967295] "s" Vector__XXX
 SG_ Temperature_Histogram_2 : 376|32@1+ (1,0) [0|4294967295] "s" Vector__XXX
 SG_ Temperature_Histogram_3 : 408|32@1+ (1,0) [0|4294967295] "s" Vector__XXX
 SG_ Temperature_Histogram_4 : 440|32@1+ (1,0) [0|4294967295] "s" Vector__XXX
 SG_ Temperature_Histogram_5 : 472|32@1+ (1,0) [0|4294967295] "s" Vector__XXX
 SG_ Temperature_Histogram_6 : 504|32@1+ (1,0) [0|4294967295] "s" Vector__XXX
 SG_ Temperature_Histogram_7 : 536|32@1+ (1,0) [0|4294967295] "s" Vector__XXX
 SG_ Temperature_Histogram_8 : 568|32@1+ (1,0) [0|4294967295] "s" Vector__XXX
 SG_ Temperature_Histogram_9 : 600|32@1+ (1,0) [0|4294967295] "s" Vector__XXX
 SG_ Temperature_Histogram_10 : 632|32@1+ (1,0) [0|4294967295] "s" Vector__XXX
 SG_ Temperature_Histogram_11 : 664|32@1+ (1,0) [0|4294967295] "s" Vector__XXX
 SG_ Temperature_Histogram_12 : 696|32@1+ (1,0) [0|4294967295] "s" Vector__XXX
 SG_ Temperature_Histogram_13 : 728|32@1+ (1,0) [0|4294967295] "s" Vector__XXX
 SG_ Temperature_Histogram_14 : 760|32@1+ (1,0) [0|4294967295] "s" Vector__XXX
 SG_ Temperature_Histogram_15 : 792|32@1+ (1,0) [0|4294967295] "s" Vector__XXX
 SG_ Temperature_Histogram_16 : 824|32@1+ (1,0) [0|4294967295] "s" Vector__XXX
 SG_ Temperature_Histogram_17 : 856|32@1+ (1,0) [0|4294967295] "s" Vector__XXX
 SG_ Temperature_Histogram_18 : 888|32@1+ (1,0) [0|4294967295] "s" Vector__XXX
 SG_ Temperature_Histogram_19 : 920|32@1+ (1,0) [0|4294967295] "s" Vector__XXX
 SG_ Temperature_Histogram_20 : 952|32@1+ (1,0) [0|4294967295] "s" Vector__XXX
 SG_ Temperature_Histogram_21 : 984|32@1+ (1,0) [0|4294967295] "s" Vector__XXX
 SG_ Temperature_Histogram_22 : 1016|32@1+ (1,0) [0|4294967295] "s" Vector__XXX
 SG_ Temperature_Histogram_23 : 1048|32@1+ (1,0) [0|4294967295] "s" Vector__XXX
 SG_ Time_Spent_in_Extreme_Temperatur0 : 1080|32@1+ (1,0) [0|4294967295] "s" Vector__XXX
 SG_ Time_Spent_in_Extreme_Temperatur1 : 1112|32@1+ (1,0) [0|4294967295] "s" Vector__XXX
 SG_ Number_of_Deep_Discharge_Events : 1144|8@1+ (1,0) [0|255] "count" Vector__XXX
 SG_ Time_Spent_Charging_In_Extreme_T : 1152|8@1+ (1,0) [0|255] "s" Vector__XXX
 SG_ State_of_Charge : 1160|16@1+ (0.0015625,0) [0|102.3984375] "%" Vector__XXX
 SG_ State_of_Charge_Histogram_0 : 1176|32@1+ (1,0) [0|4294967295] "s" Vector__XXX
 SG_ State_of_Charge_Histogram_1 : 1208|32@1+ (1,0) [0|4294967295] "s" Vector__XXX
 SG_ State_of_Charge_Histogram_2 : 1240|32@1+ (1,0) [0|4294967295] "s" Vector__XXX
 SG_ State_of_Charge_Histogram_3 : 1272|32@1+ (1,0) [0|4294967295] "s" Vector__XXX
 SG_ State_of_Charge_Histogram_4 : 1304|32@1+ (1,0) [0|4294967295] "s" Vector__XXX
 SG_ State_of_Charge_Histogram_5 : 1336|32@1+ (1,0) [0|4294967295] "s" Vector__XXX
 SG_ State_of_Charge_Histogram_6 : 1368|32@1+ (1,0) [0|4294967295] "s" Vector__XXX
 SG_ State_of_Charge_Histogram_7 : 1400|32@1+ (1,0) [0|4294967295] "s" Vector__XXX
 SG_ State_of_Charge_Histogram_8 : 1432|32@1+ (1,0) [0|4294967295] "s" Vector__XXX
 SG_ State_of_Charge_Histogram_9 : 1464|32@1+ (1,0) [0|4294967295] "s" Vector__XXX
 SG_ State_of_Charge_Histogram_10 : 1496|32@1+ (1,0) [0|4294967295] "s" Vector__XXX
 SG_ State_of_Charge_Histogram_11 : 1528|32@1+ (1,0) [0|4294967295] "s" Vector__XXX
 SG_ State_of_Charge_Histogram_12 : 1560|32@1+ (1,0) [0|4294967295] "s" Vector__XXX
 SG_ State_of_Charge_Histogram_13 : 1592|32@1+ (1,0) [0|4294967295] "s" Vector__XXX
 SG_ State_of_Charge_Histogram_14 : 1624|32@1+ (1,0) [0|4294967295] "s" Vector__XXX
 SG_ State_of_Charge_Histogram_15 : 1656|32@1+ (1,0) [0|4294967295] "s" Vector__XXX
 SG_ State_of_Charge_Histogram_16 : 1688|32@1+ (1,0) [0|4294967295] "s" Vector__XXX
 SG_ State_of_Charge_Histogram_17 : 1720|32@1+ (1,0) [0|4294967295] "s" Vector__XXX
 SG_ State_of_Charge_Histogram_18 : 1752|32@1+ (1,0) [0|4294967295] "s" Vector__XXX
 SG_ State_of_Charge_Histogram_19 : 1784|32@1+ (1,0) [0|4294967295] "s" Vector__XXX

BO_ 2566852817 PropB_16_INTERPACK_Pack09BMS: 227 Pack09BMS
 SG_ Remaining_Capacity : 0|8@1+ (1,0) [0|255] "Ah" Vector__XXX
 SG_ Date_of_Manufacture_0 : 8|8@1+ (1,0) [0|255] "" Vector__XXX
 SG_ Date_of_Manufacture_1 : 16|8@1+ (1,0) [0|255] "" Vector__XXX
 SG_ Date_of_Manufacture_2 : 24|8@1+ (1,0) [0|255] "" Vector__XXX
 SG_ Date_of_Manufacture_3 : 32|8@1+ (1,0) [0|255] "" Vector__XXX
 SG_ Date_of_Manufacture_4 : 40|8@1+ (1,0) [0|255] "" Vector__XXX
 SG_ Date_of_Manufacture_5 : 48|8@1+ (1,0) [0|255] "" Vector__XXX
 SG_ Date_of_Manufacture_6 : 56|8@1+ (1,0) [0|255] "" Vector__XXX
 SG_ Date_of_Putting_Into_Service_0 : 64|8@1+ (1,0) [0|255] "" Vector__XXX
 SG_ Date_of_Putting_Into_Service_1 : 72|8@1+ (1,0) [0|255] "" Vector__XXX
 SG_ Date_of_Putting_Into_Service_2 : 80|8@1+ (1,0) [0|255] "" Vector__XXX
 SG_ Date_of_Putting_Into_Service_3 : 88|8@1+ (1,0) [0|255] "" Vector__XXX
 SG_ Date_of_Putting_Into_Service_4 : 96|8@1+ (1,0) [0|255] "" Vector__XXX
 SG_ Date_of_Putting_Into_Service_5 : 104|8@1+ (1,0) [0|255] "" Vector__XXX
 SG_ Date_of_Putting_Into_Service_6 : 112|8@1+ (1,0) [0|255] "" Vector__XXX
 SG_ Charge_Energy_Throughput : 120|24@1+ (1,0) [0|16777215] "kWh" Vector__XXX
 SG_ Discharge_Energy_Throughput : 144|24@1+ (1,0) [0|16777215] "kWh" Vector__XXX
 SG_ Total_Energy_Throughput : 168|24@1+ (1,0) [0|16777215] "kWh" Vector__XXX
 SG_ Charged_Capacity_Throughput : 192|24@1+ (1,0) [0|16777215] "Ah" Vector__XXX
 SG_ Discharged_Capacity_Throughput : 216|24@1+ (1,0) [0|16777215] "Ah" Vector__XXX
 SG_ Total_Capacity_Throughput : 240|24@1+ (1,0) [0|16777215] "Ah" Vector__XXX
 SG_ Number_of_Full_Equivalent_Charge0 : 264|16@1+ (1,0) [0|65535] "cycles" Vector__XXX
 SG_ Number_of_Full_Equivalent_Discha : 280|16@1+ (1,0) [0|65535] "cycles" Vector__XXX
 SG_ Number_of_Full_Equivalent_Charge1 : 296|16@1+ (1,0) [0|65535] "cycles" Vector__XXX
 SG_ Temperature_Histogram_0 : 312|32@1+ (1,0) [0|4294967295] "s" Vector__XXX
 SG_ Temperature_Histogram_1 : 344|32@1+ (1,0) [0|4294967295] "s" Vector__XXX
 SG_ Temperature_Histogram_2 : 376|32@1+ (1,0) [0|4294967295] "s" Vector__XXX
 SG_ Temperature_Histogram_3 : 408|32@1+ (1,0) [0|4294967295] "s" Vector__XXX
 SG_ Temperature_Histogram_4 : 440|32@1+ (1,0) [0|4294967295] "s" Vector__XXX
 SG_ Temperature_Histogram_5 : 472|32@1+ (1,0) [0|4294967295] "s" Vector__XXX
 SG_ Temperature_Histogram_6 : 504|32@1+ (1,0) [0|4294967295] "s" Vector__XXX
 SG_ Temperature_Histogram_7 : 536|32@1+ (1,0) [0|4294967295] "s" Vector__XXX
 SG_ Temperature_Histogram_8 : 568|32@1+ (1,0) [0|4294967295] "s" Vector__XXX
 SG_ Temperature_Histogram_9 : 600|32@1+ (1,0) [0|4294967295] "s" Vector__XXX
 SG_ Temperature_Histogram_10 : 632|32@1+ (1,0) [0|4294967295] "s" Vector__XXX
 SG_ Temperature_Histogram_11 : 664|32@1+ (1,0) [0|4294967295] "s" Vector__XXX
 SG_ Temperature_Histogram_12 : 696|32@1+ (1,0) [0|4294967295] "s" Vector__XXX
 SG_ Temperature_Histogram_13 : 728|32@1+ (1,0) [0|4294967295] "s" Vector__XXX
 SG_ Temperature_Histogram_14 : 760|32@1+ (1,0) [0|4294967295] "s" Vector__XXX
 SG_ Temperature_Histogram_15 : 792|32@1+ (1,0) [0|4294967295] "s" Vector__XXX
 SG_ Temperature_Histogram_16 : 824|32@1+ (1,0) [0|4294967295] "s" Vector__XXX
 SG_ Temperature_Histogram_17 : 856|32@1+ (1,0) [0|4294967295] "s" Vector__XXX
 SG_ Temperature_Histogram_18 : 888|32@1+ (1,0) [0|4294967295] "s" Vector__XXX
 SG_ Temperature_Histogram_19 : 920|32@1+ (1,0) [0|4294967295] "s" Vector__XXX
 SG_ Temperature_Histogram_20 : 952|32@1+ (1,0) [0|4294967295] "s" Vector__XXX
 SG_ Temperature_Histogram_21 : 984|32@1+ (1,0) [0|4294967295] "s" Vector__XXX
 SG_ Temperature_Histogram_22 : 1016|32@1+ (1,0) [0|4294967295] "s" Vector__XXX
 SG_ Temperature_Histogram_23 : 1048|32@1+ (1,0) [0|4294967295] "s" Vector__XXX
 SG_ Time_Spent_in_Extreme_Temperatur0 : 1080|32@1+ (1,0) [0|4294967295] "s" Vector__XXX
 SG_ Time_Spent_in_Extreme_Temperatur1 : 1112|32@1+ (1,0) [0|4294967295] "s" Vector__XXX
 SG_ Number_of_Deep_Discharge_Events : 1144|8@1+ (1,0) [0|255] "count" Vector__XXX
 SG_ Time_Spent_Charging_In_Extreme_T : 1152|8@1+ (1,0) [0|255] "s" Vector__XXX
 SG_ State_of_Charge : 1160|16@1+ (0.0015625,0) [0|102.3984375] "%" Vector__XXX
 SG_ State_of_Charge_Histogram_0 : 1176|32@1+ (1,0) [0|4294967295] "s" Vector__XXX
 SG_ State_of_Charge_Histogram_1 : 1208|32@1+ (1,0) [0|4294967295] "s" Vector__XXX
 SG_ State_of_Charge_Histogram_2 : 1240|32@1+ (1,0) [0|4294967295] "s" Vector__XXX
 SG_ State_of_Charge_Histogram_3 : 1272|32@1+ (1,0) [0|4294967295] "s" Vector__XXX
 SG_ State_of_Charge_Histogram_4 : 1304|32@1+ (1,0) [0|4294967295] "s" Vector__XXX
 SG_ State_of_Charge_Histogram_5 : 1336|32@1+ (1,0) [0|4294967295] "s" Vector__XXX
 SG_ State_of_Charge_Histogram_6 : 1368|32@1+ (1,0) [0|4294967295] "s" Vector__XXX
 SG_ State_of_Charge_Histogram_7 : 1400|32@1+ (1,0) [0|4294967295] "s" Vector__XXX
 SG_ State_of_Charge_Histogram_8 : 1432|32@1+ (1,0) [0|4294967295] "s" Vector__XXX
 SG_ State_of_Charge_Histogram_9 : 1464|32@1+ (1,0) [0|4294967295] "s" Vector__XXX
 SG_ State_of_Charge_Histogram_10 : 1496|32@1+ (1,0) [0|4294967295] "s" Vector__XXX
 SG_ State_of_Charge_Histogram_11 : 1528|32@1+ (1,0) [0|4294967295] "s" Vector__XXX
 SG_ State_of_Charge_Histogram_12 : 1560|32@1+ (1,0) [0|4294967295] "s" Vector__XXX
 SG_ State_of_Charge_Histogram_13 : 1592|32@1+ (1,0) [0|4294967295] "s" Vector__XXX
 SG_ State_of_Charge_Histogram_14 : 1624|32@1+ (1,0) [0|4294967295] "s" Vector__XXX
 SG_ State_of_Charge_Histogram_15 : 1656|32@1+ (1,0) [0|4294967295] "s" Vector__XXX
 SG_ State_of_Charge_Histogram_16 : 1688|32@1+ (1,0) [0|4294967295] "s" Vector__XXX
 SG_ State_of_Charge_Histogram_17 : 1720|32@1+ (1,0) [0|4294967295] "s" Vector__XXX
 SG_ State_of_Charge_Histogram_18 : 1752|32@1+ (1,0) [0|4294967295] "s" Vector__XXX
 SG_ State_of_Charge_Histogram_19 : 1784|32@1+ (1,0) [0|4294967295] "s" Vector__XXX

BO_ 2566852818 PropB_16_INTERPACK_Pack10BMS: 227 Pack10BMS
 SG_ Remaining_Capacity : 0|8@1+ (1,0) [0|255] "Ah" Vector__XXX
 SG_ Date_of_Manufacture_0 : 8|8@1+ (1,0) [0|255] "" Vector__XXX
 SG_ Date_of_Manufacture_1 : 16|8@1+ (1,0) [0|255] "" Vector__XXX
 SG_ Date_of_Manufacture_2 : 24|8@1+ (1,0) [0|255] "" Vector__XXX
 SG_ Date_of_Manufacture_3 : 32|8@1+ (1,0) [0|255] "" Vector__XXX
 SG_ Date_of_Manufacture_4 : 40|8@1+ (1,0) [0|255] "" Vector__XXX
 SG_ Date_of_Manufacture_5 : 48|8@1+ (1,0) [0|255] "" Vector__XXX
 SG_ Date_of_Manufacture_6 : 56|8@1+ (1,0) [0|255] "" Vector__XXX
 SG_ Date_of_Putting_Into_Service_0 : 64|8@1+ (1,0) [0|255] "" Vector__XXX
 SG_ Date_of_Putting_Into_Service_1 : 72|8@1+ (1,0) [0|255] "" Vector__XXX
 SG_ Date_of_Putting_Into_Service_2 : 80|8@1+ (1,0) [0|255] "" Vector__XXX
 SG_ Date_of_Putting_Into_Service_3 : 88|8@1+ (1,0) [0|255] "" Vector__XXX
 SG_ Date_of_Putting_Into_Service_4 : 96|8@1+ (1,0) [0|255] "" Vector__XXX
 SG_ Date_of_Putting_Into_Service_5 : 104|8@1+ (1,0) [0|255] "" Vector__XXX
 SG_ Date_of_Putting_Into_Service_6 : 112|8@1+ (1,0) [0|255] "" Vector__XXX
 SG_ Charge_Energy_Throughput : 120|24@1+ (1,0) [0|16777215] "kWh" Vector__XXX
 SG_ Discharge_Energy_Throughput : 144|24@1+ (1,0) [0|16777215] "kWh" Vector__XXX
 SG_ Total_Energy_Throughput : 168|24@1+ (1,0) [0|16777215] "kWh" Vector__XXX
 SG_ Charged_Capacity_Throughput : 192|24@1+ (1,0) [0|16777215] "Ah" Vector__XXX
 SG_ Discharged_Capacity_Throughput : 216|24@1+ (1,0) [0|16777215] "Ah" Vector__XXX
 SG_ Total_Capacity_Throughput : 240|24@1+ (1,0) [0|16777215] "Ah" Vector__XXX
 SG_ Number_of_Full_Equivalent_Charge0 : 264|16@1+ (1,0) [0|65535] "cycles" Vector__XXX
 SG_ Number_of_Full_Equivalent_Discha : 280|16@1+ (1,0) [0|65535] "cycles" Vector__XXX
 SG_ Number_of_Full_Equivalent_Charge1 : 296|16@1+ (1,0) [0|65535] "cycles" Vector__XXX
 SG_ Temperature_Histogram_0 : 312|32@1+ (1,0) [0|4294967295] "s" Vector__XXX
 SG_ Temperature_Histogram_1 : 344|32@1+ (1,0) [0|4294967295] "s" Vector__XXX
 SG_ Temperature_Histogram_2 : 376|32@1+ (1,0) [0|4294967295] "s" Vector__XXX
 SG_ Temperature_Histogram_3 : 408|32@1+ (1,0) [0|4294967295] "s" Vector__XXX
 SG_ Temperature_Histogram_4 : 440|32@1+ (1,0) [0|4294967295] "s" Vector__XXX
 SG_ Temperature_Histogram_5 : 472|32@1+ (1,0) [0|4294967295] "s" Vector__XXX
 SG_ Temperature_Histogram_6 : 504|32@1+ (1,0) [0|4294967295] "s" Vector__XXX
 SG_ Temperature_Histogram_7 : 536|32@1+ (1,0) [0|4294967295] "s" Vector__XXX
 SG_ Temperature_Histogram_8 : 568|32@1+ (1,0) [0|4294967295] "s" Vector__XXX
 SG_ Temperature_Histogram_9 : 600|32@1+ (1,0) [0|4294967295] "s" Vector__XXX
 SG_ Temperature_Histogram_10 : 632|32@1+ (1,0) [0|4294967295] "s" Vector__XXX
 SG_ Temperature_Histogram_11 : 664|32@1+ (1,0) [0|4294967295] "s" Vector__XXX
 SG_ Temperature_Histogram_12 : 696|32@1+ (1,0) [0|4294967295] "s" Vector__XXX
 SG_ Temperature_Histogram_13 : 728|32@1+ (1,0) [0|4294967295] "s" Vector__XXX
 SG_ Temperature_Histogram_14 : 760|32@1+ (1,0) [0|4294967295] "s" Vector__XXX
 SG_ Temperature_Histogram_15 : 792|32@1+ (1,0) [0|4294967295] "s" Vector__XXX
 SG_ Temperature_Histogram_16 : 824|32@1+ (1,0) [0|4294967295] "s" Vector__XXX
 SG_ Temperature_Histogram_17 : 856|32@1+ (1,0) [0|4294967295] "s" Vector__XXX
 SG_ Temperature_Histogram_18 : 888|32@1+ (1,0) [0|4294967295] "s" Vector__XXX
 SG_ Temperature_Histogram_19 : 920|32@1+ (1,0) [0|4294967295] "s" Vector__XXX
 SG_ Temperature_Histogram_20 : 952|32@1+ (1,0) [0|4294967295] "s" Vector__XXX
 SG_ Temperature_Histogram_21 : 984|32@1+ (1,0) [0|4294967295] "s" Vector__XXX
 SG_ Temperature_Histogram_22 : 1016|32@1+ (1,0) [0|4294967295] "s" Vector__XXX
 SG_ Temperature_Histogram_23 : 1048|32@1+ (1,0) [0|4294967295] "s" Vector__XXX
 SG_ Time_Spent_in_Extreme_Temperatur0 : 1080|32@1+ (1,0) [0|4294967295] "s" Vector__XXX
 SG_ Time_Spent_in_Extreme_Temperatur1 : 1112|32@1+ (1,0) [0|4294967295] "s" Vector__XXX
 SG_ Number_of_Deep_Discharge_Events : 1144|8@1+ (1,0) [0|255] "count" Vector__XXX
 SG_ Time_Spent_Charging_In_Extreme_T : 1152|8@1+ (1,0) [0|255] "s" Vector__XXX
 SG_ State_of_Charge : 1160|16@1+ (0.0015625,0) [0|102.3984375] "%" Vector__XXX
 SG_ State_of_Charge_Histogram_0 : 1176|32@1+ (1,0) [0|4294967295] "s" Vector__XXX
 SG_ State_of_Charge_Histogram_1 : 1208|32@1+ (1,0) [0|4294967295] "s" Vector__XXX
 SG_ State_of_Charge_Histogram_2 : 1240|32@1+ (1,0) [0|4294967295] "s" Vector__XXX
 SG_ State_of_Charge_Histogram_3 : 1272|32@1+ (1,0) [0|4294967295] "s" Vector__XXX
 SG_ State_of_Charge_Histogram_4 : 1304|32@1+ (1,0) [0|4294967295] "s" Vector__XXX
 SG_ State_of_Charge_Histogram_5 : 1336|32@1+ (1,0) [0|4294967295] "s" Vector__XXX
 SG_ State_of_Charge_Histogram_6 : 1368|32@1+ (1,0) [0|4294967295] "s" Vector__XXX
 SG_ State_of_Charge_Histogram_7 : 1400|32@1+ (1,0) [0|4294967295] "s" Vector__XXX
 SG_ State_of_Charge_Histogram_8 : 1432|32@1+ (1,0) [0|4294967295] "s" Vector__XXX
 SG_ State_of_Charge_Histogram_9 : 1464|32@1+ (1,0) [0|4294967295] "s" Vector__XXX
 SG_ State_of_Charge_Histogram_10 : 1496|32@1+ (1,0) [0|4294967295] "s" Vector__XXX
 SG_ State_of_Charge_Histogram_11 : 1528|32@1+ (1,0) [0|4294967295] "s" Vector__XXX
 SG_ State_of_Charge_Histogram_12 : 1560|32@1+ (1,0) [0|4294967295] "s" Vector__XXX
 SG_ State_of_Charge_Histogram_13 : 1592|32@1+ (1,0) [0|4294967295] "s" Vector__XXX
 SG_ State_of_Charge_Histogram_14 : 1624|32@1+ (1,0) [0|4294967295] "s" Vector__XXX
 SG_ State_of_Charge_Histogram_15 : 1656|32@1+ (1,0) [0|4294967295] "s" Vector__XXX
 SG_ State_of_Charge_Histogram_16 : 1688|32@1+ (1,0) [0|4294967295] "s" Vector__XXX
 SG_ State_of_Charge_Histogram_17 : 1720|32@1+ (1,0) [0|4294967295] "s" Vector__XXX
 SG_ State_of_Charge_Histogram_18 : 1752|32@1+ (1,0) [0|4294967295] "s" Vector__XXX
 SG_ State_of_Charge_Histogram_19 : 1784|32@1+ (1,0) [0|4294967295] "s" Vector__XXX

BO_ 2566852819 PropB_16_INTERPACK_Pack11BMS: 227 Pack11BMS
 SG_ Remaining_Capacity : 0|8@1+ (1,0) [0|255] "Ah" Vector__XXX
 SG_ Date_of_Manufacture_0 : 8|8@1+ (1,0) [0|255] "" Vector__XXX
 SG_ Date_of_Manufacture_1 : 16|8@1+ (1,0) [0|255] "" Vector__XXX
 SG_ Date_of_Manufacture_2 : 24|8@1+ (1,0) [0|255] "" Vector__XXX
 SG_ Date_of_Manufacture_3 : 32|8@1+ (1,0) [0|255] "" Vector__XXX
 SG_ Date_of_Manufacture_4 : 40|8@1+ (1,0) [0|255] "" Vector__XXX
 SG_ Date_of_Manufacture_5 : 48|8@1+ (1,0) [0|255] "" Vector__XXX
 SG_ Date_of_Manufacture_6 : 56|8@1+ (1,0) [0|255] "" Vector__XXX
 SG_ Date_of_Putting_Into_Service_0 : 64|8@1+ (1,0) [0|255] "" Vector__XXX
 SG_ Date_of_Putting_Into_Service_1 : 72|8@1+ (1,0) [0|255] "" Vector__XXX
 SG_ Date_of_Putting_Into_Service_2 : 80|8@1+ (1,0) [0|255] "" Vector__XXX
 SG_ Date_of_Putting_Into_Service_3 : 88|8@1+ (1,0) [0|255] "" Vector__XXX
 SG_ Date_of_Putting_Into_Service_4 : 96|8@1+ (1,0) [0|255] "" Vector__XXX
 SG_ Date_of_Putting_Into_Service_5 : 104|8@1+ (1,0) [0|255] "" Vector__XXX
 SG_ Date_of_Putting_Into_Service_6 : 112|8@1+ (1,0) [0|255] "" Vector__XXX
 SG_ Charge_Energy_Throughput : 120|24@1+ (1,0) [0|16777215] "kWh" Vector__XXX
 SG_ Discharge_Energy_Throughput : 144|24@1+ (1,0) [0|16777215] "kWh" Vector__XXX
 SG_ Total_Energy_Throughput : 168|24@1+ (1,0) [0|16777215] "kWh" Vector__XXX
 SG_ Charged_Capacity_Throughput : 192|24@1+ (1,0) [0|16777215] "Ah" Vector__XXX
 SG_ Discharged_Capacity_Throughput : 216|24@1+ (1,0) [0|16777215] "Ah" Vector__XXX
 SG_ Total_Capacity_Throughput : 240|24@1+ (1,0) [0|16777215] "Ah" Vector__XXX
 SG_ Number_of_Full_Equivalent_Charge0 : 264|16@1+ (1,0) [0|65535] "cycles" Vector__XXX
 SG_ Number_of_Full_Equivalent_Discha : 280|16@1+ (1,0) [0|65535] "cycles" Vector__XXX
 SG_ Number_of_Full_Equivalent_Charge1 : 296|16@1+ (1,0) [0|65535] "cycles" Vector__XXX
 SG_ Temperature_Histogram_0 : 312|32@1+ (1,0) [0|4294967295] "s" Vector__XXX
 SG_ Temperature_Histogram_1 : 344|32@1+ (1,0) [0|4294967295] "s" Vector__XXX
 SG_ Temperature_Histogram_2 : 376|32@1+ (1,0) [0|4294967295] "s" Vector__XXX
 SG_ Temperature_Histogram_3 : 408|32@1+ (1,0) [0|4294967295] "s" Vector__XXX
 SG_ Temperature_Histogram_4 : 440|32@1+ (1,0) [0|4294967295] "s" Vector__XXX
 SG_ Temperature_Histogram_5 : 472|32@1+ (1,0) [0|4294967295] "s" Vector__XXX
 SG_ Temperature_Histogram_6 : 504|32@1+ (1,0) [0|4294967295] "s" Vector__XXX
 SG_ Temperature_Histogram_7 : 536|32@1+ (1,0) [0|4294967295] "s" Vector__XXX
 SG_ Temperature_Histogram_8 : 568|32@1+ (1,0) [0|4294967295] "s" Vector__XXX
 SG_ Temperature_Histogram_9 : 600|32@1+ (1,0) [0|4294967295] "s" Vector__XXX
 SG_ Temperature_Histogram_10 : 632|32@1+ (1,0) [0|4294967295] "s" Vector__XXX
 SG_ Temperature_Histogram_11 : 664|32@1+ (1,0) [0|4294967295] "s" Vector__XXX
 SG_ Temperature_Histogram_12 : 696|32@1+ (1,0) [0|4294967295] "s" Vector__XXX
 SG_ Temperature_Histogram_13 : 728|32@1+ (1,0) [0|4294967295] "s" Vector__XXX
 SG_ Temperature_Histogram_14 : 760|32@1+ (1,0) [0|4294967295] "s" Vector__XXX
 SG_ Temperature_Histogram_15 : 792|32@1+ (1,0) [0|4294967295] "s" Vector__XXX
 SG_ Temperature_Histogram_16 : 824|32@1+ (1,0) [0|4294967295] "s" Vector__XXX
 SG_ Temperature_Histogram_17 : 856|32@1+ (1,0) [0|4294967295] "s" Vector__XXX
 SG_ Temperature_Histogram_18 : 888|32@1+ (1,0) [0|4294967295] "s" Vector__XXX
 SG_ Temperature_Histogram_19 : 920|32@1+ (1,0) [0|4294967295] "s" Vector__XXX
 SG_ Temperature_Histogram_20 : 952|32@1+ (1,0) [0|4294967295] "s" Vector__XXX
 SG_ Temperature_Histogram_21 : 984|32@1+ (1,0) [0|4294967295] "s" Vector__XXX
 SG_ Temperature_Histogram_22 : 1016|32@1+ (1,0) [0|4294967295] "s" Vector__XXX
 SG_ Temperature_Histogram_23 : 1048|32@1+ (1,0) [0|4294967295] "s" Vector__XXX
 SG_ Time_Spent_in_Extreme_Temperatur0 : 1080|32@1+ (1,0) [0|4294967295] "s" Vector__XXX
 SG_ Time_Spent_in_Extreme_Temperatur1 : 1112|32@1+ (1,0) [0|4294967295] "s" Vector__XXX
 SG_ Number_of_Deep_Discharge_Events : 1144|8@1+ (1,0) [0|255] "count" Vector__XXX
 SG_ Time_Spent_Charging_In_Extreme_T : 1152|8@1+ (1,0) [0|255] "s" Vector__XXX
 SG_ State_of_Charge : 1160|16@1+ (0.0015625,0) [0|102.3984375] "%" Vector__XXX
 SG_ State_of_Charge_Histogram_0 : 1176|32@1+ (1,0) [0|4294967295] "s" Vector__XXX
 SG_ State_of_Charge_Histogram_1 : 1208|32@1+ (1,0) [0|4294967295] "s" Vector__XXX
 SG_ State_of_Charge_Histogram_2 : 1240|32@1+ (1,0) [0|4294967295] "s" Vector__XXX
 SG_ State_of_Charge_Histogram_3 : 1272|32@1+ (1,0) [0|4294967295] "s" Vector__XXX
 SG_ State_of_Charge_Histogram_4 : 1304|32@1+ (1,0) [0|4294967295] "s" Vector__XXX
 SG_ State_of_Charge_Histogram_5 : 1336|32@1+ (1,0) [0|4294967295] "s" Vector__XXX
 SG_ State_of_Charge_Histogram_6 : 1368|32@1+ (1,0) [0|4294967295] "s" Vector__XXX
 SG_ State_of_Charge_Histogram_7 : 1400|32@1+ (1,0) [0|4294967295] "s" Vector__XXX
 SG_ State_of_Charge_Histogram_8 : 1432|32@1+ (1,0) [0|4294967295] "s" Vector__XXX
 SG_ State_of_Charge_Histogram_9 : 1464|32@1+ (1,0) [0|4294967295] "s" Vector__XXX
 SG_ State_of_Charge_Histogram_10 : 1496|32@1+ (1,0) [0|4294967295] "s" Vector__XXX
 SG_ State_of_Charge_Histogram_11 : 1528|32@1+ (1,0) [0|4294967295] "s" Vector__XXX
 SG_ State_of_Charge_Histogram_12 : 1560|32@1+ (1,0) [0|4294967295] "s" Vector__XXX
 SG_ State_of_Charge_Histogram_13 : 1592|32@1+ (1,0) [0|4294967295] "s" Vector__XXX
 SG_ State_of_Charge_Histogram_14 : 1624|32@1+ (1,0) [0|4294967295] "s" Vector__XXX
 SG_ State_of_Charge_Histogram_15 : 1656|32@1+ (1,0) [0|4294967295] "s" Vector__XXX
 SG_ State_of_Charge_Histogram_16 : 1688|32@1+ (1,0) [0|4294967295] "s" Vector__XXX
 SG_ State_of_Charge_Histogram_17 : 1720|32@1+ (1,0) [0|4294967295] "s" Vector__XXX
 SG_ State_of_Charge_Histogram_18 : 1752|32@1+ (1,0) [0|4294967295] "s" Vector__XXX
 SG_ State_of_Charge_Histogram_19 : 1784|32@1+ (1,0) [0|4294967295] "s" Vector__XXX

CM_ SG_ 2566852809 Remaining_Capacity "Pack charge capacity";
CM_ SG_ 2566852809 Date_of_Manufacture_0 "Date of manufacture encoded as YYYY-MM";
CM_ SG_ 2566852809 Date_of_Manufacture_1 "Date of manufacture encoded as YYYY-MM";
CM_ SG_ 2566852809 Date_of_Manufacture_2 "Date of manufacture encoded as YYYY-MM";
CM_ SG_ 2566852809 Date_of_Manufacture_3 "Date of manufacture encoded as YYYY-MM";
CM_ SG_ 2566852809 Date_of_Manufacture_4 "Date of manufacture encoded as YYYY-MM";
CM_ SG_ 2566852809 Date_of_Manufacture_5 "Date of manufacture encoded as YYYY-MM";
CM_ SG_ 2566852809 Date_of_Manufacture_6 "Date of manufacture encoded as YYYY-MM";
CM_ SG_ 2566852809 Date_of_Putting_Into_Service_0 "Date of putting into service encoded as YYYY-MM";
CM_ SG_ 2566852809 Date_of_Putting_Into_Service_1 "Date of putting into service encoded as YYYY-MM";
CM_ SG_ 2566852809 Date_of_Putting_Into_Service_2 "Date of putting into service encoded as YYYY-MM";
CM_ SG_ 2566852809 Date_of_Putting_Into_Service_3 "Date of putting into service encoded as YYYY-MM";
CM_ SG_ 2566852809 Date_of_Putting_Into_Service_4 "Date of putting into service encoded as YYYY-MM";
CM_ SG_ 2566852809 Date_of_Putting_Into_Service_5 "Date of putting into service encoded as YYYY-MM";
CM_ SG_ 2566852809 Date_of_Putting_Into_Service_6 "Date of putting into service encoded as YYYY-MM";
CM_ SG_ 2566852809 Charge_Energy_Throughput "Battery system charge energy throughput";
CM_ SG_ 2566852809 Discharge_Energy_Throughput "Battery system discharge energy throughput";
CM_ SG_ 2566852809 Total_Energy_Throughput "Battery system total energy throughput";
CM_ SG_ 2566852809 Charged_Capacity_Throughput "Battery system charged capacity throughput";
CM_ SG_ 2566852809 Discharged_Capacity_Throughput "Battery system discharged capacity throughput";
CM_ SG_ 2566852809 Total_Capacity_Throughput "Battery system total capacity throughput";
CM_ SG_ 2566852809 Number_of_Full_Equivalent_Charge0 "Number of full equivalent charge cycles";
CM_ SG_ 2566852809 Number_of_Full_Equivalent_Discha "Number of full equivalent discharge cycles";
CM_ SG_ 2566852809 Number_of_Full_Equivalent_Charge1 "Number of full equivalent charge-discharge cycles";
CM_ SG_ 2566852809 Temperature_Histogram_0 "Battery system temperature histogram (seconds) of the battery pack.";
CM_ SG_ 2566852809 Temperature_Histogram_1 "Battery system temperature histogram (seconds) of the battery pack.";
CM_ SG_ 2566852809 Temperature_Histogram_2 "Battery system temperature histogram (seconds) of the battery pack.";
CM_ SG_ 2566852809 Temperature_Histogram_3 "Battery system temperature histogram (seconds) of the battery pack.";
CM_ SG_ 2566852809 Temperature_Histogram_4 "Battery system temperature histogram (seconds) of the battery pack.";
CM_ SG_ 2566852809 Temperature_Histogram_5 "Battery system temperature histogram (seconds) of the battery pack.";
CM_ SG_ 2566852809 Temperature_Histogram_6 "Battery system temperature histogram (seconds) of the battery pack.";
CM_ SG_ 2566852809 Temperature_Histogram_7 "Battery system temperature histogram (seconds) of the battery pack.";
CM_ SG_ 2566852809 Temperature_Histogram_8 "Battery system temperature histogram (seconds) of the battery pack.";
CM_ SG_ 2566852809 Temperature_Histogram_9 "Battery system temperature histogram (seconds) of the battery pack.";
CM_ SG_ 2566852809 Temperature_Histogram_10 "Battery system temperature histogram (seconds) of the battery pack.";
CM_ SG_ 2566852809 Temperature_Histogram_11 "Battery system temperature histogram (seconds) of the battery pack.";
CM_ SG_ 2566852809 Temperature_Histogram_12 "Battery system temperature histogram (seconds) of the battery pack.";
CM_ SG_ 2566852809 Temperature_Histogram_13 "Battery system temperature histogram (seconds) of the battery pack.";
CM_ SG_ 2566852809 Temperature_Histogram_14 "Battery system temperature histogram (seconds) of the battery pack.";
CM_ SG_ 2566852809 Temperature_Histogram_15 "Battery system temperature histogram (seconds) of the battery pack.";
CM_ SG_ 2566852809 Temperature_Histogram_16 "Battery system temperature histogram (seconds) of the battery pack.";
CM_ SG_ 2566852809 Temperature_Histogram_17 "Battery system temperature histogram (seconds) of the battery pack.";
CM_ SG_ 2566852809 Temperature_Histogram_18 "Battery system temperature histogram (seconds) of the battery pack.";
CM_ SG_ 2566852809 Temperature_Histogram_19 "Battery system temperature histogram (seconds) of the battery pack.";
CM_ SG_ 2566852809 Temperature_Histogram_20 "Battery system temperature histogram (seconds) of the battery pack.";
CM_ SG_ 2566852809 Temperature_Histogram_21 "Battery system temperature histogram (seconds) of the battery pack.";
CM_ SG_ 2566852809 Temperature_Histogram_22 "Battery system temperature histogram (seconds) of the battery pack.";
CM_ SG_ 2566852809 Temperature_Histogram_23 "Battery system temperature histogram (seconds) of the battery pack.";
CM_ SG_ 2566852809 Time_Spent_in_Extreme_Temperatur0 "Time spent in extreme temperatures above boundary (seconds) of the battery pack.";
CM_ SG_ 2566852809 Time_Spent_in_Extreme_Temperatur1 "Time spent in extreme temperatures below boundary (seconds) of the battery pack.";
CM_ SG_ 2566852809 Number_of_Deep_Discharge_Events "Number of deep discharge events of the battery pack.";
CM_ SG_ 2566852809 Time_Spent_Charging_In_Extreme_T "Time spent charging in extreme temperatures (seconds) of the battery pack.";
CM_ SG_ 2566852809 State_of_Charge "Battery system state of charge";
CM_ SG_ 2566852809 State_of_Charge_Histogram_0 "Battery system state of charge histogram (seconds) of the battery pack.";
CM_ SG_ 2566852809 State_of_Charge_Histogram_1 "Battery system state of charge histogram (seconds) of the battery pack.";
CM_ SG_ 2566852809 State_of_Charge_Histogram_2 "Battery system state of charge histogram (seconds) of the battery pack.";
CM_ SG_ 2566852809 State_of_Charge_Histogram_3 "Battery system state of charge histogram (seconds) of the battery pack.";
CM_ SG_ 2566852809 State_of_Charge_Histogram_4 "Battery system state of charge histogram (seconds) of the battery pack.";
CM_ SG_ 2566852809 State_of_Charge_Histogram_5 "Battery system state of charge histogram (seconds) of the battery pack.";
CM_ SG_ 2566852809 State_of_Charge_Histogram_6 "Battery system state of charge histogram (seconds) of the battery pack.";
CM_ SG_ 2566852809 State_of_Charge_Histogram_7 "Battery system state of charge histogram (seconds) of the battery pack.";
CM_ SG_ 2566852809 State_of_Charge_Histogram_8 "Battery system state of charge histogram (seconds) of the battery pack.";
CM_ SG_ 2566852809 State_of_Charge_Histogram_9 "Battery system state of charge histogram (seconds) of the battery pack.";
CM_ SG_ 2566852809 State_of_Charge_Histogram_10 "Battery system state of charge histogram (seconds) of the battery pack.";
CM_ SG_ 2566852809 State_of_Charge_Histogram_11 "Battery system state of charge histogram (seconds) of the battery pack.";
CM_ SG_ 2566852809 State_of_Charge_Histogram_12 "Battery system state of charge histogram (seconds) of the battery pack.";
CM_ SG_ 2566852809 State_of_Charge_Histogram_13 "Battery system state of charge histogram (seconds) of the battery pack.";
CM_ SG_ 2566852809 State_of_Charge_Histogram_14 "Battery system state of charge histogram (seconds) of the battery pack.";
CM_ SG_ 2566852809 State_of_Charge_Histogram_15 "Battery system state of charge histogram (seconds) of the battery pack.";
CM_ SG_ 2566852809 State_of_Charge_Histogram_16 "Battery system state of charge histogram (seconds) of the battery pack.";
CM_ SG_ 2566852809 State_of_Charge_Histogram_17 "Battery system state of charge histogram (seconds) of the battery pack.";
CM_ SG_ 2566852809 State_of_Charge_Histogram_18 "Battery system state of charge histogram (seconds) of the battery pack.";
CM_ SG_ 2566852809 State_of_Charge_Histogram_19 "Battery system state of charge histogram (seconds) of the battery pack.";
CM_ SG_ 2566852810 Remaining_Capacity "Pack charge capacity";
CM_ SG_ 2566852810 Date_of_Manufacture_0 "Date of manufacture encoded as YYYY-MM";
CM_ SG_ 2566852810 Date_of_Manufacture_1 "Date of manufacture encoded as YYYY-MM";
CM_ SG_ 2566852810 Date_of_Manufacture_2 "Date of manufacture encoded as YYYY-MM";
CM_ SG_ 2566852810 Date_of_Manufacture_3 "Date of manufacture encoded as YYYY-MM";
CM_ SG_ 2566852810 Date_of_Manufacture_4 "Date of manufacture encoded as YYYY-MM";
CM_ SG_ 2566852810 Date_of_Manufacture_5 "Date of manufacture encoded as YYYY-MM";
CM_ SG_ 2566852810 Date_of_Manufacture_6 "Date of manufacture encoded as YYYY-MM";
CM_ SG_ 2566852810 Date_of_Putting_Into_Service_0 "Date of putting into service encoded as YYYY-MM";
CM_ SG_ 2566852810 Date_of_Putting_Into_Service_1 "Date of putting into service encoded as YYYY-MM";
CM_ SG_ 2566852810 Date_of_Putting_Into_Service_2 "Date of putting into service encoded as YYYY-MM";
CM_ SG_ 2566852810 Date_of_Putting_Into_Service_3 "Date of putting into service encoded as YYYY-MM";
CM_ SG_ 2566852810 Date_of_Putting_Into_Service_4 "Date of putting into service encoded as YYYY-MM";
CM_ SG_ 2566852810 Date_of_Putting_Into_Service_5 "Date of putting into service encoded as YYYY-MM";
CM_ SG_ 2566852810 Date_of_Putting_Into_Service_6 "Date of putting into service encoded as YYYY-MM";
CM_ SG_ 2566852810 Charge_Energy_Throughput "Battery system charge energy throughput";
CM_ SG_ 2566852810 Discharge_Energy_Throughput "Battery system discharge energy throughput";
CM_ SG_ 2566852810 Total_Energy_Throughput "Battery system total energy throughput";
CM_ SG_ 2566852810 Charged_Capacity_Throughput "Battery system charged capacity throughput";
CM_ SG_ 2566852810 Discharged_Capacity_Throughput "Battery system discharged capacity throughput";
CM_ SG_ 2566852810 Total_Capacity_Throughput "Battery system total capacity throughput";
CM_ SG_ 2566852810 Number_of_Full_Equivalent_Charge0 "Number of full equivalent charge cycles";
CM_ SG_ 2566852810 Number_of_Full_Equivalent_Discha "Number of full equivalent discharge cycles";
CM_ SG_ 2566852810 Number_of_Full_Equivalent_Charge1 "Number of full equivalent charge-discharge cycles";
CM_ SG_ 2566852810 Temperature_Histogram_0 "Battery system temperature histogram (seconds) of the battery pack.";
CM_ SG_ 2566852810 Temperature_Histogram_1 "Battery system temperature histogram (seconds) of the battery pack.";
CM_ SG_ 2566852810 Temperature_Histogram_2 "Battery system temperature histogram (seconds) of the battery pack.";
CM_ SG_ 2566852810 Temperature_Histogram_3 "Battery system temperature histogram (seconds) of the battery pack.";
CM_ SG_ 2566852810 Temperature_Histogram_4 "Battery system temperature histogram (seconds) of the battery pack.";
CM_ SG_ 2566852810 Temperature_Histogram_5 "Battery system temperature histogram (seconds) of the battery pack.";
CM_ SG_ 2566852810 Temperature_Histogram_6 "Battery system temperature histogram (seconds) of the battery pack.";
CM_ SG_ 2566852810 Temperature_Histogram_7 "Battery system temperature histogram (seconds) of the battery pack.";
CM_ SG_ 2566852810 Temperature_Histogram_8 "Battery system temperature histogram (seconds) of the battery pack.";
CM_ SG_ 2566852810 Temperature_Histogram_9 "Battery system temperature histogram (seconds) of the battery pack.";
CM_ SG_ 2566852810 Temperature_Histogram_10 "Battery system temperature histogram (seconds) of the battery pack.";
CM_ SG_ 2566852810 Temperature_Histogram_11 "Battery system temperature histogram (seconds) of the battery pack.";
CM_ SG_ 2566852810 Temperature_Histogram_12 "Battery system temperature histogram (seconds) of the battery pack.";
CM_ SG_ 2566852810 Temperature_Histogram_13 "Battery system temperature histogram (seconds) of the battery pack.";
CM_ SG_ 2566852810 Temperature_Histogram_14 "Battery system temperature histogram (seconds) of the battery pack.";
CM_ SG_ 2566852810 Temperature_Histogram_15 "Battery system temperature histogram (seconds) of the battery pack.";
CM_ SG_ 2566852810 Temperature_Histogram_16 "Battery system temperature histogram (seconds) of the battery pack.";
CM_ SG_ 2566852810 Temperature_Histogram_17 "Battery system temperature histogram (seconds) of the battery pack.";
CM_ SG_ 2566852810 Temperature_Histogram_18 "Battery system temperature histogram (seconds) of the battery pack.";
CM_ SG_ 2566852810 Temperature_Histogram_19 "Battery system temperature histogram (seconds) of the battery pack.";
CM_ SG_ 2566852810 Temperature_Histogram_20 "Battery system temperature histogram (seconds) of the battery pack.";
CM_ SG_ 2566852810 Temperature_Histogram_21 "Battery system temperature histogram (seconds) of the battery pack.";
CM_ SG_ 2566852810 Temperature_Histogram_22 "Battery system temperature histogram (seconds) of the battery pack.";
CM_ SG_ 2566852810 Temperature_Histogram_23 "Battery system temperature histogram (seconds) of the battery pack.";
CM_ SG_ 2566852810 Time_Spent_in_Extreme_Temperatur0 "Time spent in extreme temperatures above boundary (seconds) of the battery pack.";
CM_ SG_ 2566852810 Time_Spent_in_Extreme_Temperatur1 "Time spent in extreme temperatures below boundary (seconds) of the battery pack.";
CM_ SG_ 2566852810 Number_of_Deep_Discharge_Events "Number of deep discharge events of the battery pack.";
CM_ SG_ 2566852810 Time_Spent_Charging_In_Extreme_T "Time spent charging in extreme temperatures (seconds) of the battery pack.";
CM_ SG_ 2566852810 State_of_Charge "Battery system state of charge";
CM_ SG_ 2566852810 State_of_Charge_Histogram_0 "Battery system state of charge histogram (seconds) of the battery pack.";
CM_ SG_ 2566852810 State_of_Charge_Histogram_1 "Battery system state of charge histogram (seconds) of the battery pack.";
CM_ SG_ 2566852810 State_of_Charge_Histogram_2 "Battery system state of charge histogram (seconds) of the battery pack.";
CM_ SG_ 2566852810 State_of_Charge_Histogram_3 "Battery system state of charge histogram (seconds) of the battery pack.";
CM_ SG_ 2566852810 State_of_Charge_Histogram_4 "Battery system state of charge histogram (seconds) of the battery pack.";
CM_ SG_ 2566852810 State_of_Charge_Histogram_5 "Battery system state of charge histogram (seconds) of the battery pack.";
CM_ SG_ 2566852810 State_of_Charge_Histogram_6 "Battery system state of charge histogram (seconds) of the battery pack.";
CM_ SG_ 2566852810 State_of_Charge_Histogram_7 "Battery system state of charge histogram (seconds) of the battery pack.";
CM_ SG_ 2566852810 State_of_Charge_Histogram_8 "Battery system state of charge histogram (seconds) of the battery pack.";
CM_ SG_ 2566852810 State_of_Charge_Histogram_9 "Battery system state of charge histogram (seconds) of the battery pack.";
CM_ SG_ 2566852810 State_of_Charge_Histogram_10 "Battery system state of charge histogram (seconds) of the battery pack.";
CM_ SG_ 2566852810 State_of_Charge_Histogram_11 "Battery system state of charge histogram (seconds) of the battery pack.";
CM_ SG_ 2566852810 State_of_Charge_Histogram_12 "Battery system state of charge histogram (seconds) of the battery pack.";
CM_ SG_ 2566852810 State_of_Charge_Histogram_13 "Battery system state of charge histogram (seconds) of the battery pack.";
CM_ SG_ 2566852810 State_of_Charge_Histogram_14 "Battery system state of charge histogram (seconds) of the battery pack.";
CM_ SG_ 2566852810 State_of_Charge_Histogram_15 "Battery system state of charge histogram (seconds) of the battery pack.";
CM_ SG_ 2566852810 State_of_Charge_Histogram_16 "Battery system state of charge histogram (seconds) of the battery pack.";
CM_ SG_ 2566852810 State_of_Charge_Histogram_17 "Battery system state of charge histogram (seconds) of the battery pack.";
CM_ SG_ 2566852810 State_of_Charge_Histogram_18 "Battery system state of charge histogram (seconds) of the battery pack.";
CM_ SG_ 2566852810 State_of_Charge_Histogram_19 "Battery system state of charge histogram (seconds) of the battery pack.";
CM_ SG_ 2566852811 Remaining_Capacity "Pack charge capacity";
CM_ SG_ 2566852811 Date_of_Manufacture_0 "Date of manufacture encoded as YYYY-MM";
CM_ SG_ 2566852811 Date_of_Manufacture_1 "Date of manufacture encoded as YYYY-MM";
CM_ SG_ 2566852811 Date_of_Manufacture_2 "Date of manufacture encoded as YYYY-MM";
CM_ SG_ 2566852811 Date_of_Manufacture_3 "Date of manufacture encoded as YYYY-MM";
CM_ SG_ 2566852811 Date_of_Manufacture_4 "Date of manufacture encoded as YYYY-MM";
CM_ SG_ 2566852811 Date_of_Manufacture_5 "Date of manufacture encoded as YYYY-MM";
CM_ SG_ 2566852811 Date_of_Manufacture_6 "Date of manufacture encoded as YYYY-MM";
CM_ SG_ 2566852811 Date_of_Putting_Into_Service_0 "Date of putting into service encoded as YYYY-MM";
CM_ SG_ 2566852811 Date_of_Putting_Into_Service_1 "Date of putting into service encoded as YYYY-MM";
CM_ SG_ 2566852811 Date_of_Putting_Into_Service_2 "Date of putting into service encoded as YYYY-MM";
CM_ SG_ 2566852811 Date_of_Putting_Into_Service_3 "Date of putting into service encoded as YYYY-MM";
CM_ SG_ 2566852811 Date_of_Putting_Into_Service_4 "Date of putting into service encoded as YYYY-MM";
CM_ SG_ 2566852811 Date_of_Putting_Into_Service_5 "Date of putting into service encoded as YYYY-MM";
CM_ SG_ 2566852811 Date_of_Putting_Into_Service_6 "Date of putting into service encoded as YYYY-MM";
CM_ SG_ 2566852811 Charge_Energy_Throughput "Battery system charge energy throughput";
CM_ SG_ 2566852811 Discharge_Energy_Throughput "Battery system discharge energy throughput";
CM_ SG_ 2566852811 Total_Energy_Throughput "Battery system total energy throughput";
CM_ SG_ 2566852811 Charged_Capacity_Throughput "Battery system charged capacity throughput";
CM_ SG_ 2566852811 Discharged_Capacity_Throughput "Battery system discharged capacity throughput";
CM_ SG_ 2566852811 Total_Capacity_Throughput "Battery system total capacity throughput";
CM_ SG_ 2566852811 Number_of_Full_Equivalent_Charge0 "Number of full equivalent charge cycles";
CM_ SG_ 2566852811 Number_of_Full_Equivalent_Discha "Number of full equivalent discharge cycles";
CM_ SG_ 2566852811 Number_of_Full_Equivalent_Charge1 "Number of full equivalent charge-discharge cycles";
CM_ SG_ 2566852811 Temperature_Histogram_0 "Battery system temperature histogram (seconds) of the battery pack.";
CM_ SG_ 2566852811 Temperature_Histogram_1 "Battery system temperature histogram (seconds) of the battery pack.";
CM_ SG_ 2566852811 Temperature_Histogram_2 "Battery system temperature histogram (seconds) of the battery pack.";
CM_ SG_ 2566852811 Temperature_Histogram_3 "Battery system temperature histogram (seconds) of the battery pack.";
CM_ SG_ 2566852811 Temperature_Histogram_4 "Battery system temperature histogram (seconds) of the battery pack.";
CM_ SG_ 2566852811 Temperature_Histogram_5 "Battery system temperature histogram (seconds) of the battery pack.";
CM_ SG_ 2566852811 Temperature_Histogram_6 "Battery system temperature histogram (seconds) of the battery pack.";
CM_ SG_ 2566852811 Temperature_Histogram_7 "Battery system temperature histogram (seconds) of the battery pack.";
CM_ SG_ 2566852811 Temperature_Histogram_8 "Battery system temperature histogram (seconds) of the battery pack.";
CM_ SG_ 2566852811 Temperature_Histogram_9 "Battery system temperature histogram (seconds) of the battery pack.";
CM_ SG_ 2566852811 Temperature_Histogram_10 "Battery system temperature histogram (seconds) of the battery pack.";
CM_ SG_ 2566852811 Temperature_Histogram_11 "Battery system temperature histogram (seconds) of the battery pack.";
CM_ SG_ 2566852811 Temperature_Histogram_12 "Battery system temperature histogram (seconds) of the battery pack.";
CM_ SG_ 2566852811 Temperature_Histogram_13 "Battery system temperature histogram (seconds) of the battery pack.";
CM_ SG_ 2566852811 Temperature_Histogram_14 "Battery system temperature histogram (seconds) of the battery pack.";
CM_ SG_ 2566852811 Temperature_Histogram_15 "Battery system temperature histogram (seconds) of the battery pack.";
CM_ SG_ 2566852811 Temperature_Histogram_16 "Battery system temperature histogram (seconds) of the battery pack.";
CM_ SG_ 2566852811 Temperature_Histogram_17 "Battery system temperature histogram (seconds) of the battery pack.";
CM_ SG_ 2566852811 Temperature_Histogram_18 "Battery system temperature histogram (seconds) of the battery pack.";
CM_ SG_ 2566852811 Temperature_Histogram_19 "Battery system temperature histogram (seconds) of the battery pack.";
CM_ SG_ 2566852811 Temperature_Histogram_20 "Battery system temperature histogram (seconds) of the battery pack.";
CM_ SG_ 2566852811 Temperature_Histogram_21 "Battery system temperature histogram (seconds) of the battery pack.";
CM_ SG_ 2566852811 Temperature_Histogram_22 "Battery system temperature histogram (seconds) of the battery pack.";
CM_ SG_ 2566852811 Temperature_Histogram_23 "Battery system temperature histogram (seconds) of the battery pack.";
CM_ SG_ 2566852811 Time_Spent_in_Extreme_Temperatur0 "Time spent in extreme temperatures above boundary (seconds) of the battery pack.";
CM_ SG_ 2566852811 Time_Spent_in_Extreme_Temperatur1 "Time spent in extreme temperatures below boundary (seconds) of the battery pack.";
CM_ SG_ 2566852811 Number_of_Deep_Discharge_Events "Number of deep discharge events of the battery pack.";
CM_ SG_ 2566852811 Time_Spent_Charging_In_Extreme_T "Time spent charging in extreme temperatures (seconds) of the battery pack.";
CM_ SG_ 2566852811 State_of_Charge "Battery system state of charge";
CM_ SG_ 2566852811 State_of_Charge_Histogram_0 "Battery system state of charge histogram (seconds) of the battery pack.";
CM_ SG_ 2566852811 State_of_Charge_Histogram_1 "Battery system state of charge histogram (seconds) of the battery pack.";
CM_ SG_ 2566852811 State_of_Charge_Histogram_2 "Battery system state of charge histogram (seconds) of the battery pack.";
CM_ SG_ 2566852811 State_of_Charge_Histogram_3 "Battery system state of charge histogram (seconds) of the battery pack.";
CM_ SG_ 2566852811 State_of_Charge_Histogram_4 "Battery system state of charge histogram (seconds) of the battery pack.";
CM_ SG_ 2566852811 State_of_Charge_Histogram_5 "Battery system state of charge histogram (seconds) of the battery pack.";
CM_ SG_ 2566852811 State_of_Charge_Histogram_6 "Battery system state of charge histogram (seconds) of the battery pack.";
CM_ SG_ 2566852811 State_of_Charge_Histogram_7 "Battery system state of charge histogram (seconds) of the battery pack.";
CM_ SG_ 2566852811 State_of_Charge_Histogram_8 "Battery system state of charge histogram (seconds) of the battery pack.";
CM_ SG_ 2566852811 State_of_Charge_Histogram_9 "Battery system state of charge histogram (seconds) of the battery pack.";
CM_ SG_ 2566852811 State_of_Charge_Histogram_10 "Battery system state of charge histogram (seconds) of the battery pack.";
CM_ SG_ 2566852811 State_of_Charge_Histogram_11 "Battery system state of charge histogram (seconds) of the battery pack.";
CM_ SG_ 2566852811 State_of_Charge_Histogram_12 "Battery system state of charge histogram (seconds) of the battery pack.";
CM_ SG_ 2566852811 State_of_Charge_Histogram_13 "Battery system state of charge histogram (seconds) of the battery pack.";
CM_ SG_ 2566852811 State_of_Charge_Histogram_14 "Battery system state of charge histogram (seconds) of the battery pack.";
CM_ SG_ 2566852811 State_of_Charge_Histogram_15 "Battery system state of charge histogram (seconds) of the battery pack.";
CM_ SG_ 2566852811 State_of_Charge_Histogram_16 "Battery system state of charge histogram (seconds) of the battery pack.";
CM_ SG_ 2566852811 State_of_Charge_Histogram_17 "Battery system state of charge histogram (seconds) of the battery pack.";
CM_ SG_ 2566852811 State_of_Charge_Histogram_18 "Battery system state of charge histogram (seconds) of the battery pack.";
CM_ SG_ 2566852811 State_of_Charge_Histogram_19 "Battery system state of charge histogram (seconds) of the battery pack.";
CM_ SG_ 2566852812 Remaining_Capacity "Pack charge capacity";
CM_ SG_ 2566852812 Date_of_Manufacture_0 "Date of manufacture encoded as YYYY-MM";
CM_ SG_ 2566852812 Date_of_Manufacture_1 "Date of manufacture encoded as YYYY-MM";
CM_ SG_ 2566852812 Date_of_Manufacture_2 "Date of manufacture encoded as YYYY-MM";
CM_ SG_ 2566852812 Date_of_Manufacture_3 "Date of manufacture encoded as YYYY-MM";
CM_ SG_ 2566852812 Date_of_Manufacture_4 "Date of manufacture encoded as YYYY-MM";
CM_ SG_ 2566852812 Date_of_Manufacture_5 "Date of manufacture encoded as YYYY-MM";
CM_ SG_ 2566852812 Date_of_Manufacture_6 "Date of manufacture encoded as YYYY-MM";
CM_ SG_ 2566852812 Date_of_Putting_Into_Service_0 "Date of putting into service encoded as YYYY-MM";
CM_ SG_ 2566852812 Date_of_Putting_Into_Service_1 "Date of putting into service encoded as YYYY-MM";
CM_ SG_ 2566852812 Date_of_Putting_Into_Service_2 "Date of putting into service encoded as YYYY-MM";
CM_ SG_ 2566852812 Date_of_Putting_Into_Service_3 "Date of putting into service encoded as YYYY-MM";
CM_ SG_ 2566852812 Date_of_Putting_Into_Service_4 "Date of putting into service encoded as YYYY-MM";
CM_ SG_ 2566852812 Date_of_Putting_Into_Service_5 "Date of putting into service encoded as YYYY-MM";
CM_ SG_ 2566852812 Date_of_Putting_Into_Service_6 "Date of putting into service encoded as YYYY-MM";
CM_ SG_ 2566852812 Charge_Energy_Throughput "Battery system charge energy throughput";
CM_ SG_ 2566852812 Discharge_Energy_Throughput "Battery system discharge energy throughput";
CM_ SG_ 2566852812 Total_Energy_Throughput "Battery system total energy throughput";
CM_ SG_ 2566852812 Charged_Capacity_Throughput "Battery system charged capacity throughput";
CM_ SG_ 2566852812 Discharged_Capacity_Throughput "Battery system discharged capacity throughput";
CM_ SG_ 2566852812 Total_Capacity_Throughput "Battery system total capacity throughput";
CM_ SG_ 2566852812 Number_of_Full_Equivalent_Charge0 "Number of full equivalent charge cycles";
CM_ SG_ 2566852812 Number_of_Full_Equivalent_Discha "Number of full equivalent discharge cycles";
CM_ SG_ 2566852812 Number_of_Full_Equivalent_Charge1 "Number of full equivalent charge-discharge cycles";
CM_ SG_ 2566852812 Temperature_Histogram_0 "Battery system temperature histogram (seconds) of the battery pack.";
CM_ SG_ 2566852812 Temperature_Histogram_1 "Battery system temperature histogram (seconds) of the battery pack.";
CM_ SG_ 2566852812 Temperature_Histogram_2 "Battery system temperature histogram (seconds) of the battery pack.";
CM_ SG_ 2566852812 Temperature_Histogram_3 "Battery system temperature histogram (seconds) of the battery pack.";
CM_ SG_ 2566852812 Temperature_Histogram_4 "Battery system temperature histogram (seconds) of the battery pack.";
CM_ SG_ 2566852812 Temperature_Histogram_5 "Battery system temperature histogram (seconds) of the battery pack.";
CM_ SG_ 2566852812 Temperature_Histogram_6 "Battery system temperature histogram (seconds) of the battery pack.";
CM_ SG_ 2566852812 Temperature_Histogram_7 "Battery system temperature histogram (seconds) of the battery pack.";
CM_ SG_ 2566852812 Temperature_Histogram_8 "Battery system temperature histogram (seconds) of the battery pack.";
CM_ SG_ 2566852812 Temperature_Histogram_9 "Battery system temperature histogram (seconds) of the battery pack.";
CM_ SG_ 2566852812 Temperature_Histogram_10 "Battery system temperature histogram (seconds) of the battery pack.";
CM_ SG_ 2566852812 Temperature_Histogram_11 "Battery system temperature histogram (seconds) of the battery pack.";
CM_ SG_ 2566852812 Temperature_Histogram_12 "Battery system temperature histogram (seconds) of the battery pack.";
CM_ SG_ 2566852812 Temperature_Histogram_13 "Battery system temperature histogram (seconds) of the battery pack.";
CM_ SG_ 2566852812 Temperature_Histogram_14 "Battery system temperature histogram (seconds) of the battery pack.";
CM_ SG_ 2566852812 Temperature_Histogram_15 "Battery system temperature histogram (seconds) of the battery pack.";
CM_ SG_ 2566852812 Temperature_Histogram_16 "Battery system temperature histogram (seconds) of the battery pack.";
CM_ SG_ 2566852812 Temperature_Histogram_17 "Battery system temperature histogram (seconds) of the battery pack.";
CM_ SG_ 2566852812 Temperature_Histogram_18 "Battery system temperature histogram (seconds) of the battery pack.";
CM_ SG_ 2566852812 Temperature_Histogram_19 "Battery system temperature histogram (seconds) of the battery pack.";
CM_ SG_ 2566852812 Temperature_Histogram_20 "Battery system temperature histogram (seconds) of the battery pack.";
CM_ SG_ 2566852812 Temperature_Histogram_21 "Battery system temperature histogram (seconds) of the battery pack.";
CM_ SG_ 2566852812 Temperature_Histogram_22 "Battery system temperature histogram (seconds) of the battery pack.";
CM_ SG_ 2566852812 Temperature_Histogram_23 "Battery system temperature histogram (seconds) of the battery pack.";
CM_ SG_ 2566852812 Time_Spent_in_Extreme_Temperatur0 "Time spent in extreme temperatures above boundary (seconds) of the battery pack.";
CM_ SG_ 2566852812 Time_Spent_in_Extreme_Temperatur1 "Time spent in extreme temperatures below boundary (seconds) of the battery pack.";
CM_ SG_ 2566852812 Number_of_Deep_Discharge_Events "Number of deep discharge events of the battery pack.";
CM_ SG_ 2566852812 Time_Spent_Charging_In_Extreme_T "Time spent charging in extreme temperatures (seconds) of the battery pack.";
CM_ SG_ 2566852812 State_of_Charge "Battery system state of charge";
CM_ SG_ 2566852812 State_of_Charge_Histogram_0 "Battery system state of charge histogram (seconds) of the battery pack.";
CM_ SG_ 2566852812 State_of_Charge_Histogram_1 "Battery system state of charge histogram (seconds) of the battery pack.";
CM_ SG_ 2566852812 State_of_Charge_Histogram_2 "Battery system state of charge histogram (seconds) of the battery pack.";
CM_ SG_ 2566852812 State_of_Charge_Histogram_3 "Battery system state of charge histogram (seconds) of the battery pack.";
CM_ SG_ 2566852812 State_of_Charge_Histogram_4 "Battery system state of charge histogram (seconds) of the battery pack.";
CM_ SG_ 2566852812 State_of_Charge_Histogram_5 "Battery system state of charge histogram (seconds) of the battery pack.";
CM_ SG_ 2566852812 State_of_Charge_Histogram_6 "Battery system state of charge histogram (seconds) of the battery pack.";
CM_ SG_ 2566852812 State_of_Charge_Histogram_7 "Battery system state of charge histogram (seconds) of the battery pack.";
CM_ SG_ 2566852812 State_of_Charge_Histogram_8 "Battery system state of charge histogram (seconds) of the battery pack.";
CM_ SG_ 2566852812 State_of_Charge_Histogram_9 "Battery system state of charge histogram (seconds) of the battery pack.";
CM_ SG_ 2566852812 State_of_Charge_Histogram_10 "Battery system state of charge histogram (seconds) of the battery pack.";
CM_ SG_ 2566852812 State_of_Charge_Histogram_11 "Battery system state of charge histogram (seconds) of the battery pack.";
CM_ SG_ 2566852812 State_of_Charge_Histogram_12 "Battery system state of charge histogram (seconds) of the battery pack.";
CM_ SG_ 2566852812 State_of_Charge_Histogram_13 "Battery system state of charge histogram (seconds) of the battery pack.";
CM_ SG_ 2566852812 State_of_Charge_Histogram_14 "Battery system state of charge histogram (seconds) of the battery pack.";
CM_ SG_ 2566852812 State_of_Charge_Histogram_15 "Battery system state of charge histogram (seconds) of the battery pack.";
CM_ SG_ 2566852812 State_of_Charge_Histogram_16 "Battery system state of charge histogram (seconds) of the battery pack.";
CM_ SG_ 2566852812 State_of_Charge_Histogram_17 "Battery system state of charge histogram (seconds) of the battery pack.";
CM_ SG_ 2566852812 State_of_Charge_Histogram_18 "Battery system state of charge histogram (seconds) of the battery pack.";
CM_ SG_ 2566852812 State_of_Charge_Histogram_19 "Battery system state of charge histogram (seconds) of the battery pack.";
CM_ SG_ 2566852813 Remaining_Capacity "Pack charge capacity";
CM_ SG_ 2566852813 Date_of_Manufacture_0 "Date of manufacture encoded as YYYY-MM";
CM_ SG_ 2566852813 Date_of_Manufacture_1 "Date of manufacture encoded as YYYY-MM";
CM_ SG_ 2566852813 Date_of_Manufacture_2 "Date of manufacture encoded as YYYY-MM";
CM_ SG_ 2566852813 Date_of_Manufacture_3 "Date of manufacture encoded as YYYY-MM";
CM_ SG_ 2566852813 Date_of_Manufacture_4 "Date of manufacture encoded as YYYY-MM";
CM_ SG_ 2566852813 Date_of_Manufacture_5 "Date of manufacture encoded as YYYY-MM";
CM_ SG_ 2566852813 Date_of_Manufacture_6 "Date of manufacture encoded as YYYY-MM";
CM_ SG_ 2566852813 Date_of_Putting_Into_Service_0 "Date of putting into service encoded as YYYY-MM";
CM_ SG_ 2566852813 Date_of_Putting_Into_Service_1 "Date of putting into service encoded as YYYY-MM";
CM_ SG_ 2566852813 Date_of_Putting_Into_Service_2 "Date of putting into service encoded as YYYY-MM";
CM_ SG_ 2566852813 Date_of_Putting_Into_Service_3 "Date of putting into service encoded as YYYY-MM";
CM_ SG_ 2566852813 Date_of_Putting_Into_Service_4 "Date of putting into service encoded as YYYY-MM";
CM_ SG_ 2566852813 Date_of_Putting_Into_Service_5 "Date of putting into service encoded as YYYY-MM";
CM_ SG_ 2566852813 Date_of_Putting_Into_Service_6 "Date of putting into service encoded as YYYY-MM";
CM_ SG_ 2566852813 Charge_Energy_Throughput "Battery system charge energy throughput";
CM_ SG_ 2566852813 Discharge_Energy_Throughput "Battery system discharge energy throughput";
CM_ SG_ 2566852813 Total_Energy_Throughput "Battery system total energy throughput";
CM_ SG_ 2566852813 Charged_Capacity_Throughput "Battery system charged capacity throughput";
CM_ SG_ 2566852813 Discharged_Capacity_Throughput "Battery system discharged capacity throughput";
CM_ SG_ 2566852813 Total_Capacity_Throughput "Battery system total capacity throughput";
CM_ SG_ 2566852813 Number_of_Full_Equivalent_Charge0 "Number of full equivalent charge cycles";
CM_ SG_ 2566852813 Number_of_Full_Equivalent_Discha "Number of full equivalent discharge cycles";
CM_ SG_ 2566852813 Number_of_Full_Equivalent_Charge1 "Number of full equivalent charge-discharge cycles";
CM_ SG_ 2566852813 Temperature_Histogram_0 "Battery system temperature histogram (seconds) of the battery pack.";
CM_ SG_ 2566852813 Temperature_Histogram_1 "Battery system temperature histogram (seconds) of the battery pack.";
CM_ SG_ 2566852813 Temperature_Histogram_2 "Battery system temperature histogram (seconds) of the battery pack.";
CM_ SG_ 2566852813 Temperature_Histogram_3 "Battery system temperature histogram (seconds) of the battery pack.";
CM_ SG_ 2566852813 Temperature_Histogram_4 "Battery system temperature histogram (seconds) of the battery pack.";
CM_ SG_ 2566852813 Temperature_Histogram_5 "Battery system temperature histogram (seconds) of the battery pack.";
CM_ SG_ 2566852813 Temperature_Histogram_6 "Battery system temperature histogram (seconds) of the battery pack.";
CM_ SG_ 2566852813 Temperature_Histogram_7 "Battery system temperature histogram (seconds) of the battery pack.";
CM_ SG_ 2566852813 Temperature_Histogram_8 "Battery system temperature histogram (seconds) of the battery pack.";
CM_ SG_ 2566852813 Temperature_Histogram_9 "Battery system temperature histogram (seconds) of the battery pack.";
CM_ SG_ 2566852813 Temperature_Histogram_10 "Battery system temperature histogram (seconds) of the battery pack.";
CM_ SG_ 2566852813 Temperature_Histogram_11 "Battery system temperature histogram (seconds) of the battery pack.";
CM_ SG_ 2566852813 Temperature_Histogram_12 "Battery system temperature histogram (seconds) of the battery pack.";
CM_ SG_ 2566852813 Temperature_Histogram_13 "Battery system temperature histogram (seconds) of the battery pack.";
CM_ SG_ 2566852813 Temperature_Histogram_14 "Battery system temperature histogram (seconds) of the battery pack.";
CM_ SG_ 2566852813 Temperature_Histogram_15 "Battery system temperature histogram (seconds) of the battery pack.";
CM_ SG_ 2566852813 Temperature_Histogram_16 "Battery system temperature histogram (seconds) of the battery pack.";
CM_ SG_ 2566852813 Temperature_Histogram_17 "Battery system temperature histogram (seconds) of the battery pack.";
CM_ SG_ 2566852813 Temperature_Histogram_18 "Battery system temperature histogram (seconds) of the battery pack.";
CM_ SG_ 2566852813 Temperature_Histogram_19 "Battery system temperature histogram (seconds) of the battery pack.";
CM_ SG_ 2566852813 Temperature_Histogram_20 "Battery system temperature histogram (seconds) of the battery pack.";
CM_ SG_ 2566852813 Temperature_Histogram_21 "Battery system temperature histogram (seconds) of the battery pack.";
CM_ SG_ 2566852813 Temperature_Histogram_22 "Battery system temperature histogram (seconds) of the battery pack.";
CM_ SG_ 2566852813 Temperature_Histogram_23 "Battery system temperature histogram (seconds) of the battery pack.";
CM_ SG_ 2566852813 Time_Spent_in_Extreme_Temperatur0 "Time spent in extreme temperatures above boundary (seconds) of the battery pack.";
CM_ SG_ 2566852813 Time_Spent_in_Extreme_Temperatur1 "Time spent in extreme temperatures below boundary (seconds) of the battery pack.";
CM_ SG_ 2566852813 Number_of_Deep_Discharge_Events "Number of deep discharge events of the battery pack.";
CM_ SG_ 2566852813 Time_Spent_Charging_In_Extreme_T "Time spent charging in extreme temperatures (seconds) of the battery pack.";
CM_ SG_ 2566852813 State_of_Charge "Battery system state of charge";
CM_ SG_ 2566852813 State_of_Charge_Histogram_0 "Battery system state of charge histogram (seconds) of the battery pack.";
CM_ SG_ 2566852813 State_of_Charge_Histogram_1 "Battery system state of charge histogram (seconds) of the battery pack.";
CM_ SG_ 2566852813 State_of_Charge_Histogram_2 "Battery system state of charge histogram (seconds) of the battery pack.";
CM_ SG_ 2566852813 State_of_Charge_Histogram_3 "Battery system state of charge histogram (seconds) of the battery pack.";
CM_ SG_ 2566852813 State_of_Charge_Histogram_4 "Battery system state of charge histogram (seconds) of the battery pack.";
CM_ SG_ 2566852813 State_of_Charge_Histogram_5 "Battery system state of charge histogram (seconds) of the battery pack.";
CM_ SG_ 2566852813 State_of_Charge_Histogram_6 "Battery system state of charge histogram (seconds) of the battery pack.";
CM_ SG_ 2566852813 State_of_Charge_Histogram_7 "Battery system state of charge histogram (seconds) of the battery pack.";
CM_ SG_ 2566852813 State_of_Charge_Histogram_8 "Battery system state of charge histogram (seconds) of the battery pack.";
CM_ SG_ 2566852813 State_of_Charge_Histogram_9 "Battery system state of charge histogram (seconds) of the battery pack.";
CM_ SG_ 2566852813 State_of_Charge_Histogram_10 "Battery system state of charge histogram (seconds) of the battery pack.";
CM_ SG_ 2566852813 State_of_Charge_Histogram_11 "Battery system state of charge histogram (seconds) of the battery pack.";
CM_ SG_ 2566852813 State_of_Charge_Histogram_12 "Battery system state of charge histogram (seconds) of the battery pack.";
CM_ SG_ 2566852813 State_of_Charge_Histogram_13 "Battery system state of charge histogram (seconds) of the battery pack.";
CM_ SG_ 2566852813 State_of_Charge_Histogram_14 "Battery system state of charge histogram (seconds) of the battery pack.";
CM_ SG_ 2566852813 State_of_Charge_Histogram_15 "Battery system state of charge histogram (seconds) of the battery pack.";
CM_ SG_ 2566852813 State_of_Charge_Histogram_16 "Battery system state of charge histogram (seconds) of the battery pack.";
CM_ SG_ 2566852813 State_of_Charge_Histogram_17 "Battery system state of charge histogram (seconds) of the battery pack.";
CM_ SG_ 2566852813 State_of_Charge_Histogram_18 "Battery system state of charge histogram (seconds) of the battery pack.";
CM_ SG_ 2566852813 State_of_Charge_Histogram_19 "Battery system state of charge histogram (seconds) of the battery pack.";
CM_ SG_ 2566852814 Remaining_Capacity "Pack charge capacity";
CM_ SG_ 2566852814 Date_of_Manufacture_0 "Date of manufacture encoded as YYYY-MM";
CM_ SG_ 2566852814 Date_of_Manufacture_1 "Date of manufacture encoded as YYYY-MM";
CM_ SG_ 2566852814 Date_of_Manufacture_2 "Date of manufacture encoded as YYYY-MM";
CM_ SG_ 2566852814 Date_of_Manufacture_3 "Date of manufacture encoded as YYYY-MM";
CM_ SG_ 2566852814 Date_of_Manufacture_4 "Date of manufacture encoded as YYYY-MM";
CM_ SG_ 2566852814 Date_of_Manufacture_5 "Date of manufacture encoded as YYYY-MM";
CM_ SG_ 2566852814 Date_of_Manufacture_6 "Date of manufacture encoded as YYYY-MM";
CM_ SG_ 2566852814 Date_of_Putting_Into_Service_0 "Date of putting into service encoded as YYYY-MM";
CM_ SG_ 2566852814 Date_of_Putting_Into_Service_1 "Date of putting into service encoded as YYYY-MM";
CM_ SG_ 2566852814 Date_of_Putting_Into_Service_2 "Date of putting into service encoded as YYYY-MM";
CM_ SG_ 2566852814 Date_of_Putting_Into_Service_3 "Date of putting into service encoded as YYYY-MM";
CM_ SG_ 2566852814 Date_of_Putting_Into_Service_4 "Date of putting into service encoded as YYYY-MM";
CM_ SG_ 2566852814 Date_of_Putting_Into_Service_5 "Date of putting into service encoded as YYYY-MM";
CM_ SG_ 2566852814 Date_of_Putting_Into_Service_6 "Date of putting into service encoded as YYYY-MM";
CM_ SG_ 2566852814 Charge_Energy_Throughput "Battery system charge energy throughput";
CM_ SG_ 2566852814 Discharge_Energy_Throughput "Battery system discharge energy throughput";
CM_ SG_ 2566852814 Total_Energy_Throughput "Battery system total energy throughput";
CM_ SG_ 2566852814 Charged_Capacity_Throughput "Battery system charged capacity throughput";
CM_ SG_ 2566852814 Discharged_Capacity_Throughput "Battery system discharged capacity throughput";
CM_ SG_ 2566852814 Total_Capacity_Throughput "Battery system total capacity throughput";
CM_ SG_ 2566852814 Number_of_Full_Equivalent_Charge0 "Number of full equivalent charge cycles";
CM_ SG_ 2566852814 Number_of_Full_Equivalent_Discha "Number of full equivalent discharge cycles";
CM_ SG_ 2566852814 Number_of_Full_Equivalent_Charge1 "Number of full equivalent charge-discharge cycles";
CM_ SG_ 2566852814 Temperature_Histogram_0 "Battery system temperature histogram (seconds) of the battery pack.";
CM_ SG_ 2566852814 Temperature_Histogram_1 "Battery system temperature histogram (seconds) of the battery pack.";
CM_ SG_ 2566852814 Temperature_Histogram_2 "Battery system temperature histogram (seconds) of the battery pack.";
CM_ SG_ 2566852814 Temperature_Histogram_3 "Battery system temperature histogram (seconds) of the battery pack.";
CM_ SG_ 2566852814 Temperature_Histogram_4 "Battery system temperature histogram (seconds) of the battery pack.";
CM_ SG_ 2566852814 Temperature_Histogram_5 "Battery system temperature histogram (seconds) of the battery pack.";
CM_ SG_ 2566852814 Temperature_Histogram_6 "Battery system temperature histogram (seconds) of the battery pack.";
CM_ SG_ 2566852814 Temperature_Histogram_7 "Battery system temperature histogram (seconds) of the battery pack.";
CM_ SG_ 2566852814 Temperature_Histogram_8 "Battery system temperature histogram (seconds) of the battery pack.";
CM_ SG_ 2566852814 Temperature_Histogram_9 "Battery system temperature histogram (seconds) of the battery pack.";
CM_ SG_ 2566852814 Temperature_Histogram_10 "Battery system temperature histogram (seconds) of the battery pack.";
CM_ SG_ 2566852814 Temperature_Histogram_11 "Battery system temperature histogram (seconds) of the battery pack.";
CM_ SG_ 2566852814 Temperature_Histogram_12 "Battery system temperature histogram (seconds) of the battery pack.";
CM_ SG_ 2566852814 Temperature_Histogram_13 "Battery system temperature histogram (seconds) of the battery pack.";
CM_ SG_ 2566852814 Temperature_Histogram_14 "Battery system temperature histogram (seconds) of the battery pack.";
CM_ SG_ 2566852814 Temperature_Histogram_15 "Battery system temperature histogram (seconds) of the battery pack.";
CM_ SG_ 2566852814 Temperature_Histogram_16 "Battery system temperature histogram (seconds) of the battery pack.";
CM_ SG_ 2566852814 Temperature_Histogram_17 "Battery system temperature histogram (seconds) of the battery pack.";
CM_ SG_ 2566852814 Temperature_Histogram_18 "Battery system temperature histogram (seconds) of the battery pack.";
CM_ SG_ 2566852814 Temperature_Histogram_19 "Battery system temperature histogram (seconds) of the battery pack.";
CM_ SG_ 2566852814 Temperature_Histogram_20 "Battery system temperature histogram (seconds) of the battery pack.";
CM_ SG_ 2566852814 Temperature_Histogram_21 "Battery system temperature histogram (seconds) of the battery pack.";
CM_ SG_ 2566852814 Temperature_Histogram_22 "Battery system temperature histogram (seconds) of the battery pack.";
CM_ SG_ 2566852814 Temperature_Histogram_23 "Battery system temperature histogram (seconds) of the battery pack.";
CM_ SG_ 2566852814 Time_Spent_in_Extreme_Temperatur0 "Time spent in extreme temperatures above boundary (seconds) of the battery pack.";
CM_ SG_ 2566852814 Time_Spent_in_Extreme_Temperatur1 "Time spent in extreme temperatures below boundary (seconds) of the battery pack.";
CM_ SG_ 2566852814 Number_of_Deep_Discharge_Events "Number of deep discharge events of the battery pack.";
CM_ SG_ 2566852814 Time_Spent_Charging_In_Extreme_T "Time spent charging in extreme temperatures (seconds) of the battery pack.";
CM_ SG_ 2566852814 State_of_Charge "Battery system state of charge";
CM_ SG_ 2566852814 State_of_Charge_Histogram_0 "Battery system state of charge histogram (seconds) of the battery pack.";
CM_ SG_ 2566852814 State_of_Charge_Histogram_1 "Battery system state of charge histogram (seconds) of the battery pack.";
CM_ SG_ 2566852814 State_of_Charge_Histogram_2 "Battery system state of charge histogram (seconds) of the battery pack.";
CM_ SG_ 2566852814 State_of_Charge_Histogram_3 "Battery system state of charge histogram (seconds) of the battery pack.";
CM_ SG_ 2566852814 State_of_Charge_Histogram_4 "Battery system state of charge histogram (seconds) of the battery pack.";
CM_ SG_ 2566852814 State_of_Charge_Histogram_5 "Battery system state of charge histogram (seconds) of the battery pack.";
CM_ SG_ 2566852814 State_of_Charge_Histogram_6 "Battery system state of charge histogram (seconds) of the battery pack.";
CM_ SG_ 2566852814 State_of_Charge_Histogram_7 "Battery system state of charge histogram (seconds) of the battery pack.";
CM_ SG_ 2566852814 State_of_Charge_Histogram_8 "Battery system state of charge histogram (seconds) of the battery pack.";
CM_ SG_ 2566852814 State_of_Charge_Histogram_9 "Battery system state of charge histogram (seconds) of the battery pack.";
CM_ SG_ 2566852814 State_of_Charge_Histogram_10 "Battery system state of charge histogram (seconds) of the battery pack.";
CM_ SG_ 2566852814 State_of_Charge_Histogram_11 "Battery system state of charge histogram (seconds) of the battery pack.";
CM_ SG_ 2566852814 State_of_Charge_Histogram_12 "Battery system state of charge histogram (seconds) of the battery pack.";
CM_ SG_ 2566852814 State_of_Charge_Histogram_13 "Battery system state of charge histogram (seconds) of the battery pack.";
CM_ SG_ 2566852814 State_of_Charge_Histogram_14 "Battery system state of charge histogram (seconds) of the battery pack.";
CM_ SG_ 2566852814 State_of_Charge_Histogram_15 "Battery system state of charge histogram (seconds) of the battery pack.";
CM_ SG_ 2566852814 State_of_Charge_Histogram_16 "Battery system state of charge histogram (seconds) of the battery pack.";
CM_ SG_ 2566852814 State_of_Charge_Histogram_17 "Battery system state of charge histogram (seconds) of the battery pack.";
CM_ SG_ 2566852814 State_of_Charge_Histogram_18 "Battery system state of charge histogram (seconds) of the battery pack.";
CM_ SG_ 2566852814 State_of_Charge_Histogram_19 "Battery system state of charge histogram (seconds) of the battery pack.";
CM_ SG_ 2566852815 Remaining_Capacity "Pack charge capacity";
CM_ SG_ 2566852815 Date_of_Manufacture_0 "Date of manufacture encoded as YYYY-MM";
CM_ SG_ 2566852815 Date_of_Manufacture_1 "Date of manufacture encoded as YYYY-MM";
CM_ SG_ 2566852815 Date_of_Manufacture_2 "Date of manufacture encoded as YYYY-MM";
CM_ SG_ 2566852815 Date_of_Manufacture_3 "Date of manufacture encoded as YYYY-MM";
CM_ SG_ 2566852815 Date_of_Manufacture_4 "Date of manufacture encoded as YYYY-MM";
CM_ SG_ 2566852815 Date_of_Manufacture_5 "Date of manufacture encoded as YYYY-MM";
CM_ SG_ 2566852815 Date_of_Manufacture_6 "Date of manufacture encoded as YYYY-MM";
CM_ SG_ 2566852815 Date_of_Putting_Into_Service_0 "Date of putting into service encoded as YYYY-MM";
CM_ SG_ 2566852815 Date_of_Putting_Into_Service_1 "Date of putting into service encoded as YYYY-MM";
CM_ SG_ 2566852815 Date_of_Putting_Into_Service_2 "Date of putting into service encoded as YYYY-MM";
CM_ SG_ 2566852815 Date_of_Putting_Into_Service_3 "Date of putting into service encoded as YYYY-MM";
CM_ SG_ 2566852815 Date_of_Putting_Into_Service_4 "Date of putting into service encoded as YYYY-MM";
CM_ SG_ 2566852815 Date_of_Putting_Into_Service_5 "Date of putting into service encoded as YYYY-MM";
CM_ SG_ 2566852815 Date_of_Putting_Into_Service_6 "Date of putting into service encoded as YYYY-MM";
CM_ SG_ 2566852815 Charge_Energy_Throughput "Battery system charge energy throughput";
CM_ SG_ 2566852815 Discharge_Energy_Throughput "Battery system discharge energy throughput";
CM_ SG_ 2566852815 Total_Energy_Throughput "Battery system total energy throughput";
CM_ SG_ 2566852815 Charged_Capacity_Throughput "Battery system charged capacity throughput";
CM_ SG_ 2566852815 Discharged_Capacity_Throughput "Battery system discharged capacity throughput";
CM_ SG_ 2566852815 Total_Capacity_Throughput "Battery system total capacity throughput";
CM_ SG_ 2566852815 Number_of_Full_Equivalent_Charge0 "Number of full equivalent charge cycles";
CM_ SG_ 2566852815 Number_of_Full_Equivalent_Discha "Number of full equivalent discharge cycles";
CM_ SG_ 2566852815 Number_of_Full_Equivalent_Charge1 "Number of full equivalent charge-discharge cycles";
CM_ SG_ 2566852815 Temperature_Histogram_0 "Battery system temperature histogram (seconds) of the battery pack.";
CM_ SG_ 2566852815 Temperature_Histogram_1 "Battery system temperature histogram (seconds) of the battery pack.";
CM_ SG_ 2566852815 Temperature_Histogram_2 "Battery system temperature histogram (seconds) of the battery pack.";
CM_ SG_ 2566852815 Temperature_Histogram_3 "Battery system temperature histogram (seconds) of the battery pack.";
CM_ SG_ 2566852815 Temperature_Histogram_4 "Battery system temperature histogram (seconds) of the battery pack.";
CM_ SG_ 2566852815 Temperature_Histogram_5 "Battery system temperature histogram (seconds) of the battery pack.";
CM_ SG_ 2566852815 Temperature_Histogram_6 "Battery system temperature histogram (seconds) of the battery pack.";
CM_ SG_ 2566852815 Temperature_Histogram_7 "Battery system temperature histogram (seconds) of the battery pack.";
CM_ SG_ 2566852815 Temperature_Histogram_8 "Battery system temperature histogram (seconds) of the battery pack.";
CM_ SG_ 2566852815 Temperature_Histogram_9 "Battery system temperature histogram (seconds) of the battery pack.";
CM_ SG_ 2566852815 Temperature_Histogram_10 "Battery system temperature histogram (seconds) of the battery pack.";
CM_ SG_ 2566852815 Temperature_Histogram_11 "Battery system temperature histogram (seconds) of the battery pack.";
CM_ SG_ 2566852815 Temperature_Histogram_12 "Battery system temperature histogram (seconds) of the battery pack.";
CM_ SG_ 2566852815 Temperature_Histogram_13 "Battery system temperature histogram (seconds) of the battery pack.";
CM_ SG_ 2566852815 Temperature_Histogram_14 "Battery system temperature histogram (seconds) of the battery pack.";
CM_ SG_ 2566852815 Temperature_Histogram_15 "Battery system temperature histogram (seconds) of the battery pack.";
CM_ SG_ 2566852815 Temperature_Histogram_16 "Battery system temperature histogram (seconds) of the battery pack.";
CM_ SG_ 2566852815 Temperature_Histogram_17 "Battery system temperature histogram (seconds) of the battery pack.";
CM_ SG_ 2566852815 Temperature_Histogram_18 "Battery system temperature histogram (seconds) of the battery pack.";
CM_ SG_ 2566852815 Temperature_Histogram_19 "Battery system temperature histogram (seconds) of the battery pack.";
CM_ SG_ 2566852815 Temperature_Histogram_20 "Battery system temperature histogram (seconds) of the battery pack.";
CM_ SG_ 2566852815 Temperature_Histogram_21 "Battery system temperature histogram (seconds) of the battery pack.";
CM_ SG_ 2566852815 Temperature_Histogram_22 "Battery system temperature histogram (seconds) of the battery pack.";
CM_ SG_ 2566852815 Temperature_Histogram_23 "Battery system temperature histogram (seconds) of the battery pack.";
CM_ SG_ 2566852815 Time_Spent_in_Extreme_Temperatur0 "Time spent in extreme temperatures above boundary (seconds) of the battery pack.";
CM_ SG_ 2566852815 Time_Spent_in_Extreme_Temperatur1 "Time spent in extreme temperatures below boundary (seconds) of the battery pack.";
CM_ SG_ 2566852815 Number_of_Deep_Discharge_Events "Number of deep discharge events of the battery pack.";
CM_ SG_ 2566852815 Time_Spent_Charging_In_Extreme_T "Time spent charging in extreme temperatures (seconds) of the battery pack.";
CM_ SG_ 2566852815 State_of_Charge "Battery system state of charge";
CM_ SG_ 2566852815 State_of_Charge_Histogram_0 "Battery system state of charge histogram (seconds) of the battery pack.";
CM_ SG_ 2566852815 State_of_Charge_Histogram_1 "Battery system state of charge histogram (seconds) of the battery pack.";
CM_ SG_ 2566852815 State_of_Charge_Histogram_2 "Battery system state of charge histogram (seconds) of the battery pack.";
CM_ SG_ 2566852815 State_of_Charge_Histogram_3 "Battery system state of charge histogram (seconds) of the battery pack.";
CM_ SG_ 2566852815 State_of_Charge_Histogram_4 "Battery system state of charge histogram (seconds) of the battery pack.";
CM_ SG_ 2566852815 State_of_Charge_Histogram_5 "Battery system state of charge histogram (seconds) of the battery pack.";
CM_ SG_ 2566852815 State_of_Charge_Histogram_6 "Battery system state of charge histogram (seconds) of the battery pack.";
CM_ SG_ 2566852815 State_of_Charge_Histogram_7 "Battery system state of charge histogram (seconds) of the battery pack.";
CM_ SG_ 2566852815 State_of_Charge_Histogram_8 "Battery system state of charge histogram (seconds) of the battery pack.";
CM_ SG_ 2566852815 State_of_Charge_Histogram_9 "Battery system state of charge histogram (seconds) of the battery pack.";
CM_ SG_ 2566852815 State_of_Charge_Histogram_10 "Battery system state of charge histogram (seconds) of the battery pack.";
CM_ SG_ 2566852815 State_of_Charge_Histogram_11 "Battery system state of charge histogram (seconds) of the battery pack.";
CM_ SG_ 2566852815 State_of_Charge_Histogram_12 "Battery system state of charge histogram (seconds) of the battery pack.";
CM_ SG_ 2566852815 State_of_Charge_Histogram_13 "Battery system state of charge histogram (seconds) of the battery pack.";
CM_ SG_ 2566852815 State_of_Charge_Histogram_14 "Battery system state of charge histogram (seconds) of the battery pack.";
CM_ SG_ 2566852815 State_of_Charge_Histogram_15 "Battery system state of charge histogram (seconds) of the battery pack.";
CM_ SG_ 2566852815 State_of_Charge_Histogram_16 "Battery system state of charge histogram (seconds) of the battery pack.";
CM_ SG_ 2566852815 State_of_Charge_Histogram_17 "Battery system state of charge histogram (seconds) of the battery pack.";
CM_ SG_ 2566852815 State_of_Charge_Histogram_18 "Battery system state of charge histogram (seconds) of the battery pack.";
CM_ SG_ 2566852815 State_of_Charge_Histogram_19 "Battery system state of charge histogram (seconds) of the battery pack.";
CM_ SG_ 2566852816 Remaining_Capacity "Pack charge capacity";
CM_ SG_ 2566852816 Date_of_Manufacture_0 "Date of manufacture encoded as YYYY-MM";
CM_ SG_ 2566852816 Date_of_Manufacture_1 "Date of manufacture encoded as YYYY-MM";
CM_ SG_ 2566852816 Date_of_Manufacture_2 "Date of manufacture encoded as YYYY-MM";
CM_ SG_ 2566852816 Date_of_Manufacture_3 "Date of manufacture encoded as YYYY-MM";
CM_ SG_ 2566852816 Date_of_Manufacture_4 "Date of manufacture encoded as YYYY-MM";
CM_ SG_ 2566852816 Date_of_Manufacture_5 "Date of manufacture encoded as YYYY-MM";
CM_ SG_ 2566852816 Date_of_Manufacture_6 "Date of manufacture encoded as YYYY-MM";
CM_ SG_ 2566852816 Date_of_Putting_Into_Service_0 "Date of putting into service encoded as YYYY-MM";
CM_ SG_ 2566852816 Date_of_Putting_Into_Service_1 "Date of putting into service encoded as YYYY-MM";
CM_ SG_ 2566852816 Date_of_Putting_Into_Service_2 "Date of putting into service encoded as YYYY-MM";
CM_ SG_ 2566852816 Date_of_Putting_Into_Service_3 "Date of putting into service encoded as YYYY-MM";
CM_ SG_ 2566852816 Date_of_Putting_Into_Service_4 "Date of putting into service encoded as YYYY-MM";
CM_ SG_ 2566852816 Date_of_Putting_Into_Service_5 "Date of putting into service encoded as YYYY-MM";
CM_ SG_ 2566852816 Date_of_Putting_Into_Service_6 "Date of putting into service encoded as YYYY-MM";
CM_ SG_ 2566852816 Charge_Energy_Throughput "Battery system charge energy throughput";
CM_ SG_ 2566852816 Discharge_Energy_Throughput "Battery system discharge energy throughput";
CM_ SG_ 2566852816 Total_Energy_Throughput "Battery system total energy throughput";
CM_ SG_ 2566852816 Charged_Capacity_Throughput "Battery system charged capacity throughput";
CM_ SG_ 2566852816 Discharged_Capacity_Throughput "Battery system discharged capacity throughput";
CM_ SG_ 2566852816 Total_Capacity_Throughput "Battery system total capacity throughput";
CM_ SG_ 2566852816 Number_of_Full_Equivalent_Charge0 "Number of full equivalent charge cycles";
CM_ SG_ 2566852816 Number_of_Full_Equivalent_Discha "Number of full equivalent discharge cycles";
CM_ SG_ 2566852816 Number_of_Full_Equivalent_Charge1 "Number of full equivalent charge-discharge cycles";
CM_ SG_ 2566852816 Temperature_Histogram_0 "Battery system temperature histogram (seconds) of the battery pack.";
CM_ SG_ 2566852816 Temperature_Histogram_1 "Battery system temperature histogram (seconds) of the battery pack.";
CM_ SG_ 2566852816 Temperature_Histogram_2 "Battery system temperature histogram (seconds) of the battery pack.";
CM_ SG_ 2566852816 Temperature_Histogram_3 "Battery system temperature histogram (seconds) of the battery pack.";
CM_ SG_ 2566852816 Temperature_Histogram_4 "Battery system temperature histogram (seconds) of the battery pack.";
CM_ SG_ 2566852816 Temperature_Histogram_5 "Battery system temperature histogram (seconds) of the battery pack.";
CM_ SG_ 2566852816 Temperature_Histogram_6 "Battery system temperature histogram (seconds) of the battery pack.";
CM_ SG_ 2566852816 Temperature_Histogram_7 "Battery system temperature histogram (seconds) of the battery pack.";
CM_ SG_ 2566852816 Temperature_Histogram_8 "Battery system temperature histogram (seconds) of the battery pack.";
CM_ SG_ 2566852816 Temperature_Histogram_9 "Battery system temperature histogram (seconds) of the battery pack.";
CM_ SG_ 2566852816 Temperature_Histogram_10 "Battery system temperature histogram (seconds) of the battery pack.";
CM_ SG_ 2566852816 Temperature_Histogram_11 "Battery system temperature histogram (seconds) of the battery pack.";
CM_ SG_ 2566852816 Temperature_Histogram_12 "Battery system temperature histogram (seconds) of the battery pack.";
CM_ SG_ 2566852816 Temperature_Histogram_13 "Battery system temperature histogram (seconds) of the battery pack.";
CM_ SG_ 2566852816 Temperature_Histogram_14 "Battery system temperature histogram (seconds) of the battery pack.";
CM_ SG_ 2566852816 Temperature_Histogram_15 "Battery system temperature histogram (seconds) of the battery pack.";
CM_ SG_ 2566852816 Temperature_Histogram_16 "Battery system temperature histogram (seconds) of the battery pack.";
CM_ SG_ 2566852816 Temperature_Histogram_17 "Battery system temperature histogram (seconds) of the battery pack.";
CM_ SG_ 2566852816 Temperature_Histogram_18 "Battery system temperature histogram (seconds) of the battery pack.";
CM_ SG_ 2566852816 Temperature_Histogram_19 "Battery system temperature histogram (seconds) of the battery pack.";
CM_ SG_ 2566852816 Temperature_Histogram_20 "Battery system temperature histogram (seconds) of the battery pack.";
CM_ SG_ 2566852816 Temperature_Histogram_21 "Battery system temperature histogram (seconds) of the battery pack.";
CM_ SG_ 2566852816 Temperature_Histogram_22 "Battery system temperature histogram (seconds) of the battery pack.";
CM_ SG_ 2566852816 Temperature_Histogram_23 "Battery system temperature histogram (seconds) of the battery pack.";
CM_ SG_ 2566852816 Time_Spent_in_Extreme_Temperatur0 "Time spent in extreme temperatures above boundary (seconds) of the battery pack.";
CM_ SG_ 2566852816 Time_Spent_in_Extreme_Temperatur1 "Time spent in extreme temperatures below boundary (seconds) of the battery pack.";
CM_ SG_ 2566852816 Number_of_Deep_Discharge_Events "Number of deep discharge events of the battery pack.";
CM_ SG_ 2566852816 Time_Spent_Charging_In_Extreme_T "Time spent charging in extreme temperatures (seconds) of the battery pack.";
CM_ SG_ 2566852816 State_of_Charge "Battery system state of charge";
CM_ SG_ 2566852816 State_of_Charge_Histogram_0 "Battery system state of charge histogram (seconds) of the battery pack.";
CM_ SG_ 2566852816 State_of_Charge_Histogram_1 "Battery system state of charge histogram (seconds) of the battery pack.";
CM_ SG_ 2566852816 State_of_Charge_Histogram_2 "Battery system state of charge histogram (seconds) of the battery pack.";
CM_ SG_ 2566852816 State_of_Charge_Histogram_3 "Battery system state of charge histogram (seconds) of the battery pack.";
CM_ SG_ 2566852816 State_of_Charge_Histogram_4 "Battery system state of charge histogram (seconds) of the battery pack.";
CM_ SG_ 2566852816 State_of_Charge_Histogram_5 "Battery system state of charge histogram (seconds) of the battery pack.";
CM_ SG_ 2566852816 State_of_Charge_Histogram_6 "Battery system state of charge histogram (seconds) of the battery pack.";
CM_ SG_ 2566852816 State_of_Charge_Histogram_7 "Battery system state of charge histogram (seconds) of the battery pack.";
CM_ SG_ 2566852816 State_of_Charge_Histogram_8 "Battery system state of charge histogram (seconds) of the battery pack.";
CM_ SG_ 2566852816 State_of_Charge_Histogram_9 "Battery system state of charge histogram (seconds) of the battery pack.";
CM_ SG_ 2566852816 State_of_Charge_Histogram_10 "Battery system state of charge histogram (seconds) of the battery pack.";
CM_ SG_ 2566852816 State_of_Charge_Histogram_11 "Battery system state of charge histogram (seconds) of the battery pack.";
CM_ SG_ 2566852816 State_of_Charge_Histogram_12 "Battery system state of charge histogram (seconds) of the battery pack.";
CM_ SG_ 2566852816 State_of_Charge_Histogram_13 "Battery system state of charge histogram (seconds) of the battery pack.";
CM_ SG_ 2566852816 State_of_Charge_Histogram_14 "Battery system state of charge histogram (seconds) of the battery pack.";
CM_ SG_ 2566852816 State_of_Charge_Histogram_15 "Battery system state of charge histogram (seconds) of the battery pack.";
CM_ SG_ 2566852816 State_of_Charge_Histogram_16 "Battery system state of charge histogram (seconds) of the battery pack.";
CM_ SG_ 2566852816 State_of_Charge_Histogram_17 "Battery system state of charge histogram (seconds) of the battery pack.";
CM_ SG_ 2566852816 State_of_Charge_Histogram_18 "Battery system state of charge histogram (seconds) of the battery pack.";
CM_ SG_ 2566852816 State_of_Charge_Histogram_19 "Battery system state of charge histogram (seconds) of the battery pack.";
CM_ SG_ 2566852817 Remaining_Capacity "Pack charge capacity";
CM_ SG_ 2566852817 Date_of_Manufacture_0 "Date of manufacture encoded as YYYY-MM";
CM_ SG_ 2566852817 Date_of_Manufacture_1 "Date of manufacture encoded as YYYY-MM";
CM_ SG_ 2566852817 Date_of_Manufacture_2 "Date of manufacture encoded as YYYY-MM";
CM_ SG_ 2566852817 Date_of_Manufacture_3 "Date of manufacture encoded as YYYY-MM";
CM_ SG_ 2566852817 Date_of_Manufacture_4 "Date of manufacture encoded as YYYY-MM";
CM_ SG_ 2566852817 Date_of_Manufacture_5 "Date of manufacture encoded as YYYY-MM";
CM_ SG_ 2566852817 Date_of_Manufacture_6 "Date of manufacture encoded as YYYY-MM";
CM_ SG_ 2566852817 Date_of_Putting_Into_Service_0 "Date of putting into service encoded as YYYY-MM";
CM_ SG_ 2566852817 Date_of_Putting_Into_Service_1 "Date of putting into service encoded as YYYY-MM";
CM_ SG_ 2566852817 Date_of_Putting_Into_Service_2 "Date of putting into service encoded as YYYY-MM";
CM_ SG_ 2566852817 Date_of_Putting_Into_Service_3 "Date of putting into service encoded as YYYY-MM";
CM_ SG_ 2566852817 Date_of_Putting_Into_Service_4 "Date of putting into service encoded as YYYY-MM";
CM_ SG_ 2566852817 Date_of_Putting_Into_Service_5 "Date of putting into service encoded as YYYY-MM";
CM_ SG_ 2566852817 Date_of_Putting_Into_Service_6 "Date of putting into service encoded as YYYY-MM";
CM_ SG_ 2566852817 Charge_Energy_Throughput "Battery system charge energy throughput";
CM_ SG_ 2566852817 Discharge_Energy_Throughput "Battery system discharge energy throughput";
CM_ SG_ 2566852817 Total_Energy_Throughput "Battery system total energy throughput";
CM_ SG_ 2566852817 Charged_Capacity_Throughput "Battery system charged capacity throughput";
CM_ SG_ 2566852817 Discharged_Capacity_Throughput "Battery system discharged capacity throughput";
CM_ SG_ 2566852817 Total_Capacity_Throughput "Battery system total capacity throughput";
CM_ SG_ 2566852817 Number_of_Full_Equivalent_Charge0 "Number of full equivalent charge cycles";
CM_ SG_ 2566852817 Number_of_Full_Equivalent_Discha "Number of full equivalent discharge cycles";
CM_ SG_ 2566852817 Number_of_Full_Equivalent_Charge1 "Number of full equivalent charge-discharge cycles";
CM_ SG_ 2566852817 Temperature_Histogram_0 "Battery system temperature histogram (seconds) of the battery pack.";
CM_ SG_ 2566852817 Temperature_Histogram_1 "Battery system temperature histogram (seconds) of the battery pack.";
CM_ SG_ 2566852817 Temperature_Histogram_2 "Battery system temperature histogram (seconds) of the battery pack.";
CM_ SG_ 2566852817 Temperature_Histogram_3 "Battery system temperature histogram (seconds) of the battery pack.";
CM_ SG_ 2566852817 Temperature_Histogram_4 "Battery system temperature histogram (seconds) of the battery pack.";
CM_ SG_ 2566852817 Temperature_Histogram_5 "Battery system temperature histogram (seconds) of the battery pack.";
CM_ SG_ 2566852817 Temperature_Histogram_6 "Battery system temperature histogram (seconds) of the battery pack.";
CM_ SG_ 2566852817 Temperature_Histogram_7 "Battery system temperature histogram (seconds) of the battery pack.";
CM_ SG_ 2566852817 Temperature_Histogram_8 "Battery system temperature histogram (seconds) of the battery pack.";
CM_ SG_ 2566852817 Temperature_Histogram_9 "Battery system temperature histogram (seconds) of the battery pack.";
CM_ SG_ 2566852817 Temperature_Histogram_10 "Battery system temperature histogram (seconds) of the battery pack.";
CM_ SG_ 2566852817 Temperature_Histogram_11 "Battery system temperature histogram (seconds) of the battery pack.";
CM_ SG_ 2566852817 Temperature_Histogram_12 "Battery system temperature histogram (seconds) of the battery pack.";
CM_ SG_ 2566852817 Temperature_Histogram_13 "Battery system temperature histogram (seconds) of the battery pack.";
CM_ SG_ 2566852817 Temperature_Histogram_14 "Battery system temperature histogram (seconds) of the battery pack.";
CM_ SG_ 2566852817 Temperature_Histogram_15 "Battery system temperature histogram (seconds) of the battery pack.";
CM_ SG_ 2566852817 Temperature_Histogram_16 "Battery system temperature histogram (seconds) of the battery pack.";
CM_ SG_ 2566852817 Temperature_Histogram_17 "Battery system temperature histogram (seconds) of the battery pack.";
CM_ SG_ 2566852817 Temperature_Histogram_18 "Battery system temperature histogram (seconds) of the battery pack.";
CM_ SG_ 2566852817 Temperature_Histogram_19 "Battery system temperature histogram (seconds) of the battery pack.";
CM_ SG_ 2566852817 Temperature_Histogram_20 "Battery system temperature histogram (seconds) of the battery pack.";
CM_ SG_ 2566852817 Temperature_Histogram_21 "Battery system temperature histogram (seconds) of the battery pack.";
CM_ SG_ 2566852817 Temperature_Histogram_22 "Battery system temperature histogram (seconds) of the battery pack.";
CM_ SG_ 2566852817 Temperature_Histogram_23 "Battery system temperature histogram (seconds) of the battery pack.";
CM_ SG_ 2566852817 Time_Spent_in_Extreme_Temperatur0 "Time spent in extreme temperatures above boundary (seconds) of the battery pack.";
CM_ SG_ 2566852817 Time_Spent_in_Extreme_Temperatur1 "Time spent in extreme temperatures below boundary (seconds) of the battery pack.";
CM_ SG_ 2566852817 Number_of_Deep_Discharge_Events "Number of deep discharge events of the battery pack.";
CM_ SG_ 2566852817 Time_Spent_Charging_In_Extreme_T "Time spent charging in extreme temperatures (seconds) of the battery pack.";
CM_ SG_ 2566852817 State_of_Charge "Battery system state of charge";
CM_ SG_ 2566852817 State_of_Charge_Histogram_0 "Battery system state of charge histogram (seconds) of the battery pack.";
CM_ SG_ 2566852817 State_of_Charge_Histogram_1 "Battery system state of charge histogram (seconds) of the battery pack.";
CM_ SG_ 2566852817 State_of_Charge_Histogram_2 "Battery system state of charge histogram (seconds) of the battery pack.";
CM_ SG_ 2566852817 State_of_Charge_Histogram_3 "Battery system state of charge histogram (seconds) of the battery pack.";
CM_ SG_ 2566852817 State_of_Charge_Histogram_4 "Battery system state of charge histogram (seconds) of the battery pack.";
CM_ SG_ 2566852817 State_of_Charge_Histogram_5 "Battery system state of charge histogram (seconds) of the battery pack.";
CM_ SG_ 2566852817 State_of_Charge_Histogram_6 "Battery system state of charge histogram (seconds) of the battery pack.";
CM_ SG_ 2566852817 State_of_Charge_Histogram_7 "Battery system state of charge histogram (seconds) of the battery pack.";
CM_ SG_ 2566852817 State_of_Charge_Histogram_8 "Battery system state of charge histogram (seconds) of the battery pack.";
CM_ SG_ 2566852817 State_of_Charge_Histogram_9 "Battery system state of charge histogram (seconds) of the battery pack.";
CM_ SG_ 2566852817 State_of_Charge_Histogram_10 "Battery system state of charge histogram (seconds) of the battery pack.";
CM_ SG_ 2566852817 State_of_Charge_Histogram_11 "Battery system state of charge histogram (seconds) of the battery pack.";
CM_ SG_ 2566852817 State_of_Charge_Histogram_12 "Battery system state of charge histogram (seconds) of the battery pack.";
CM_ SG_ 2566852817 State_of_Charge_Histogram_13 "Battery system state of charge histogram (seconds) of the battery pack.";
CM_ SG_ 2566852817 State_of_Charge_Histogram_14 "Battery system state of charge histogram (seconds) of the battery pack.";
CM_ SG_ 2566852817 State_of_Charge_Histogram_15 "Battery system state of charge histogram (seconds) of the battery pack.";
CM_ SG_ 2566852817 State_of_Charge_Histogram_16 "Battery system state of charge histogram (seconds) of the battery pack.";
CM_ SG_ 2566852817 State_of_Charge_Histogram_17 "Battery system state of charge histogram (seconds) of the battery pack.";
CM_ SG_ 2566852817 State_of_Charge_Histogram_18 "Battery system state of charge histogram (seconds) of the battery pack.";
CM_ SG_ 2566852817 State_of_Charge_Histogram_19 "Battery system state of charge histogram (seconds) of the battery pack.";
CM_ SG_ 2566852818 Remaining_Capacity "Pack charge capacity";
CM_ SG_ 2566852818 Date_of_Manufacture_0 "Date of manufacture encoded as YYYY-MM";
CM_ SG_ 2566852818 Date_of_Manufacture_1 "Date of manufacture encoded as YYYY-MM";
CM_ SG_ 2566852818 Date_of_Manufacture_2 "Date of manufacture encoded as YYYY-MM";
CM_ SG_ 2566852818 Date_of_Manufacture_3 "Date of manufacture encoded as YYYY-MM";
CM_ SG_ 2566852818 Date_of_Manufacture_4 "Date of manufacture encoded as YYYY-MM";
CM_ SG_ 2566852818 Date_of_Manufacture_5 "Date of manufacture encoded as YYYY-MM";
CM_ SG_ 2566852818 Date_of_Manufacture_6 "Date of manufacture encoded as YYYY-MM";
CM_ SG_ 2566852818 Date_of_Putting_Into_Service_0 "Date of putting into service encoded as YYYY-MM";
CM_ SG_ 2566852818 Date_of_Putting_Into_Service_1 "Date of putting into service encoded as YYYY-MM";
CM_ SG_ 2566852818 Date_of_Putting_Into_Service_2 "Date of putting into service encoded as YYYY-MM";
CM_ SG_ 2566852818 Date_of_Putting_Into_Service_3 "Date of putting into service encoded as YYYY-MM";
CM_ SG_ 2566852818 Date_of_Putting_Into_Service_4 "Date of putting into service encoded as YYYY-MM";
CM_ SG_ 2566852818 Date_of_Putting_Into_Service_5 "Date of putting into service encoded as YYYY-MM";
CM_ SG_ 2566852818 Date_of_Putting_Into_Service_6 "Date of putting into service encoded as YYYY-MM";
CM_ SG_ 2566852818 Charge_Energy_Throughput "Battery system charge energy throughput";
CM_ SG_ 2566852818 Discharge_Energy_Throughput "Battery system discharge energy throughput";
CM_ SG_ 2566852818 Total_Energy_Throughput "Battery system total energy throughput";
CM_ SG_ 2566852818 Charged_Capacity_Throughput "Battery system charged capacity throughput";
CM_ SG_ 2566852818 Discharged_Capacity_Throughput "Battery system discharged capacity throughput";
CM_ SG_ 2566852818 Total_Capacity_Throughput "Battery system total capacity throughput";
CM_ SG_ 2566852818 Number_of_Full_Equivalent_Charge0 "Number of full equivalent charge cycles";
CM_ SG_ 2566852818 Number_of_Full_Equivalent_Discha "Number of full equivalent discharge cycles";
CM_ SG_ 2566852818 Number_of_Full_Equivalent_Charge1 "Number of full equivalent charge-discharge cycles";
CM_ SG_ 2566852818 Temperature_Histogram_0 "Battery system temperature histogram (seconds) of the battery pack.";
CM_ SG_ 2566852818 Temperature_Histogram_1 "Battery system temperature histogram (seconds) of the battery pack.";
CM_ SG_ 2566852818 Temperature_Histogram_2 "Battery system temperature histogram (seconds) of the battery pack.";
CM_ SG_ 2566852818 Temperature_Histogram_3 "Battery system temperature histogram (seconds) of the battery pack.";
CM_ SG_ 2566852818 Temperature_Histogram_4 "Battery system temperature histogram (seconds) of the battery pack.";
CM_ SG_ 2566852818 Temperature_Histogram_5 "Battery system temperature histogram (seconds) of the battery pack.";
CM_ SG_ 2566852818 Temperature_Histogram_6 "Battery system temperature histogram (seconds) of the battery pack.";
CM_ SG_ 2566852818 Temperature_Histogram_7 "Battery system temperature histogram (seconds) of the battery pack.";
CM_ SG_ 2566852818 Temperature_Histogram_8 "Battery system temperature histogram (seconds) of the battery pack.";
CM_ SG_ 2566852818 Temperature_Histogram_9 "Battery system temperature histogram (seconds) of the battery pack.";
CM_ SG_ 2566852818 Temperature_Histogram_10 "Battery system temperature histogram (seconds) of the battery pack.";
CM_ SG_ 2566852818 Temperature_Histogram_11 "Battery system temperature histogram (seconds) of the battery pack.";
CM_ SG_ 2566852818 Temperature_Histogram_12 "Battery system temperature histogram (seconds) of the battery pack.";
CM_ SG_ 2566852818 Temperature_Histogram_13 "Battery system temperature histogram (seconds) of the battery pack.";
CM_ SG_ 2566852818 Temperature_Histogram_14 "Battery system temperature histogram (seconds) of the battery pack.";
CM_ SG_ 2566852818 Temperature_Histogram_15 "Battery system temperature histogram (seconds) of the battery pack.";
CM_ SG_ 2566852818 Temperature_Histogram_16 "Battery system temperature histogram (seconds) of the battery pack.";
CM_ SG_ 2566852818 Temperature_Histogram_17 "Battery system temperature histogram (seconds) of the battery pack.";
CM_ SG_ 2566852818 Temperature_Histogram_18 "Battery system temperature histogram (seconds) of the battery pack.";
CM_ SG_ 2566852818 Temperature_Histogram_19 "Battery system temperature histogram (seconds) of the battery pack.";
CM_ SG_ 2566852818 Temperature_Histogram_20 "Battery system temperature histogram (seconds) of the battery pack.";
CM_ SG_ 2566852818 Temperature_Histogram_21 "Battery system temperature histogram (seconds) of the battery pack.";
CM_ SG_ 2566852818 Temperature_Histogram_22 "Battery system temperature histogram (seconds) of the battery pack.";
CM_ SG_ 2566852818 Temperature_Histogram_23 "Battery system temperature histogram (seconds) of the battery pack.";
CM_ SG_ 2566852818 Time_Spent_in_Extreme_Temperatur0 "Time spent in extreme temperatures above boundary (seconds) of the battery pack.";
CM_ SG_ 2566852818 Time_Spent_in_Extreme_Temperatur1 "Time spent in extreme temperatures below boundary (seconds) of the battery pack.";
CM_ SG_ 2566852818 Number_of_Deep_Discharge_Events "Number of deep discharge events of the battery pack.";
CM_ SG_ 2566852818 Time_Spent_Charging_In_Extreme_T "Time spent charging in extreme temperatures (seconds) of the battery pack.";
CM_ SG_ 2566852818 State_of_Charge "Battery system state of charge";
CM_ SG_ 2566852818 State_of_Charge_Histogram_0 "Battery system state of charge histogram (seconds) of the battery pack.";
CM_ SG_ 2566852818 State_of_Charge_Histogram_1 "Battery system state of charge histogram (seconds) of the battery pack.";
CM_ SG_ 2566852818 State_of_Charge_Histogram_2 "Battery system state of charge histogram (seconds) of the battery pack.";
CM_ SG_ 2566852818 State_of_Charge_Histogram_3 "Battery system state of charge histogram (seconds) of the battery pack.";
CM_ SG_ 2566852818 State_of_Charge_Histogram_4 "Battery system state of charge histogram (seconds) of the battery pack.";
CM_ SG_ 2566852818 State_of_Charge_Histogram_5 "Battery system state of charge histogram (seconds) of the battery pack.";
CM_ SG_ 2566852818 State_of_Charge_Histogram_6 "Battery system state of charge histogram (seconds) of the battery pack.";
CM_ SG_ 2566852818 State_of_Charge_Histogram_7 "Battery system state of charge histogram (seconds) of the battery pack.";
CM_ SG_ 2566852818 State_of_Charge_Histogram_8 "Battery system state of charge histogram (seconds) of the battery pack.";
CM_ SG_ 2566852818 State_of_Charge_Histogram_9 "Battery system state of charge histogram (seconds) of the battery pack.";
CM_ SG_ 2566852818 State_of_Charge_Histogram_10 "Battery system state of charge histogram (seconds) of the battery pack.";
CM_ SG_ 2566852818 State_of_Charge_Histogram_11 "Battery system state of charge histogram (seconds) of the battery pack.";
CM_ SG_ 2566852818 State_of_Charge_Histogram_12 "Battery system state of charge histogram (seconds) of the battery pack.";
CM_ SG_ 2566852818 State_of_Charge_Histogram_13 "Battery system state of charge histogram (seconds) of the battery pack.";
CM_ SG_ 2566852818 State_of_Charge_Histogram_14 "Battery system state of charge histogram (seconds) of the battery pack.";
CM_ SG_ 2566852818 State_of_Charge_Histogram_15 "Battery system state of charge histogram (seconds) of the battery pack.";
CM_ SG_ 2566852818 State_of_Charge_Histogram_16 "Battery system state of charge histogram (seconds) of the battery pack.";
CM_ SG_ 2566852818 State_of_Charge_Histogram_17 "Battery system state of charge histogram (seconds) of the battery pack.";
CM_ SG_ 2566852818 State_of_Charge_Histogram_18 "Battery system state of charge histogram (seconds) of the battery pack.";
CM_ SG_ 2566852818 State_of_Charge_Histogram_19 "Battery system state of charge histogram (seconds) of the battery pack.";
CM_ SG_ 2566852819 Remaining_Capacity "Pack charge capacity";
CM_ SG_ 2566852819 Date_of_Manufacture_0 "Date of manufacture encoded as YYYY-MM";
CM_ SG_ 2566852819 Date_of_Manufacture_1 "Date of manufacture encoded as YYYY-MM";
CM_ SG_ 2566852819 Date_of_Manufacture_2 "Date of manufacture encoded as YYYY-MM";
CM_ SG_ 2566852819 Date_of_Manufacture_3 "Date of manufacture encoded as YYYY-MM";
CM_ SG_ 2566852819 Date_of_Manufacture_4 "Date of manufacture encoded as YYYY-MM";
CM_ SG_ 2566852819 Date_of_Manufacture_5 "Date of manufacture encoded as YYYY-MM";
CM_ SG_ 2566852819 Date_of_Manufacture_6 "Date of manufacture encoded as YYYY-MM";
CM_ SG_ 2566852819 Date_of_Putting_Into_Service_0 "Date of putting into service encoded as YYYY-MM";
CM_ SG_ 2566852819 Date_of_Putting_Into_Service_1 "Date of putting into service encoded as YYYY-MM";
CM_ SG_ 2566852819 Date_of_Putting_Into_Service_2 "Date of putting into service encoded as YYYY-MM";
CM_ SG_ 2566852819 Date_of_Putting_Into_Service_3 "Date of putting into service encoded as YYYY-MM";
CM_ SG_ 2566852819 Date_of_Putting_Into_Service_4 "Date of putting into service encoded as YYYY-MM";
CM_ SG_ 2566852819 Date_of_Putting_Into_Service_5 "Date of putting into service encoded as YYYY-MM";
CM_ SG_ 2566852819 Date_of_Putting_Into_Service_6 "Date of putting into service encoded as YYYY-MM";
CM_ SG_ 2566852819 Charge_Energy_Throughput "Battery system charge energy throughput";
CM_ SG_ 2566852819 Discharge_Energy_Throughput "Battery system discharge energy throughput";
CM_ SG_ 2566852819 Total_Energy_Throughput "Battery system total energy throughput";
CM_ SG_ 2566852819 Charged_Capacity_Throughput "Battery system charged capacity throughput";
CM_ SG_ 2566852819 Discharged_Capacity_Throughput "Battery system discharged capacity throughput";
CM_ SG_ 2566852819 Total_Capacity_Throughput "Battery system total capacity throughput";
CM_ SG_ 2566852819 Number_of_Full_Equivalent_Charge0 "Number of full equivalent charge cycles";
CM_ SG_ 2566852819 Number_of_Full_Equivalent_Discha "Number of full equivalent discharge cycles";
CM_ SG_ 2566852819 Number_of_Full_Equivalent_Charge1 "Number of full equivalent charge-discharge cycles";
CM_ SG_ 2566852819 Temperature_Histogram_0 "Battery system temperature histogram (seconds) of the battery pack.";
CM_ SG_ 2566852819 Temperature_Histogram_1 "Battery system temperature histogram (seconds) of the battery pack.";
CM_ SG_ 2566852819 Temperature_Histogram_2 "Battery system temperature histogram (seconds) of the battery pack.";
CM_ SG_ 2566852819 Temperature_Histogram_3 "Battery system temperature histogram (seconds) of the battery pack.";
CM_ SG_ 2566852819 Temperature_Histogram_4 "Battery system temperature histogram (seconds) of the battery pack.";
CM_ SG_ 2566852819 Temperature_Histogram_5 "Battery system temperature histogram (seconds) of the battery pack.";
CM_ SG_ 2566852819 Temperature_Histogram_6 "Battery system temperature histogram (seconds) of the battery pack.";
CM_ SG_ 2566852819 Temperature_Histogram_7 "Battery system temperature histogram (seconds) of the battery pack.";
CM_ SG_ 2566852819 Temperature_Histogram_8 "Battery system temperature histogram (seconds) of the battery pack.";
CM_ SG_ 2566852819 Temperature_Histogram_9 "Battery system temperature histogram (seconds) of the battery pack.";
CM_ SG_ 2566852819 Temperature_Histogram_10 "Battery system temperature histogram (seconds) of the battery pack.";
CM_ SG_ 2566852819 Temperature_Histogram_11 "Battery system temperature histogram (seconds) of the battery pack.";
CM_ SG_ 2566852819 Temperature_Histogram_12 "Battery system temperature histogram (seconds) of the battery pack.";
CM_ SG_ 2566852819 Temperature_Histogram_13 "Battery system temperature histogram (seconds) of the battery pack.";
CM_ SG_ 2566852819 Temperature_Histogram_14 "Battery system temperature histogram (seconds) of the battery pack.";
CM_ SG_ 2566852819 Temperature_Histogram_15 "Battery system temperature histogram (seconds) of the battery pack.";
CM_ SG_ 2566852819 Temperature_Histogram_16 "Battery system temperature histogram (seconds) of the battery pack.";
CM_ SG_ 2566852819 Temperature_Histogram_17 "Battery system temperature histogram (seconds) of the battery pack.";
CM_ SG_ 2566852819 Temperature_Histogram_18 "Battery system temperature histogram (seconds) of the battery pack.";
CM_ SG_ 2566852819 Temperature_Histogram_19 "Battery system temperature histogram (seconds) of the battery pack.";
CM_ SG_ 2566852819 Temperature_Histogram_20 "Battery system temperature histogram (seconds) of the battery pack.";
CM_ SG_ 2566852819 Temperature_Histogram_21 "Battery system temperature histogram (seconds) of the battery pack.";
CM_ SG_ 2566852819 Temperature_Histogram_22 "Battery system temperature histogram (seconds) of the battery pack.";
CM_ SG_ 2566852819 Temperature_Histogram_23 "Battery system temperature histogram (seconds) of the battery pack.";
CM_ SG_ 2566852819 Time_Spent_in_Extreme_Temperatur0 "Time spent in extreme temperatures above boundary (seconds) of the battery pack.";
CM_ SG_ 2566852819 Time_Spent_in_Extreme_Temperatur1 "Time spent in extreme temperatures below boundary (seconds) of the battery pack.";
CM_ SG_ 2566852819 Number_of_Deep_Discharge_Events "Number of deep discharge events of the battery pack.";
CM_ SG_ 2566852819 Time_Spent_Charging_In_Extreme_T "Time spent charging in extreme temperatures (seconds) of the battery pack.";
CM_ SG_ 2566852819 State_of_Charge "Battery system state of charge";
CM_ SG_ 2566852819 State_of_Charge_Histogram_0 "Battery system state of charge histogram (seconds) of the battery pack.";
CM_ SG_ 2566852819 State_of_Charge_Histogram_1 "Battery system state of charge histogram (seconds) of the battery pack.";
CM_ SG_ 2566852819 State_of_Charge_Histogram_2 "Battery system state of charge histogram (seconds) of the battery pack.";
CM_ SG_ 2566852819 State_of_Charge_Histogram_3 "Battery system state of charge histogram (seconds) of the battery pack.";
CM_ SG_ 2566852819 State_of_Charge_Histogram_4 "Battery system state of charge histogram (seconds) of the battery pack.";
CM_ SG_ 2566852819 State_of_Charge_Histogram_5 "Battery system state of charge histogram (seconds) of the battery pack.";
CM_ SG_ 2566852819 State_of_Charge_Histogram_6 "Battery system state of charge histogram (seconds) of the battery pack.";
CM_ SG_ 2566852819 State_of_Charge_Histogram_7 "Battery system state of charge histogram (seconds) of the battery pack.";
CM_ SG_ 2566852819 State_of_Charge_Histogram_8 "Battery system state of charge histogram (seconds) of the battery pack.";
CM_ SG_ 2566852819 State_of_Charge_Histogram_9 "Battery system state of charge histogram (seconds) of the battery pack.";
CM_ SG_ 2566852819 State_of_Charge_Histogram_10 "Battery system state of charge histogram (seconds) of the battery pack.";
CM_ SG_ 2566852819 State_of_Charge_Histogram_11 "Battery system state of charge histogram (seconds) of the battery pack.";
CM_ SG_ 2566852819 State_of_Charge_Histogram_12 "Battery system state of charge histogram (seconds) of the battery pack.";
CM_ SG_ 2566852819 State_of_Charge_Histogram_13 "Battery system state of charge histogram (seconds) of the battery pack.";
CM_ SG_ 2566852819 State_of_Charge_Histogram_14 "Battery system state of charge histogram (seconds) of the battery pack.";
CM_ SG_ 2566852819 State_of_Charge_Histogram_15 "Battery system state of charge histogram (seconds) of the battery pack.";
CM_ SG_ 2566852819 State_of_Charge_Histogram_16 "Battery system state of charge histogram (seconds) of the battery pack.";
CM_ SG_ 2566852819 State_of_Charge_Histogram_17 "Battery system state of charge histogram (seconds) of the battery pack.";
CM_ SG_ 2566852819 State_of_Charge_Histogram_18 "Battery system state of charge histogram (seconds) of the battery pack.";
CM_ SG_ 2566852819 State_of_Charge_Histogram_19 "Battery system state of charge histogram (seconds) of the battery pack.";

BA_DEF_ BO_ "GenMsgCycleTime" INT 0 65535;
BA_DEF_ BO_ "VFrameFormat" ENUM  "StandardCAN","ExtendedCAN","reserved","J1939PG";
BA_DEF_ SG_ "GenSigStartValue" FLOAT 0 100000000000;
BA_ "VFrameFormat" BO_ 2566852809 3;
BA_ "VFrameFormat" BO_ 2566852810 3;
BA_ "VFrameFormat" BO_ 2566852811 3;
BA_ "VFrameFormat" BO_ 2566852812 3;
BA_ "VFrameFormat" BO_ 2566852813 3;
BA_ "VFrameFormat" BO_ 2566852814 3;
BA_ "VFrameFormat" BO_ 2566852815 3;
BA_ "VFrameFormat" BO_ 2566852816 3;
BA_ "VFrameFormat" BO_ 2566852817 3;
BA_ "VFrameFormat" BO_ 2566852818 3;
BA_ "VFrameFormat" BO_ 2566852819 3;
