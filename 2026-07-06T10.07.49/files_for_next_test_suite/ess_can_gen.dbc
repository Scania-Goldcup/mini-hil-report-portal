VERSION "created by canmatrix"

NS_ :

BS_:

BU_: Pack01BMSLeader ExternalECU Pack02BMS Pack03BMS Pack04BMS Pack05BMS Pack06BMS Pack07BMS Pack08BMS Pack09BMS Pack10BMS Pack11BMS Pack12BMS Pack13BMS Pack14BMS Pack15BMS Pack16BMS

BO_ 2566852817 PropB_16_INTERPACK_Pack09BMS: 227 Pack09BMS
 SG_ Remaining_Capacity : 0|8@1+ (1,0) [0|255] "Ah" Vector__XXX
 SG_ Date_of_Manufacture_0 : 8|8@1+ (1,0) [0|255] "" Vector__XXX
 SG_ Date_of_Manufacture_1 : 16|8@1+ (1,0) [0|255] "" Vector__XXX
 SG_ Date_of_Manufacture_2 : 24|8@1+ (1,0) [0|255] "" Vector__XXX
 SG_ Date_of_Manufacture_3 : 32|8@1+ (1,0) [0|255] "" Vector__XXX
 SG_ Date_of_Manufacture_4 : 40|8@1+ (1,0) [0|255] "" Vector__XXX
 SG_ Date_of_Manufacture_5 : 48|8@1+ (1,0) [0|255] "" Vector__XXX
 SG_ Date_of_Manufacture_6 : 56|8@1+ (1,0) [0|255] "" Vector__XXX
 SG_ Date_of_Putting_Into_Service_0 : 64|8@1+ (1,0) [0|255] "" Vector__XXX
 SG_ Date_of_Putting_Into_Service_1 : 72|8@1+ (1,0) [0|255] "" Vector__XXX
 SG_ Date_of_Putting_Into_Service_2 : 80|8@1+ (1,0) [0|255] "" Vector__XXX
 SG_ Date_of_Putting_Into_Service_3 : 88|8@1+ (1,0) [0|255] "" Vector__XXX
 SG_ Date_of_Putting_Into_Service_4 : 96|8@1+ (1,0) [0|255] "" Vector__XXX
 SG_ Date_of_Putting_Into_Service_5 : 104|8@1+ (1,0) [0|255] "" Vector__XXX
 SG_ Date_of_Putting_Into_Service_6 : 112|8@1+ (1,0) [0|255] "" Vector__XXX
 SG_ Charge_Energy_Throughput : 120|24@1+ (1,0) [0|16777215] "kWh" Vector__XXX
 SG_ Discharge_Energy_Throughput : 144|24@1+ (1,0) [0|16777215] "kWh" Vector__XXX
 SG_ Total_Energy_Throughput : 168|24@1+ (1,0) [0|16777215] "kWh" Vector__XXX
 SG_ Charged_Capacity_Throughput : 192|24@1+ (1,0) [0|16777215] "Ah" Vector__XXX
 SG_ Discharged_Capacity_Throughput : 216|24@1+ (1,0) [0|16777215] "Ah" Vector__XXX
 SG_ Total_Capacity_Throughput : 240|24@1+ (1,0) [0|16777215] "Ah" Vector__XXX
 SG_ Number_of_Full_Equivalent_Charge0 : 264|16@1+ (1,0) [0|65535] "cycles" Vector__XXX
 SG_ Number_of_Full_Equivalent_Discha : 280|16@1+ (1,0) [0|65535] "cycles" Vector__XXX
 SG_ Number_of_Full_Equivalent_Charge1 : 296|16@1+ (1,0) [0|65535] "cycles" Vector__XXX
 SG_ Temperature_Histogram_0 : 312|32@1+ (1,0) [0|4294967295] "s" Vector__XXX
 SG_ Temperature_Histogram_1 : 344|32@1+ (1,0) [0|4294967295] "s" Vector__XXX
 SG_ Temperature_Histogram_2 : 376|32@1+ (1,0) [0|4294967295] "s" Vector__XXX
 SG_ Temperature_Histogram_3 : 408|32@1+ (1,0) [0|4294967295] "s" Vector__XXX
 SG_ Temperature_Histogram_4 : 440|32@1+ (1,0) [0|4294967295] "s" Vector__XXX
 SG_ Temperature_Histogram_5 : 472|32@1+ (1,0) [0|4294967295] "s" Vector__XXX
 SG_ Temperature_Histogram_6 : 504|32@1+ (1,0) [0|4294967295] "s" Vector__XXX
 SG_ Temperature_Histogram_7 : 536|32@1+ (1,0) [0|4294967295] "s" Vector__XXX
 SG_ Temperature_Histogram_8 : 568|32@1+ (1,0) [0|4294967295] "s" Vector__XXX
 SG_ Temperature_Histogram_9 : 600|32@1+ (1,0) [0|4294967295] "s" Vector__XXX
 SG_ Temperature_Histogram_10 : 632|32@1+ (1,0) [0|4294967295] "s" Vector__XXX
 SG_ Temperature_Histogram_11 : 664|32@1+ (1,0) [0|4294967295] "s" Vector__XXX
 SG_ Temperature_Histogram_12 : 696|32@1+ (1,0) [0|4294967295] "s" Vector__XXX
 SG_ Temperature_Histogram_13 : 728|32@1+ (1,0) [0|4294967295] "s" Vector__XXX
 SG_ Temperature_Histogram_14 : 760|32@1+ (1,0) [0|4294967295] "s" Vector__XXX
 SG_ Temperature_Histogram_15 : 792|32@1+ (1,0) [0|4294967295] "s" Vector__XXX
 SG_ Temperature_Histogram_16 : 824|32@1+ (1,0) [0|4294967295] "s" Vector__XXX
 SG_ Temperature_Histogram_17 : 856|32@1+ (1,0) [0|4294967295] "s" Vector__XXX
 SG_ Temperature_Histogram_18 : 888|32@1+ (1,0) [0|4294967295] "s" Vector__XXX
 SG_ Temperature_Histogram_19 : 920|32@1+ (1,0) [0|4294967295] "s" Vector__XXX
 SG_ Temperature_Histogram_20 : 952|32@1+ (1,0) [0|4294967295] "s" Vector__XXX
 SG_ Temperature_Histogram_21 : 984|32@1+ (1,0) [0|4294967295] "s" Vector__XXX
 SG_ Temperature_Histogram_22 : 1016|32@1+ (1,0) [0|4294967295] "s" Vector__XXX
 SG_ Temperature_Histogram_23 : 1048|32@1+ (1,0) [0|4294967295] "s" Vector__XXX
 SG_ Time_Spent_in_Extreme_Temperatur0 : 1080|32@1+ (1,0) [0|4294967295] "s" Vector__XXX
 SG_ Time_Spent_in_Extreme_Temperatur1 : 1112|32@1+ (1,0) [0|4294967295] "s" Vector__XXX
 SG_ Number_of_Deep_Discharge_Events : 1144|8@1+ (1,0) [0|255] "count" Vector__XXX
 SG_ Time_Spent_Charging_In_Extreme_T : 1152|8@1+ (1,0) [0|255] "s" Vector__XXX
 SG_ State_of_Charge : 1160|16@1+ (0.0015625,0) [0|102.3984375] "%" Vector__XXX
 SG_ State_of_Charge_Histogram_0 : 1176|32@1+ (1,0) [0|4294967295] "s" Vector__XXX
 SG_ State_of_Charge_Histogram_1 : 1208|32@1+ (1,0) [0|4294967295] "s" Vector__XXX
 SG_ State_of_Charge_Histogram_2 : 1240|32@1+ (1,0) [0|4294967295] "s" Vector__XXX
 SG_ State_of_Charge_Histogram_3 : 1272|32@1+ (1,0) [0|4294967295] "s" Vector__XXX
 SG_ State_of_Charge_Histogram_4 : 1304|32@1+ (1,0) [0|4294967295] "s" Vector__XXX
 SG_ State_of_Charge_Histogram_5 : 1336|32@1+ (1,0) [0|4294967295] "s" Vector__XXX
 SG_ State_of_Charge_Histogram_6 : 1368|32@1+ (1,0) [0|4294967295] "s" Vector__XXX
 SG_ State_of_Charge_Histogram_7 : 1400|32@1+ (1,0) [0|4294967295] "s" Vector__XXX
 SG_ State_of_Charge_Histogram_8 : 1432|32@1+ (1,0) [0|4294967295] "s" Vector__XXX
 SG_ State_of_Charge_Histogram_9 : 1464|32@1+ (1,0) [0|4294967295] "s" Vector__XXX
 SG_ State_of_Charge_Histogram_10 : 1496|32@1+ (1,0) [0|4294967295] "s" Vector__XXX
 SG_ State_of_Charge_Histogram_11 : 1528|32@1+ (1,0) [0|4294967295] "s" Vector__XXX
 SG_ State_of_Charge_Histogram_12 : 1560|32@1+ (1,0) [0|4294967295] "s" Vector__XXX
 SG_ State_of_Charge_Histogram_13 : 1592|32@1+ (1,0) [0|4294967295] "s" Vector__XXX
 SG_ State_of_Charge_Histogram_14 : 1624|32@1+ (1,0) [0|4294967295] "s" Vector__XXX
 SG_ State_of_Charge_Histogram_15 : 1656|32@1+ (1,0) [0|4294967295] "s" Vector__XXX
 SG_ State_of_Charge_Histogram_16 : 1688|32@1+ (1,0) [0|4294967295] "s" Vector__XXX
 SG_ State_of_Charge_Histogram_17 : 1720|32@1+ (1,0) [0|4294967295] "s" Vector__XXX
 SG_ State_of_Charge_Histogram_18 : 1752|32@1+ (1,0) [0|4294967295] "s" Vector__XXX
 SG_ State_of_Charge_Histogram_19 : 1784|32@1+ (1,0) [0|4294967295] "s" Vector__XXX

BO_ 2566852818 PropB_16_INTERPACK_Pack10BMS: 227 Pack10BMS
 SG_ Remaining_Capacity : 0|8@1+ (1,0) [0|255] "Ah" Vector__XXX
 SG_ Date_of_Manufacture_0 : 8|8@1+ (1,0) [0|255] "" Vector__XXX
 SG_ Date_of_Manufacture_1 : 16|8@1+ (1,0) [0|255] "" Vector__XXX
 SG_ Date_of_Manufacture_2 : 24|8@1+ (1,0) [0|255] "" Vector__XXX
 SG_ Date_of_Manufacture_3 : 32|8@1+ (1,0) [0|255] "" Vector__XXX
 SG_ Date_of_Manufacture_4 : 40|8@1+ (1,0) [0|255] "" Vector__XXX
 SG_ Date_of_Manufacture_5 : 48|8@1+ (1,0) [0|255] "" Vector__XXX
 SG_ Date_of_Manufacture_6 : 56|8@1+ (1,0) [0|255] "" Vector__XXX
 SG_ Date_of_Putting_Into_Service_0 : 64|8@1+ (1,0) [0|255] "" Vector__XXX
 SG_ Date_of_Putting_Into_Service_1 : 72|8@1+ (1,0) [0|255] "" Vector__XXX
 SG_ Date_of_Putting_Into_Service_2 : 80|8@1+ (1,0) [0|255] "" Vector__XXX
 SG_ Date_of_Putting_Into_Service_3 : 88|8@1+ (1,0) [0|255] "" Vector__XXX
 SG_ Date_of_Putting_Into_Service_4 : 96|8@1+ (1,0) [0|255] "" Vector__XXX
 SG_ Date_of_Putting_Into_Service_5 : 104|8@1+ (1,0) [0|255] "" Vector__XXX
 SG_ Date_of_Putting_Into_Service_6 : 112|8@1+ (1,0) [0|255] "" Vector__XXX
 SG_ Charge_Energy_Throughput : 120|24@1+ (1,0) [0|16777215] "kWh" Vector__XXX
 SG_ Discharge_Energy_Throughput : 144|24@1+ (1,0) [0|16777215] "kWh" Vector__XXX
 SG_ Total_Energy_Throughput : 168|24@1+ (1,0) [0|16777215] "kWh" Vector__XXX
 SG_ Charged_Capacity_Throughput : 192|24@1+ (1,0) [0|16777215] "Ah" Vector__XXX
 SG_ Discharged_Capacity_Throughput : 216|24@1+ (1,0) [0|16777215] "Ah" Vector__XXX
 SG_ Total_Capacity_Throughput : 240|24@1+ (1,0) [0|16777215] "Ah" Vector__XXX
 SG_ Number_of_Full_Equivalent_Charge0 : 264|16@1+ (1,0) [0|65535] "cycles" Vector__XXX
 SG_ Number_of_Full_Equivalent_Discha : 280|16@1+ (1,0) [0|65535] "cycles" Vector__XXX
 SG_ Number_of_Full_Equivalent_Charge1 : 296|16@1+ (1,0) [0|65535] "cycles" Vector__XXX
 SG_ Temperature_Histogram_0 : 312|32@1+ (1,0) [0|4294967295] "s" Vector__XXX
 SG_ Temperature_Histogram_1 : 344|32@1+ (1,0) [0|4294967295] "s" Vector__XXX
 SG_ Temperature_Histogram_2 : 376|32@1+ (1,0) [0|4294967295] "s" Vector__XXX
 SG_ Temperature_Histogram_3 : 408|32@1+ (1,0) [0|4294967295] "s" Vector__XXX
 SG_ Temperature_Histogram_4 : 440|32@1+ (1,0) [0|4294967295] "s" Vector__XXX
 SG_ Temperature_Histogram_5 : 472|32@1+ (1,0) [0|4294967295] "s" Vector__XXX
 SG_ Temperature_Histogram_6 : 504|32@1+ (1,0) [0|4294967295] "s" Vector__XXX
 SG_ Temperature_Histogram_7 : 536|32@1+ (1,0) [0|4294967295] "s" Vector__XXX
 SG_ Temperature_Histogram_8 : 568|32@1+ (1,0) [0|4294967295] "s" Vector__XXX
 SG_ Temperature_Histogram_9 : 600|32@1+ (1,0) [0|4294967295] "s" Vector__XXX
 SG_ Temperature_Histogram_10 : 632|32@1+ (1,0) [0|4294967295] "s" Vector__XXX
 SG_ Temperature_Histogram_11 : 664|32@1+ (1,0) [0|4294967295] "s" Vector__XXX
 SG_ Temperature_Histogram_12 : 696|32@1+ (1,0) [0|4294967295] "s" Vector__XXX
 SG_ Temperature_Histogram_13 : 728|32@1+ (1,0) [0|4294967295] "s" Vector__XXX
 SG_ Temperature_Histogram_14 : 760|32@1+ (1,0) [0|4294967295] "s" Vector__XXX
 SG_ Temperature_Histogram_15 : 792|32@1+ (1,0) [0|4294967295] "s" Vector__XXX
 SG_ Temperature_Histogram_16 : 824|32@1+ (1,0) [0|4294967295] "s" Vector__XXX
 SG_ Temperature_Histogram_17 : 856|32@1+ (1,0) [0|4294967295] "s" Vector__XXX
 SG_ Temperature_Histogram_18 : 888|32@1+ (1,0) [0|4294967295] "s" Vector__XXX
 SG_ Temperature_Histogram_19 : 920|32@1+ (1,0) [0|4294967295] "s" Vector__XXX
 SG_ Temperature_Histogram_20 : 952|32@1+ (1,0) [0|4294967295] "s" Vector__XXX
 SG_ Temperature_Histogram_21 : 984|32@1+ (1,0) [0|4294967295] "s" Vector__XXX
 SG_ Temperature_Histogram_22 : 1016|32@1+ (1,0) [0|4294967295] "s" Vector__XXX
 SG_ Temperature_Histogram_23 : 1048|32@1+ (1,0) [0|4294967295] "s" Vector__XXX
 SG_ Time_Spent_in_Extreme_Temperatur0 : 1080|32@1+ (1,0) [0|4294967295] "s" Vector__XXX
 SG_ Time_Spent_in_Extreme_Temperatur1 : 1112|32@1+ (1,0) [0|4294967295] "s" Vector__XXX
 SG_ Number_of_Deep_Discharge_Events : 1144|8@1+ (1,0) [0|255] "count" Vector__XXX
 SG_ Time_Spent_Charging_In_Extreme_T : 1152|8@1+ (1,0) [0|255] "s" Vector__XXX
 SG_ State_of_Charge : 1160|16@1+ (0.0015625,0) [0|102.3984375] "%" Vector__XXX
 SG_ State_of_Charge_Histogram_0 : 1176|32@1+ (1,0) [0|4294967295] "s" Vector__XXX
 SG_ State_of_Charge_Histogram_1 : 1208|32@1+ (1,0) [0|4294967295] "s" Vector__XXX
 SG_ State_of_Charge_Histogram_2 : 1240|32@1+ (1,0) [0|4294967295] "s" Vector__XXX
 SG_ State_of_Charge_Histogram_3 : 1272|32@1+ (1,0) [0|4294967295] "s" Vector__XXX
 SG_ State_of_Charge_Histogram_4 : 1304|32@1+ (1,0) [0|4294967295] "s" Vector__XXX
 SG_ State_of_Charge_Histogram_5 : 1336|32@1+ (1,0) [0|4294967295] "s" Vector__XXX
 SG_ State_of_Charge_Histogram_6 : 1368|32@1+ (1,0) [0|4294967295] "s" Vector__XXX
 SG_ State_of_Charge_Histogram_7 : 1400|32@1+ (1,0) [0|4294967295] "s" Vector__XXX
 SG_ State_of_Charge_Histogram_8 : 1432|32@1+ (1,0) [0|4294967295] "s" Vector__XXX
 SG_ State_of_Charge_Histogram_9 : 1464|32@1+ (1,0) [0|4294967295] "s" Vector__XXX
 SG_ State_of_Charge_Histogram_10 : 1496|32@1+ (1,0) [0|4294967295] "s" Vector__XXX
 SG_ State_of_Charge_Histogram_11 : 1528|32@1+ (1,0) [0|4294967295] "s" Vector__XXX
 SG_ State_of_Charge_Histogram_12 : 1560|32@1+ (1,0) [0|4294967295] "s" Vector__XXX
 SG_ State_of_Charge_Histogram_13 : 1592|32@1+ (1,0) [0|4294967295] "s" Vector__XXX
 SG_ State_of_Charge_Histogram_14 : 1624|32@1+ (1,0) [0|4294967295] "s" Vector__XXX
 SG_ State_of_Charge_Histogram_15 : 1656|32@1+ (1,0) [0|4294967295] "s" Vector__XXX
 SG_ State_of_Charge_Histogram_16 : 1688|32@1+ (1,0) [0|4294967295] "s" Vector__XXX
 SG_ State_of_Charge_Histogram_17 : 1720|32@1+ (1,0) [0|4294967295] "s" Vector__XXX
 SG_ State_of_Charge_Histogram_18 : 1752|32@1+ (1,0) [0|4294967295] "s" Vector__XXX
 SG_ State_of_Charge_Histogram_19 : 1784|32@1+ (1,0) [0|4294967295] "s" Vector__XXX

BO_ 2566852819 PropB_16_INTERPACK_Pack11BMS: 227 Pack11BMS
 SG_ Remaining_Capacity : 0|8@1+ (1,0) [0|255] "Ah" Vector__XXX
 SG_ Date_of_Manufacture_0 : 8|8@1+ (1,0) [0|255] "" Vector__XXX
 SG_ Date_of_Manufacture_1 : 16|8@1+ (1,0) [0|255] "" Vector__XXX
 SG_ Date_of_Manufacture_2 : 24|8@1+ (1,0) [0|255] "" Vector__XXX
 SG_ Date_of_Manufacture_3 : 32|8@1+ (1,0) [0|255] "" Vector__XXX
 SG_ Date_of_Manufacture_4 : 40|8@1+ (1,0) [0|255] "" Vector__XXX
 SG_ Date_of_Manufacture_5 : 48|8@1+ (1,0) [0|255] "" Vector__XXX
 SG_ Date_of_Manufacture_6 : 56|8@1+ (1,0) [0|255] "" Vector__XXX
 SG_ Date_of_Putting_Into_Service_0 : 64|8@1+ (1,0) [0|255] "" Vector__XXX
 SG_ Date_of_Putting_Into_Service_1 : 72|8@1+ (1,0) [0|255] "" Vector__XXX
 SG_ Date_of_Putting_Into_Service_2 : 80|8@1+ (1,0) [0|255] "" Vector__XXX
 SG_ Date_of_Putting_Into_Service_3 : 88|8@1+ (1,0) [0|255] "" Vector__XXX
 SG_ Date_of_Putting_Into_Service_4 : 96|8@1+ (1,0) [0|255] "" Vector__XXX
 SG_ Date_of_Putting_Into_Service_5 : 104|8@1+ (1,0) [0|255] "" Vector__XXX
 SG_ Date_of_Putting_Into_Service_6 : 112|8@1+ (1,0) [0|255] "" Vector__XXX
 SG_ Charge_Energy_Throughput : 120|24@1+ (1,0) [0|16777215] "kWh" Vector__XXX
 SG_ Discharge_Energy_Throughput : 144|24@1+ (1,0) [0|16777215] "kWh" Vector__XXX
 SG_ Total_Energy_Throughput : 168|24@1+ (1,0) [0|16777215] "kWh" Vector__XXX
 SG_ Charged_Capacity_Throughput : 192|24@1+ (1,0) [0|16777215] "Ah" Vector__XXX
 SG_ Discharged_Capacity_Throughput : 216|24@1+ (1,0) [0|16777215] "Ah" Vector__XXX
 SG_ Total_Capacity_Throughput : 240|24@1+ (1,0) [0|16777215] "Ah" Vector__XXX
 SG_ Number_of_Full_Equivalent_Charge0 : 264|16@1+ (1,0) [0|65535] "cycles" Vector__XXX
 SG_ Number_of_Full_Equivalent_Discha : 280|16@1+ (1,0) [0|65535] "cycles" Vector__XXX
 SG_ Number_of_Full_Equivalent_Charge1 : 296|16@1+ (1,0) [0|65535] "cycles" Vector__XXX
 SG_ Temperature_Histogram_0 : 312|32@1+ (1,0) [0|4294967295] "s" Vector__XXX
 SG_ Temperature_Histogram_1 : 344|32@1+ (1,0) [0|4294967295] "s" Vector__XXX
 SG_ Temperature_Histogram_2 : 376|32@1+ (1,0) [0|4294967295] "s" Vector__XXX
 SG_ Temperature_Histogram_3 : 408|32@1+ (1,0) [0|4294967295] "s" Vector__XXX
 SG_ Temperature_Histogram_4 : 440|32@1+ (1,0) [0|4294967295] "s" Vector__XXX
 SG_ Temperature_Histogram_5 : 472|32@1+ (1,0) [0|4294967295] "s" Vector__XXX
 SG_ Temperature_Histogram_6 : 504|32@1+ (1,0) [0|4294967295] "s" Vector__XXX
 SG_ Temperature_Histogram_7 : 536|32@1+ (1,0) [0|4294967295] "s" Vector__XXX
 SG_ Temperature_Histogram_8 : 568|32@1+ (1,0) [0|4294967295] "s" Vector__XXX
 SG_ Temperature_Histogram_9 : 600|32@1+ (1,0) [0|4294967295] "s" Vector__XXX
 SG_ Temperature_Histogram_10 : 632|32@1+ (1,0) [0|4294967295] "s" Vector__XXX
 SG_ Temperature_Histogram_11 : 664|32@1+ (1,0) [0|4294967295] "s" Vector__XXX
 SG_ Temperature_Histogram_12 : 696|32@1+ (1,0) [0|4294967295] "s" Vector__XXX
 SG_ Temperature_Histogram_13 : 728|32@1+ (1,0) [0|4294967295] "s" Vector__XXX
 SG_ Temperature_Histogram_14 : 760|32@1+ (1,0) [0|4294967295] "s" Vector__XXX
 SG_ Temperature_Histogram_15 : 792|32@1+ (1,0) [0|4294967295] "s" Vector__XXX
 SG_ Temperature_Histogram_16 : 824|32@1+ (1,0) [0|4294967295] "s" Vector__XXX
 SG_ Temperature_Histogram_17 : 856|32@1+ (1,0) [0|4294967295] "s" Vector__XXX
 SG_ Temperature_Histogram_18 : 888|32@1+ (1,0) [0|4294967295] "s" Vector__XXX
 SG_ Temperature_Histogram_19 : 920|32@1+ (1,0) [0|4294967295] "s" Vector__XXX
 SG_ Temperature_Histogram_20 : 952|32@1+ (1,0) [0|4294967295] "s" Vector__XXX
 SG_ Temperature_Histogram_21 : 984|32@1+ (1,0) [0|4294967295] "s" Vector__XXX
 SG_ Temperature_Histogram_22 : 1016|32@1+ (1,0) [0|4294967295] "s" Vector__XXX
 SG_ Temperature_Histogram_23 : 1048|32@1+ (1,0) [0|4294967295] "s" Vector__XXX
 SG_ Time_Spent_in_Extreme_Temperatur0 : 1080|32@1+ (1,0) [0|4294967295] "s" Vector__XXX
 SG_ Time_Spent_in_Extreme_Temperatur1 : 1112|32@1+ (1,0) [0|4294967295] "s" Vector__XXX
 SG_ Number_of_Deep_Discharge_Events : 1144|8@1+ (1,0) [0|255] "count" Vector__XXX
 SG_ Time_Spent_Charging_In_Extreme_T : 1152|8@1+ (1,0) [0|255] "s" Vector__XXX
 SG_ State_of_Charge : 1160|16@1+ (0.0015625,0) [0|102.3984375] "%" Vector__XXX
 SG_ State_of_Charge_Histogram_0 : 1176|32@1+ (1,0) [0|4294967295] "s" Vector__XXX
 SG_ State_of_Charge_Histogram_1 : 1208|32@1+ (1,0) [0|4294967295] "s" Vector__XXX
 SG_ State_of_Charge_Histogram_2 : 1240|32@1+ (1,0) [0|4294967295] "s" Vector__XXX
 SG_ State_of_Charge_Histogram_3 : 1272|32@1+ (1,0) [0|4294967295] "s" Vector__XXX
 SG_ State_of_Charge_Histogram_4 : 1304|32@1+ (1,0) [0|4294967295] "s" Vector__XXX
 SG_ State_of_Charge_Histogram_5 : 1336|32@1+ (1,0) [0|4294967295] "s" Vector__XXX
 SG_ State_of_Charge_Histogram_6 : 1368|32@1+ (1,0) [0|4294967295] "s" Vector__XXX
 SG_ State_of_Charge_Histogram_7 : 1400|32@1+ (1,0) [0|4294967295] "s" Vector__XXX
 SG_ State_of_Charge_Histogram_8 : 1432|32@1+ (1,0) [0|4294967295] "s" Vector__XXX
 SG_ State_of_Charge_Histogram_9 : 1464|32@1+ (1,0) [0|4294967295] "s" Vector__XXX
 SG_ State_of_Charge_Histogram_10 : 1496|32@1+ (1,0) [0|4294967295] "s" Vector__XXX
 SG_ State_of_Charge_Histogram_11 : 1528|32@1+ (1,0) [0|4294967295] "s" Vector__XXX
 SG_ State_of_Charge_Histogram_12 : 1560|32@1+ (1,0) [0|4294967295] "s" Vector__XXX
 SG_ State_of_Charge_Histogram_13 : 1592|32@1+ (1,0) [0|4294967295] "s" Vector__XXX
 SG_ State_of_Charge_Histogram_14 : 1624|32@1+ (1,0) [0|4294967295] "s" Vector__XXX
 SG_ State_of_Charge_Histogram_15 : 1656|32@1+ (1,0) [0|4294967295] "s" Vector__XXX
 SG_ State_of_Charge_Histogram_16 : 1688|32@1+ (1,0) [0|4294967295] "s" Vector__XXX
 SG_ State_of_Charge_Histogram_17 : 1720|32@1+ (1,0) [0|4294967295] "s" Vector__XXX
 SG_ State_of_Charge_Histogram_18 : 1752|32@1+ (1,0) [0|4294967295] "s" Vector__XXX
 SG_ State_of_Charge_Histogram_19 : 1784|32@1+ (1,0) [0|4294967295] "s" Vector__XXX

BO_ 2566852820 PropB_16_INTERPACK_Pack12BMS: 227 Pack12BMS
 SG_ Remaining_Capacity : 0|8@1+ (1,0) [0|255] "Ah" Vector__XXX
 SG_ Date_of_Manufacture_0 : 8|8@1+ (1,0) [0|255] "" Vector__XXX
 SG_ Date_of_Manufacture_1 : 16|8@1+ (1,0) [0|255] "" Vector__XXX
 SG_ Date_of_Manufacture_2 : 24|8@1+ (1,0) [0|255] "" Vector__XXX
 SG_ Date_of_Manufacture_3 : 32|8@1+ (1,0) [0|255] "" Vector__XXX
 SG_ Date_of_Manufacture_4 : 40|8@1+ (1,0) [0|255] "" Vector__XXX
 SG_ Date_of_Manufacture_5 : 48|8@1+ (1,0) [0|255] "" Vector__XXX
 SG_ Date_of_Manufacture_6 : 56|8@1+ (1,0) [0|255] "" Vector__XXX
 SG_ Date_of_Putting_Into_Service_0 : 64|8@1+ (1,0) [0|255] "" Vector__XXX
 SG_ Date_of_Putting_Into_Service_1 : 72|8@1+ (1,0) [0|255] "" Vector__XXX
 SG_ Date_of_Putting_Into_Service_2 : 80|8@1+ (1,0) [0|255] "" Vector__XXX
 SG_ Date_of_Putting_Into_Service_3 : 88|8@1+ (1,0) [0|255] "" Vector__XXX
 SG_ Date_of_Putting_Into_Service_4 : 96|8@1+ (1,0) [0|255] "" Vector__XXX
 SG_ Date_of_Putting_Into_Service_5 : 104|8@1+ (1,0) [0|255] "" Vector__XXX
 SG_ Date_of_Putting_Into_Service_6 : 112|8@1+ (1,0) [0|255] "" Vector__XXX
 SG_ Charge_Energy_Throughput : 120|24@1+ (1,0) [0|16777215] "kWh" Vector__XXX
 SG_ Discharge_Energy_Throughput : 144|24@1+ (1,0) [0|16777215] "kWh" Vector__XXX
 SG_ Total_Energy_Throughput : 168|24@1+ (1,0) [0|16777215] "kWh" Vector__XXX
 SG_ Charged_Capacity_Throughput : 192|24@1+ (1,0) [0|16777215] "Ah" Vector__XXX
 SG_ Discharged_Capacity_Throughput : 216|24@1+ (1,0) [0|16777215] "Ah" Vector__XXX
 SG_ Total_Capacity_Throughput : 240|24@1+ (1,0) [0|16777215] "Ah" Vector__XXX
 SG_ Number_of_Full_Equivalent_Charge0 : 264|16@1+ (1,0) [0|65535] "cycles" Vector__XXX
 SG_ Number_of_Full_Equivalent_Discha : 280|16@1+ (1,0) [0|65535] "cycles" Vector__XXX
 SG_ Number_of_Full_Equivalent_Charge1 : 296|16@1+ (1,0) [0|65535] "cycles" Vector__XXX
 SG_ Temperature_Histogram_0 : 312|32@1+ (1,0) [0|4294967295] "s" Vector__XXX
 SG_ Temperature_Histogram_1 : 344|32@1+ (1,0) [0|4294967295] "s" Vector__XXX
 SG_ Temperature_Histogram_2 : 376|32@1+ (1,0) [0|4294967295] "s" Vector__XXX
 SG_ Temperature_Histogram_3 : 408|32@1+ (1,0) [0|4294967295] "s" Vector__XXX
 SG_ Temperature_Histogram_4 : 440|32@1+ (1,0) [0|4294967295] "s" Vector__XXX
 SG_ Temperature_Histogram_5 : 472|32@1+ (1,0) [0|4294967295] "s" Vector__XXX
 SG_ Temperature_Histogram_6 : 504|32@1+ (1,0) [0|4294967295] "s" Vector__XXX
 SG_ Temperature_Histogram_7 : 536|32@1+ (1,0) [0|4294967295] "s" Vector__XXX
 SG_ Temperature_Histogram_8 : 568|32@1+ (1,0) [0|4294967295] "s" Vector__XXX
 SG_ Temperature_Histogram_9 : 600|32@1+ (1,0) [0|4294967295] "s" Vector__XXX
 SG_ Temperature_Histogram_10 : 632|32@1+ (1,0) [0|4294967295] "s" Vector__XXX
 SG_ Temperature_Histogram_11 : 664|32@1+ (1,0) [0|4294967295] "s" Vector__XXX
 SG_ Temperature_Histogram_12 : 696|32@1+ (1,0) [0|4294967295] "s" Vector__XXX
 SG_ Temperature_Histogram_13 : 728|32@1+ (1,0) [0|4294967295] "s" Vector__XXX
 SG_ Temperature_Histogram_14 : 760|32@1+ (1,0) [0|4294967295] "s" Vector__XXX
 SG_ Temperature_Histogram_15 : 792|32@1+ (1,0) [0|4294967295] "s" Vector__XXX
 SG_ Temperature_Histogram_16 : 824|32@1+ (1,0) [0|4294967295] "s" Vector__XXX
 SG_ Temperature_Histogram_17 : 856|32@1+ (1,0) [0|4294967295] "s" Vector__XXX
 SG_ Temperature_Histogram_18 : 888|32@1+ (1,0) [0|4294967295] "s" Vector__XXX
 SG_ Temperature_Histogram_19 : 920|32@1+ (1,0) [0|4294967295] "s" Vector__XXX
 SG_ Temperature_Histogram_20 : 952|32@1+ (1,0) [0|4294967295] "s" Vector__XXX
 SG_ Temperature_Histogram_21 : 984|32@1+ (1,0) [0|4294967295] "s" Vector__XXX
 SG_ Temperature_Histogram_22 : 1016|32@1+ (1,0) [0|4294967295] "s" Vector__XXX
 SG_ Temperature_Histogram_23 : 1048|32@1+ (1,0) [0|4294967295] "s" Vector__XXX
 SG_ Time_Spent_in_Extreme_Temperatur0 : 1080|32@1+ (1,0) [0|4294967295] "s" Vector__XXX
 SG_ Time_Spent_in_Extreme_Temperatur1 : 1112|32@1+ (1,0) [0|4294967295] "s" Vector__XXX
 SG_ Number_of_Deep_Discharge_Events : 1144|8@1+ (1,0) [0|255] "count" Vector__XXX
 SG_ Time_Spent_Charging_In_Extreme_T : 1152|8@1+ (1,0) [0|255] "s" Vector__XXX
 SG_ State_of_Charge : 1160|16@1+ (0.0015625,0) [0|102.3984375] "%" Vector__XXX
 SG_ State_of_Charge_Histogram_0 : 1176|32@1+ (1,0) [0|4294967295] "s" Vector__XXX
 SG_ State_of_Charge_Histogram_1 : 1208|32@1+ (1,0) [0|4294967295] "s" Vector__XXX
 SG_ State_of_Charge_Histogram_2 : 1240|32@1+ (1,0) [0|4294967295] "s" Vector__XXX
 SG_ State_of_Charge_Histogram_3 : 1272|32@1+ (1,0) [0|4294967295] "s" Vector__XXX
 SG_ State_of_Charge_Histogram_4 : 1304|32@1+ (1,0) [0|4294967295] "s" Vector__XXX
 SG_ State_of_Charge_Histogram_5 : 1336|32@1+ (1,0) [0|4294967295] "s" Vector__XXX
 SG_ State_of_Charge_Histogram_6 : 1368|32@1+ (1,0) [0|4294967295] "s" Vector__XXX
 SG_ State_of_Charge_Histogram_7 : 1400|32@1+ (1,0) [0|4294967295] "s" Vector__XXX
 SG_ State_of_Charge_Histogram_8 : 1432|32@1+ (1,0) [0|4294967295] "s" Vector__XXX
 SG_ State_of_Charge_Histogram_9 : 1464|32@1+ (1,0) [0|4294967295] "s" Vector__XXX
 SG_ State_of_Charge_Histogram_10 : 1496|32@1+ (1,0) [0|4294967295] "s" Vector__XXX
 SG_ State_of_Charge_Histogram_11 : 1528|32@1+ (1,0) [0|4294967295] "s" Vector__XXX
 SG_ State_of_Charge_Histogram_12 : 1560|32@1+ (1,0) [0|4294967295] "s" Vector__XXX
 SG_ State_of_Charge_Histogram_13 : 1592|32@1+ (1,0) [0|4294967295] "s" Vector__XXX
 SG_ State_of_Charge_Histogram_14 : 1624|32@1+ (1,0) [0|4294967295] "s" Vector__XXX
 SG_ State_of_Charge_Histogram_15 : 1656|32@1+ (1,0) [0|4294967295] "s" Vector__XXX
 SG_ State_of_Charge_Histogram_16 : 1688|32@1+ (1,0) [0|4294967295] "s" Vector__XXX
 SG_ State_of_Charge_Histogram_17 : 1720|32@1+ (1,0) [0|4294967295] "s" Vector__XXX
 SG_ State_of_Charge_Histogram_18 : 1752|32@1+ (1,0) [0|4294967295] "s" Vector__XXX
 SG_ State_of_Charge_Histogram_19 : 1784|32@1+ (1,0) [0|4294967295] "s" Vector__XXX

BO_ 2566852821 PropB_16_INTERPACK_Pack13BMS: 227 Pack13BMS
 SG_ Remaining_Capacity : 0|8@1+ (1,0) [0|255] "Ah" Vector__XXX
 SG_ Date_of_Manufacture_0 : 8|8@1+ (1,0) [0|255] "" Vector__XXX
 SG_ Date_of_Manufacture_1 : 16|8@1+ (1,0) [0|255] "" Vector__XXX
 SG_ Date_of_Manufacture_2 : 24|8@1+ (1,0) [0|255] "" Vector__XXX
 SG_ Date_of_Manufacture_3 : 32|8@1+ (1,0) [0|255] "" Vector__XXX
 SG_ Date_of_Manufacture_4 : 40|8@1+ (1,0) [0|255] "" Vector__XXX
 SG_ Date_of_Manufacture_5 : 48|8@1+ (1,0) [0|255] "" Vector__XXX
 SG_ Date_of_Manufacture_6 : 56|8@1+ (1,0) [0|255] "" Vector__XXX
 SG_ Date_of_Putting_Into_Service_0 : 64|8@1+ (1,0) [0|255] "" Vector__XXX
 SG_ Date_of_Putting_Into_Service_1 : 72|8@1+ (1,0) [0|255] "" Vector__XXX
 SG_ Date_of_Putting_Into_Service_2 : 80|8@1+ (1,0) [0|255] "" Vector__XXX
 SG_ Date_of_Putting_Into_Service_3 : 88|8@1+ (1,0) [0|255] "" Vector__XXX
 SG_ Date_of_Putting_Into_Service_4 : 96|8@1+ (1,0) [0|255] "" Vector__XXX
 SG_ Date_of_Putting_Into_Service_5 : 104|8@1+ (1,0) [0|255] "" Vector__XXX
 SG_ Date_of_Putting_Into_Service_6 : 112|8@1+ (1,0) [0|255] "" Vector__XXX
 SG_ Charge_Energy_Throughput : 120|24@1+ (1,0) [0|16777215] "kWh" Vector__XXX
 SG_ Discharge_Energy_Throughput : 144|24@1+ (1,0) [0|16777215] "kWh" Vector__XXX
 SG_ Total_Energy_Throughput : 168|24@1+ (1,0) [0|16777215] "kWh" Vector__XXX
 SG_ Charged_Capacity_Throughput : 192|24@1+ (1,0) [0|16777215] "Ah" Vector__XXX
 SG_ Discharged_Capacity_Throughput : 216|24@1+ (1,0) [0|16777215] "Ah" Vector__XXX
 SG_ Total_Capacity_Throughput : 240|24@1+ (1,0) [0|16777215] "Ah" Vector__XXX
 SG_ Number_of_Full_Equivalent_Charge0 : 264|16@1+ (1,0) [0|65535] "cycles" Vector__XXX
 SG_ Number_of_Full_Equivalent_Discha : 280|16@1+ (1,0) [0|65535] "cycles" Vector__XXX
 SG_ Number_of_Full_Equivalent_Charge1 : 296|16@1+ (1,0) [0|65535] "cycles" Vector__XXX
 SG_ Temperature_Histogram_0 : 312|32@1+ (1,0) [0|4294967295] "s" Vector__XXX
 SG_ Temperature_Histogram_1 : 344|32@1+ (1,0) [0|4294967295] "s" Vector__XXX
 SG_ Temperature_Histogram_2 : 376|32@1+ (1,0) [0|4294967295] "s" Vector__XXX
 SG_ Temperature_Histogram_3 : 408|32@1+ (1,0) [0|4294967295] "s" Vector__XXX
 SG_ Temperature_Histogram_4 : 440|32@1+ (1,0) [0|4294967295] "s" Vector__XXX
 SG_ Temperature_Histogram_5 : 472|32@1+ (1,0) [0|4294967295] "s" Vector__XXX
 SG_ Temperature_Histogram_6 : 504|32@1+ (1,0) [0|4294967295] "s" Vector__XXX
 SG_ Temperature_Histogram_7 : 536|32@1+ (1,0) [0|4294967295] "s" Vector__XXX
 SG_ Temperature_Histogram_8 : 568|32@1+ (1,0) [0|4294967295] "s" Vector__XXX
 SG_ Temperature_Histogram_9 : 600|32@1+ (1,0) [0|4294967295] "s" Vector__XXX
 SG_ Temperature_Histogram_10 : 632|32@1+ (1,0) [0|4294967295] "s" Vector__XXX
 SG_ Temperature_Histogram_11 : 664|32@1+ (1,0) [0|4294967295] "s" Vector__XXX
 SG_ Temperature_Histogram_12 : 696|32@1+ (1,0) [0|4294967295] "s" Vector__XXX
 SG_ Temperature_Histogram_13 : 728|32@1+ (1,0) [0|4294967295] "s" Vector__XXX
 SG_ Temperature_Histogram_14 : 760|32@1+ (1,0) [0|4294967295] "s" Vector__XXX
 SG_ Temperature_Histogram_15 : 792|32@1+ (1,0) [0|4294967295] "s" Vector__XXX
 SG_ Temperature_Histogram_16 : 824|32@1+ (1,0) [0|4294967295] "s" Vector__XXX
 SG_ Temperature_Histogram_17 : 856|32@1+ (1,0) [0|4294967295] "s" Vector__XXX
 SG_ Temperature_Histogram_18 : 888|32@1+ (1,0) [0|4294967295] "s" Vector__XXX
 SG_ Temperature_Histogram_19 : 920|32@1+ (1,0) [0|4294967295] "s" Vector__XXX
 SG_ Temperature_Histogram_20 : 952|32@1+ (1,0) [0|4294967295] "s" Vector__XXX
 SG_ Temperature_Histogram_21 : 984|32@1+ (1,0) [0|4294967295] "s" Vector__XXX
 SG_ Temperature_Histogram_22 : 1016|32@1+ (1,0) [0|4294967295] "s" Vector__XXX
 SG_ Temperature_Histogram_23 : 1048|32@1+ (1,0) [0|4294967295] "s" Vector__XXX
 SG_ Time_Spent_in_Extreme_Temperatur0 : 1080|32@1+ (1,0) [0|4294967295] "s" Vector__XXX
 SG_ Time_Spent_in_Extreme_Temperatur1 : 1112|32@1+ (1,0) [0|4294967295] "s" Vector__XXX
 SG_ Number_of_Deep_Discharge_Events : 1144|8@1+ (1,0) [0|255] "count" Vector__XXX
 SG_ Time_Spent_Charging_In_Extreme_T : 1152|8@1+ (1,0) [0|255] "s" Vector__XXX
 SG_ State_of_Charge : 1160|16@1+ (0.0015625,0) [0|102.3984375] "%" Vector__XXX
 SG_ State_of_Charge_Histogram_0 : 1176|32@1+ (1,0) [0|4294967295] "s" Vector__XXX
 SG_ State_of_Charge_Histogram_1 : 1208|32@1+ (1,0) [0|4294967295] "s" Vector__XXX
 SG_ State_of_Charge_Histogram_2 : 1240|32@1+ (1,0) [0|4294967295] "s" Vector__XXX
 SG_ State_of_Charge_Histogram_3 : 1272|32@1+ (1,0) [0|4294967295] "s" Vector__XXX
 SG_ State_of_Charge_Histogram_4 : 1304|32@1+ (1,0) [0|4294967295] "s" Vector__XXX
 SG_ State_of_Charge_Histogram_5 : 1336|32@1+ (1,0) [0|4294967295] "s" Vector__XXX
 SG_ State_of_Charge_Histogram_6 : 1368|32@1+ (1,0) [0|4294967295] "s" Vector__XXX
 SG_ State_of_Charge_Histogram_7 : 1400|32@1+ (1,0) [0|4294967295] "s" Vector__XXX
 SG_ State_of_Charge_Histogram_8 : 1432|32@1+ (1,0) [0|4294967295] "s" Vector__XXX
 SG_ State_of_Charge_Histogram_9 : 1464|32@1+ (1,0) [0|4294967295] "s" Vector__XXX
 SG_ State_of_Charge_Histogram_10 : 1496|32@1+ (1,0) [0|4294967295] "s" Vector__XXX
 SG_ State_of_Charge_Histogram_11 : 1528|32@1+ (1,0) [0|4294967295] "s" Vector__XXX
 SG_ State_of_Charge_Histogram_12 : 1560|32@1+ (1,0) [0|4294967295] "s" Vector__XXX
 SG_ State_of_Charge_Histogram_13 : 1592|32@1+ (1,0) [0|4294967295] "s" Vector__XXX
 SG_ State_of_Charge_Histogram_14 : 1624|32@1+ (1,0) [0|4294967295] "s" Vector__XXX
 SG_ State_of_Charge_Histogram_15 : 1656|32@1+ (1,0) [0|4294967295] "s" Vector__XXX
 SG_ State_of_Charge_Histogram_16 : 1688|32@1+ (1,0) [0|4294967295] "s" Vector__XXX
 SG_ State_of_Charge_Histogram_17 : 1720|32@1+ (1,0) [0|4294967295] "s" Vector__XXX
 SG_ State_of_Charge_Histogram_18 : 1752|32@1+ (1,0) [0|4294967295] "s" Vector__XXX
 SG_ State_of_Charge_Histogram_19 : 1784|32@1+ (1,0) [0|4294967295] "s" Vector__XXX

BO_ 2566852822 PropB_16_INTERPACK_Pack14BMS: 227 Pack14BMS
 SG_ Remaining_Capacity : 0|8@1+ (1,0) [0|255] "Ah" Vector__XXX
 SG_ Date_of_Manufacture_0 : 8|8@1+ (1,0) [0|255] "" Vector__XXX
 SG_ Date_of_Manufacture_1 : 16|8@1+ (1,0) [0|255] "" Vector__XXX
 SG_ Date_of_Manufacture_2 : 24|8@1+ (1,0) [0|255] "" Vector__XXX
 SG_ Date_of_Manufacture_3 : 32|8@1+ (1,0) [0|255] "" Vector__XXX
 SG_ Date_of_Manufacture_4 : 40|8@1+ (1,0) [0|255] "" Vector__XXX
 SG_ Date_of_Manufacture_5 : 48|8@1+ (1,0) [0|255] "" Vector__XXX
 SG_ Date_of_Manufacture_6 : 56|8@1+ (1,0) [0|255] "" Vector__XXX
 SG_ Date_of_Putting_Into_Service_0 : 64|8@1+ (1,0) [0|255] "" Vector__XXX
 SG_ Date_of_Putting_Into_Service_1 : 72|8@1+ (1,0) [0|255] "" Vector__XXX
 SG_ Date_of_Putting_Into_Service_2 : 80|8@1+ (1,0) [0|255] "" Vector__XXX
 SG_ Date_of_Putting_Into_Service_3 : 88|8@1+ (1,0) [0|255] "" Vector__XXX
 SG_ Date_of_Putting_Into_Service_4 : 96|8@1+ (1,0) [0|255] "" Vector__XXX
 SG_ Date_of_Putting_Into_Service_5 : 104|8@1+ (1,0) [0|255] "" Vector__XXX
 SG_ Date_of_Putting_Into_Service_6 : 112|8@1+ (1,0) [0|255] "" Vector__XXX
 SG_ Charge_Energy_Throughput : 120|24@1+ (1,0) [0|16777215] "kWh" Vector__XXX
 SG_ Discharge_Energy_Throughput : 144|24@1+ (1,0) [0|16777215] "kWh" Vector__XXX
 SG_ Total_Energy_Throughput : 168|24@1+ (1,0) [0|16777215] "kWh" Vector__XXX
 SG_ Charged_Capacity_Throughput : 192|24@1+ (1,0) [0|16777215] "Ah" Vector__XXX
 SG_ Discharged_Capacity_Throughput : 216|24@1+ (1,0) [0|16777215] "Ah" Vector__XXX
 SG_ Total_Capacity_Throughput : 240|24@1+ (1,0) [0|16777215] "Ah" Vector__XXX
 SG_ Number_of_Full_Equivalent_Charge0 : 264|16@1+ (1,0) [0|65535] "cycles" Vector__XXX
 SG_ Number_of_Full_Equivalent_Discha : 280|16@1+ (1,0) [0|65535] "cycles" Vector__XXX
 SG_ Number_of_Full_Equivalent_Charge1 : 296|16@1+ (1,0) [0|65535] "cycles" Vector__XXX
 SG_ Temperature_Histogram_0 : 312|32@1+ (1,0) [0|4294967295] "s" Vector__XXX
 SG_ Temperature_Histogram_1 : 344|32@1+ (1,0) [0|4294967295] "s" Vector__XXX
 SG_ Temperature_Histogram_2 : 376|32@1+ (1,0) [0|4294967295] "s" Vector__XXX
 SG_ Temperature_Histogram_3 : 408|32@1+ (1,0) [0|4294967295] "s" Vector__XXX
 SG_ Temperature_Histogram_4 : 440|32@1+ (1,0) [0|4294967295] "s" Vector__XXX
 SG_ Temperature_Histogram_5 : 472|32@1+ (1,0) [0|4294967295] "s" Vector__XXX
 SG_ Temperature_Histogram_6 : 504|32@1+ (1,0) [0|4294967295] "s" Vector__XXX
 SG_ Temperature_Histogram_7 : 536|32@1+ (1,0) [0|4294967295] "s" Vector__XXX
 SG_ Temperature_Histogram_8 : 568|32@1+ (1,0) [0|4294967295] "s" Vector__XXX
 SG_ Temperature_Histogram_9 : 600|32@1+ (1,0) [0|4294967295] "s" Vector__XXX
 SG_ Temperature_Histogram_10 : 632|32@1+ (1,0) [0|4294967295] "s" Vector__XXX
 SG_ Temperature_Histogram_11 : 664|32@1+ (1,0) [0|4294967295] "s" Vector__XXX
 SG_ Temperature_Histogram_12 : 696|32@1+ (1,0) [0|4294967295] "s" Vector__XXX
 SG_ Temperature_Histogram_13 : 728|32@1+ (1,0) [0|4294967295] "s" Vector__XXX
 SG_ Temperature_Histogram_14 : 760|32@1+ (1,0) [0|4294967295] "s" Vector__XXX
 SG_ Temperature_Histogram_15 : 792|32@1+ (1,0) [0|4294967295] "s" Vector__XXX
 SG_ Temperature_Histogram_16 : 824|32@1+ (1,0) [0|4294967295] "s" Vector__XXX
 SG_ Temperature_Histogram_17 : 856|32@1+ (1,0) [0|4294967295] "s" Vector__XXX
 SG_ Temperature_Histogram_18 : 888|32@1+ (1,0) [0|4294967295] "s" Vector__XXX
 SG_ Temperature_Histogram_19 : 920|32@1+ (1,0) [0|4294967295] "s" Vector__XXX
 SG_ Temperature_Histogram_20 : 952|32@1+ (1,0) [0|4294967295] "s" Vector__XXX
 SG_ Temperature_Histogram_21 : 984|32@1+ (1,0) [0|4294967295] "s" Vector__XXX
 SG_ Temperature_Histogram_22 : 1016|32@1+ (1,0) [0|4294967295] "s" Vector__XXX
 SG_ Temperature_Histogram_23 : 1048|32@1+ (1,0) [0|4294967295] "s" Vector__XXX
 SG_ Time_Spent_in_Extreme_Temperatur0 : 1080|32@1+ (1,0) [0|4294967295] "s" Vector__XXX
 SG_ Time_Spent_in_Extreme_Temperatur1 : 1112|32@1+ (1,0) [0|4294967295] "s" Vector__XXX
 SG_ Number_of_Deep_Discharge_Events : 1144|8@1+ (1,0) [0|255] "count" Vector__XXX
 SG_ Time_Spent_Charging_In_Extreme_T : 1152|8@1+ (1,0) [0|255] "s" Vector__XXX
 SG_ State_of_Charge : 1160|16@1+ (0.0015625,0) [0|102.3984375] "%" Vector__XXX
 SG_ State_of_Charge_Histogram_0 : 1176|32@1+ (1,0) [0|4294967295] "s" Vector__XXX
 SG_ State_of_Charge_Histogram_1 : 1208|32@1+ (1,0) [0|4294967295] "s" Vector__XXX
 SG_ State_of_Charge_Histogram_2 : 1240|32@1+ (1,0) [0|4294967295] "s" Vector__XXX
 SG_ State_of_Charge_Histogram_3 : 1272|32@1+ (1,0) [0|4294967295] "s" Vector__XXX
 SG_ State_of_Charge_Histogram_4 : 1304|32@1+ (1,0) [0|4294967295] "s" Vector__XXX
 SG_ State_of_Charge_Histogram_5 : 1336|32@1+ (1,0) [0|4294967295] "s" Vector__XXX
 SG_ State_of_Charge_Histogram_6 : 1368|32@1+ (1,0) [0|4294967295] "s" Vector__XXX
 SG_ State_of_Charge_Histogram_7 : 1400|32@1+ (1,0) [0|4294967295] "s" Vector__XXX
 SG_ State_of_Charge_Histogram_8 : 1432|32@1+ (1,0) [0|4294967295] "s" Vector__XXX
 SG_ State_of_Charge_Histogram_9 : 1464|32@1+ (1,0) [0|4294967295] "s" Vector__XXX
 SG_ State_of_Charge_Histogram_10 : 1496|32@1+ (1,0) [0|4294967295] "s" Vector__XXX
 SG_ State_of_Charge_Histogram_11 : 1528|32@1+ (1,0) [0|4294967295] "s" Vector__XXX
 SG_ State_of_Charge_Histogram_12 : 1560|32@1+ (1,0) [0|4294967295] "s" Vector__XXX
 SG_ State_of_Charge_Histogram_13 : 1592|32@1+ (1,0) [0|4294967295] "s" Vector__XXX
 SG_ State_of_Charge_Histogram_14 : 1624|32@1+ (1,0) [0|4294967295] "s" Vector__XXX
 SG_ State_of_Charge_Histogram_15 : 1656|32@1+ (1,0) [0|4294967295] "s" Vector__XXX
 SG_ State_of_Charge_Histogram_16 : 1688|32@1+ (1,0) [0|4294967295] "s" Vector__XXX
 SG_ State_of_Charge_Histogram_17 : 1720|32@1+ (1,0) [0|4294967295] "s" Vector__XXX
 SG_ State_of_Charge_Histogram_18 : 1752|32@1+ (1,0) [0|4294967295] "s" Vector__XXX
 SG_ State_of_Charge_Histogram_19 : 1784|32@1+ (1,0) [0|4294967295] "s" Vector__XXX

BO_ 2566852823 PropB_16_INTERPACK_Pack15BMS: 227 Pack15BMS
 SG_ Remaining_Capacity : 0|8@1+ (1,0) [0|255] "Ah" Vector__XXX
 SG_ Date_of_Manufacture_0 : 8|8@1+ (1,0) [0|255] "" Vector__XXX
 SG_ Date_of_Manufacture_1 : 16|8@1+ (1,0) [0|255] "" Vector__XXX
 SG_ Date_of_Manufacture_2 : 24|8@1+ (1,0) [0|255] "" Vector__XXX
 SG_ Date_of_Manufacture_3 : 32|8@1+ (1,0) [0|255] "" Vector__XXX
 SG_ Date_of_Manufacture_4 : 40|8@1+ (1,0) [0|255] "" Vector__XXX
 SG_ Date_of_Manufacture_5 : 48|8@1+ (1,0) [0|255] "" Vector__XXX
 SG_ Date_of_Manufacture_6 : 56|8@1+ (1,0) [0|255] "" Vector__XXX
 SG_ Date_of_Putting_Into_Service_0 : 64|8@1+ (1,0) [0|255] "" Vector__XXX
 SG_ Date_of_Putting_Into_Service_1 : 72|8@1+ (1,0) [0|255] "" Vector__XXX
 SG_ Date_of_Putting_Into_Service_2 : 80|8@1+ (1,0) [0|255] "" Vector__XXX
 SG_ Date_of_Putting_Into_Service_3 : 88|8@1+ (1,0) [0|255] "" Vector__XXX
 SG_ Date_of_Putting_Into_Service_4 : 96|8@1+ (1,0) [0|255] "" Vector__XXX
 SG_ Date_of_Putting_Into_Service_5 : 104|8@1+ (1,0) [0|255] "" Vector__XXX
 SG_ Date_of_Putting_Into_Service_6 : 112|8@1+ (1,0) [0|255] "" Vector__XXX
 SG_ Charge_Energy_Throughput : 120|24@1+ (1,0) [0|16777215] "kWh" Vector__XXX
 SG_ Discharge_Energy_Throughput : 144|24@1+ (1,0) [0|16777215] "kWh" Vector__XXX
 SG_ Total_Energy_Throughput : 168|24@1+ (1,0) [0|16777215] "kWh" Vector__XXX
 SG_ Charged_Capacity_Throughput : 192|24@1+ (1,0) [0|16777215] "Ah" Vector__XXX
 SG_ Discharged_Capacity_Throughput : 216|24@1+ (1,0) [0|16777215] "Ah" Vector__XXX
 SG_ Total_Capacity_Throughput : 240|24@1+ (1,0) [0|16777215] "Ah" Vector__XXX
 SG_ Number_of_Full_Equivalent_Charge0 : 264|16@1+ (1,0) [0|65535] "cycles" Vector__XXX
 SG_ Number_of_Full_Equivalent_Discha : 280|16@1+ (1,0) [0|65535] "cycles" Vector__XXX
 SG_ Number_of_Full_Equivalent_Charge1 : 296|16@1+ (1,0) [0|65535] "cycles" Vector__XXX
 SG_ Temperature_Histogram_0 : 312|32@1+ (1,0) [0|4294967295] "s" Vector__XXX
 SG_ Temperature_Histogram_1 : 344|32@1+ (1,0) [0|4294967295] "s" Vector__XXX
 SG_ Temperature_Histogram_2 : 376|32@1+ (1,0) [0|4294967295] "s" Vector__XXX
 SG_ Temperature_Histogram_3 : 408|32@1+ (1,0) [0|4294967295] "s" Vector__XXX
 SG_ Temperature_Histogram_4 : 440|32@1+ (1,0) [0|4294967295] "s" Vector__XXX
 SG_ Temperature_Histogram_5 : 472|32@1+ (1,0) [0|4294967295] "s" Vector__XXX
 SG_ Temperature_Histogram_6 : 504|32@1+ (1,0) [0|4294967295] "s" Vector__XXX
 SG_ Temperature_Histogram_7 : 536|32@1+ (1,0) [0|4294967295] "s" Vector__XXX
 SG_ Temperature_Histogram_8 : 568|32@1+ (1,0) [0|4294967295] "s" Vector__XXX
 SG_ Temperature_Histogram_9 : 600|32@1+ (1,0) [0|4294967295] "s" Vector__XXX
 SG_ Temperature_Histogram_10 : 632|32@1+ (1,0) [0|4294967295] "s" Vector__XXX
 SG_ Temperature_Histogram_11 : 664|32@1+ (1,0) [0|4294967295] "s" Vector__XXX
 SG_ Temperature_Histogram_12 : 696|32@1+ (1,0) [0|4294967295] "s" Vector__XXX
 SG_ Temperature_Histogram_13 : 728|32@1+ (1,0) [0|4294967295] "s" Vector__XXX
 SG_ Temperature_Histogram_14 : 760|32@1+ (1,0) [0|4294967295] "s" Vector__XXX
 SG_ Temperature_Histogram_15 : 792|32@1+ (1,0) [0|4294967295] "s" Vector__XXX
 SG_ Temperature_Histogram_16 : 824|32@1+ (1,0) [0|4294967295] "s" Vector__XXX
 SG_ Temperature_Histogram_17 : 856|32@1+ (1,0) [0|4294967295] "s" Vector__XXX
 SG_ Temperature_Histogram_18 : 888|32@1+ (1,0) [0|4294967295] "s" Vector__XXX
 SG_ Temperature_Histogram_19 : 920|32@1+ (1,0) [0|4294967295] "s" Vector__XXX
 SG_ Temperature_Histogram_20 : 952|32@1+ (1,0) [0|4294967295] "s" Vector__XXX
 SG_ Temperature_Histogram_21 : 984|32@1+ (1,0) [0|4294967295] "s" Vector__XXX
 SG_ Temperature_Histogram_22 : 1016|32@1+ (1,0) [0|4294967295] "s" Vector__XXX
 SG_ Temperature_Histogram_23 : 1048|32@1+ (1,0) [0|4294967295] "s" Vector__XXX
 SG_ Time_Spent_in_Extreme_Temperatur0 : 1080|32@1+ (1,0) [0|4294967295] "s" Vector__XXX
 SG_ Time_Spent_in_Extreme_Temperatur1 : 1112|32@1+ (1,0) [0|4294967295] "s" Vector__XXX
 SG_ Number_of_Deep_Discharge_Events : 1144|8@1+ (1,0) [0|255] "count" Vector__XXX
 SG_ Time_Spent_Charging_In_Extreme_T : 1152|8@1+ (1,0) [0|255] "s" Vector__XXX
 SG_ State_of_Charge : 1160|16@1+ (0.0015625,0) [0|102.3984375] "%" Vector__XXX
 SG_ State_of_Charge_Histogram_0 : 1176|32@1+ (1,0) [0|4294967295] "s" Vector__XXX
 SG_ State_of_Charge_Histogram_1 : 1208|32@1+ (1,0) [0|4294967295] "s" Vector__XXX
 SG_ State_of_Charge_Histogram_2 : 1240|32@1+ (1,0) [0|4294967295] "s" Vector__XXX
 SG_ State_of_Charge_Histogram_3 : 1272|32@1+ (1,0) [0|4294967295] "s" Vector__XXX
 SG_ State_of_Charge_Histogram_4 : 1304|32@1+ (1,0) [0|4294967295] "s" Vector__XXX
 SG_ State_of_Charge_Histogram_5 : 1336|32@1+ (1,0) [0|4294967295] "s" Vector__XXX
 SG_ State_of_Charge_Histogram_6 : 1368|32@1+ (1,0) [0|4294967295] "s" Vector__XXX
 SG_ State_of_Charge_Histogram_7 : 1400|32@1+ (1,0) [0|4294967295] "s" Vector__XXX
 SG_ State_of_Charge_Histogram_8 : 1432|32@1+ (1,0) [0|4294967295] "s" Vector__XXX
 SG_ State_of_Charge_Histogram_9 : 1464|32@1+ (1,0) [0|4294967295] "s" Vector__XXX
 SG_ State_of_Charge_Histogram_10 : 1496|32@1+ (1,0) [0|4294967295] "s" Vector__XXX
 SG_ State_of_Charge_Histogram_11 : 1528|32@1+ (1,0) [0|4294967295] "s" Vector__XXX
 SG_ State_of_Charge_Histogram_12 : 1560|32@1+ (1,0) [0|4294967295] "s" Vector__XXX
 SG_ State_of_Charge_Histogram_13 : 1592|32@1+ (1,0) [0|4294967295] "s" Vector__XXX
 SG_ State_of_Charge_Histogram_14 : 1624|32@1+ (1,0) [0|4294967295] "s" Vector__XXX
 SG_ State_of_Charge_Histogram_15 : 1656|32@1+ (1,0) [0|4294967295] "s" Vector__XXX
 SG_ State_of_Charge_Histogram_16 : 1688|32@1+ (1,0) [0|4294967295] "s" Vector__XXX
 SG_ State_of_Charge_Histogram_17 : 1720|32@1+ (1,0) [0|4294967295] "s" Vector__XXX
 SG_ State_of_Charge_Histogram_18 : 1752|32@1+ (1,0) [0|4294967295] "s" Vector__XXX
 SG_ State_of_Charge_Histogram_19 : 1784|32@1+ (1,0) [0|4294967295] "s" Vector__XXX

BO_ 2566852824 PropB_16_INTERPACK_Pack16BMS: 227 Pack16BMS
 SG_ Remaining_Capacity : 0|8@1+ (1,0) [0|255] "Ah" Vector__XXX
 SG_ Date_of_Manufacture_0 : 8|8@1+ (1,0) [0|255] "" Vector__XXX
 SG_ Date_of_Manufacture_1 : 16|8@1+ (1,0) [0|255] "" Vector__XXX
 SG_ Date_of_Manufacture_2 : 24|8@1+ (1,0) [0|255] "" Vector__XXX
 SG_ Date_of_Manufacture_3 : 32|8@1+ (1,0) [0|255] "" Vector__XXX
 SG_ Date_of_Manufacture_4 : 40|8@1+ (1,0) [0|255] "" Vector__XXX
 SG_ Date_of_Manufacture_5 : 48|8@1+ (1,0) [0|255] "" Vector__XXX
 SG_ Date_of_Manufacture_6 : 56|8@1+ (1,0) [0|255] "" Vector__XXX
 SG_ Date_of_Putting_Into_Service_0 : 64|8@1+ (1,0) [0|255] "" Vector__XXX
 SG_ Date_of_Putting_Into_Service_1 : 72|8@1+ (1,0) [0|255] "" Vector__XXX
 SG_ Date_of_Putting_Into_Service_2 : 80|8@1+ (1,0) [0|255] "" Vector__XXX
 SG_ Date_of_Putting_Into_Service_3 : 88|8@1+ (1,0) [0|255] "" Vector__XXX
 SG_ Date_of_Putting_Into_Service_4 : 96|8@1+ (1,0) [0|255] "" Vector__XXX
 SG_ Date_of_Putting_Into_Service_5 : 104|8@1+ (1,0) [0|255] "" Vector__XXX
 SG_ Date_of_Putting_Into_Service_6 : 112|8@1+ (1,0) [0|255] "" Vector__XXX
 SG_ Charge_Energy_Throughput : 120|24@1+ (1,0) [0|16777215] "kWh" Vector__XXX
 SG_ Discharge_Energy_Throughput : 144|24@1+ (1,0) [0|16777215] "kWh" Vector__XXX
 SG_ Total_Energy_Throughput : 168|24@1+ (1,0) [0|16777215] "kWh" Vector__XXX
 SG_ Charged_Capacity_Throughput : 192|24@1+ (1,0) [0|16777215] "Ah" Vector__XXX
 SG_ Discharged_Capacity_Throughput : 216|24@1+ (1,0) [0|16777215] "Ah" Vector__XXX
 SG_ Total_Capacity_Throughput : 240|24@1+ (1,0) [0|16777215] "Ah" Vector__XXX
 SG_ Number_of_Full_Equivalent_Charge0 : 264|16@1+ (1,0) [0|65535] "cycles" Vector__XXX
 SG_ Number_of_Full_Equivalent_Discha : 280|16@1+ (1,0) [0|65535] "cycles" Vector__XXX
 SG_ Number_of_Full_Equivalent_Charge1 : 296|16@1+ (1,0) [0|65535] "cycles" Vector__XXX
 SG_ Temperature_Histogram_0 : 312|32@1+ (1,0) [0|4294967295] "s" Vector__XXX
 SG_ Temperature_Histogram_1 : 344|32@1+ (1,0) [0|4294967295] "s" Vector__XXX
 SG_ Temperature_Histogram_2 : 376|32@1+ (1,0) [0|4294967295] "s" Vector__XXX
 SG_ Temperature_Histogram_3 : 408|32@1+ (1,0) [0|4294967295] "s" Vector__XXX
 SG_ Temperature_Histogram_4 : 440|32@1+ (1,0) [0|4294967295] "s" Vector__XXX
 SG_ Temperature_Histogram_5 : 472|32@1+ (1,0) [0|4294967295] "s" Vector__XXX
 SG_ Temperature_Histogram_6 : 504|32@1+ (1,0) [0|4294967295] "s" Vector__XXX
 SG_ Temperature_Histogram_7 : 536|32@1+ (1,0) [0|4294967295] "s" Vector__XXX
 SG_ Temperature_Histogram_8 : 568|32@1+ (1,0) [0|4294967295] "s" Vector__XXX
 SG_ Temperature_Histogram_9 : 600|32@1+ (1,0) [0|4294967295] "s" Vector__XXX
 SG_ Temperature_Histogram_10 : 632|32@1+ (1,0) [0|4294967295] "s" Vector__XXX
 SG_ Temperature_Histogram_11 : 664|32@1+ (1,0) [0|4294967295] "s" Vector__XXX
 SG_ Temperature_Histogram_12 : 696|32@1+ (1,0) [0|4294967295] "s" Vector__XXX
 SG_ Temperature_Histogram_13 : 728|32@1+ (1,0) [0|4294967295] "s" Vector__XXX
 SG_ Temperature_Histogram_14 : 760|32@1+ (1,0) [0|4294967295] "s" Vector__XXX
 SG_ Temperature_Histogram_15 : 792|32@1+ (1,0) [0|4294967295] "s" Vector__XXX
 SG_ Temperature_Histogram_16 : 824|32@1+ (1,0) [0|4294967295] "s" Vector__XXX
 SG_ Temperature_Histogram_17 : 856|32@1+ (1,0) [0|4294967295] "s" Vector__XXX
 SG_ Temperature_Histogram_18 : 888|32@1+ (1,0) [0|4294967295] "s" Vector__XXX
 SG_ Temperature_Histogram_19 : 920|32@1+ (1,0) [0|4294967295] "s" Vector__XXX
 SG_ Temperature_Histogram_20 : 952|32@1+ (1,0) [0|4294967295] "s" Vector__XXX
 SG_ Temperature_Histogram_21 : 984|32@1+ (1,0) [0|4294967295] "s" Vector__XXX
 SG_ Temperature_Histogram_22 : 1016|32@1+ (1,0) [0|4294967295] "s" Vector__XXX
 SG_ Temperature_Histogram_23 : 1048|32@1+ (1,0) [0|4294967295] "s" Vector__XXX
 SG_ Time_Spent_in_Extreme_Temperatur0 : 1080|32@1+ (1,0) [0|4294967295] "s" Vector__XXX
 SG_ Time_Spent_in_Extreme_Temperatur1 : 1112|32@1+ (1,0) [0|4294967295] "s" Vector__XXX
 SG_ Number_of_Deep_Discharge_Events : 1144|8@1+ (1,0) [0|255] "count" Vector__XXX
 SG_ Time_Spent_Charging_In_Extreme_T : 1152|8@1+ (1,0) [0|255] "s" Vector__XXX
 SG_ State_of_Charge : 1160|16@1+ (0.0015625,0) [0|102.3984375] "%" Vector__XXX
 SG_ State_of_Charge_Histogram_0 : 1176|32@1+ (1,0) [0|4294967295] "s" Vector__XXX
 SG_ State_of_Charge_Histogram_1 : 1208|32@1+ (1,0) [0|4294967295] "s" Vector__XXX
 SG_ State_of_Charge_Histogram_2 : 1240|32@1+ (1,0) [0|4294967295] "s" Vector__XXX
 SG_ State_of_Charge_Histogram_3 : 1272|32@1+ (1,0) [0|4294967295] "s" Vector__XXX
 SG_ State_of_Charge_Histogram_4 : 1304|32@1+ (1,0) [0|4294967295] "s" Vector__XXX
 SG_ State_of_Charge_Histogram_5 : 1336|32@1+ (1,0) [0|4294967295] "s" Vector__XXX
 SG_ State_of_Charge_Histogram_6 : 1368|32@1+ (1,0) [0|4294967295] "s" Vector__XXX
 SG_ State_of_Charge_Histogram_7 : 1400|32@1+ (1,0) [0|4294967295] "s" Vector__XXX
 SG_ State_of_Charge_Histogram_8 : 1432|32@1+ (1,0) [0|4294967295] "s" Vector__XXX
 SG_ State_of_Charge_Histogram_9 : 1464|32@1+ (1,0) [0|4294967295] "s" Vector__XXX
 SG_ State_of_Charge_Histogram_10 : 1496|32@1+ (1,0) [0|4294967295] "s" Vector__XXX
 SG_ State_of_Charge_Histogram_11 : 1528|32@1+ (1,0) [0|4294967295] "s" Vector__XXX
 SG_ State_of_Charge_Histogram_12 : 1560|32@1+ (1,0) [0|4294967295] "s" Vector__XXX
 SG_ State_of_Charge_Histogram_13 : 1592|32@1+ (1,0) [0|4294967295] "s" Vector__XXX
 SG_ State_of_Charge_Histogram_14 : 1624|32@1+ (1,0) [0|4294967295] "s" Vector__XXX
 SG_ State_of_Charge_Histogram_15 : 1656|32@1+ (1,0) [0|4294967295] "s" Vector__XXX
 SG_ State_of_Charge_Histogram_16 : 1688|32@1+ (1,0) [0|4294967295] "s" Vector__XXX
 SG_ State_of_Charge_Histogram_17 : 1720|32@1+ (1,0) [0|4294967295] "s" Vector__XXX
 SG_ State_of_Charge_Histogram_18 : 1752|32@1+ (1,0) [0|4294967295] "s" Vector__XXX
 SG_ State_of_Charge_Histogram_19 : 1784|32@1+ (1,0) [0|4294967295] "s" Vector__XXX

BO_ 2566838986 SOFT_INTERPACK_Pack02BMS: 222 Pack02BMS

BO_ 2566838987 SOFT_INTERPACK_Pack03BMS: 222 Pack03BMS

BO_ 2566838988 SOFT_INTERPACK_Pack04BMS: 222 Pack04BMS

BO_ 2566838989 SOFT_INTERPACK_Pack05BMS: 222 Pack05BMS

BO_ 2566838990 SOFT_INTERPACK_Pack06BMS: 222 Pack06BMS

BO_ 2566838991 SOFT_INTERPACK_Pack07BMS: 222 Pack07BMS

BO_ 2566838992 SOFT_INTERPACK_Pack08BMS: 222 Pack08BMS

BO_ 2566838993 SOFT_INTERPACK_Pack09BMS: 222 Pack09BMS

BO_ 2566838994 SOFT_INTERPACK_Pack10BMS: 222 Pack10BMS

BO_ 2566838995 SOFT_INTERPACK_Pack11BMS: 222 Pack11BMS

BO_ 2566838996 SOFT_INTERPACK_Pack12BMS: 222 Pack12BMS

BO_ 2566838997 SOFT_INTERPACK_Pack13BMS: 222 Pack13BMS

BO_ 2566838998 SOFT_INTERPACK_Pack14BMS: 222 Pack14BMS

BO_ 2566838999 SOFT_INTERPACK_Pack15BMS: 222 Pack15BMS

BO_ 2566839000 SOFT_INTERPACK_Pack16BMS: 222 Pack16BMS

BO_ 2566768074 ECUID_INTERPACK_Pack02BMS: 42 Pack02BMS

BO_ 2566768075 ECUID_INTERPACK_Pack03BMS: 42 Pack03BMS

BO_ 2566768076 ECUID_INTERPACK_Pack04BMS: 42 Pack04BMS

BO_ 2566768077 ECUID_INTERPACK_Pack05BMS: 42 Pack05BMS

BO_ 2566768078 ECUID_INTERPACK_Pack06BMS: 42 Pack06BMS

BO_ 2566768079 ECUID_INTERPACK_Pack07BMS: 42 Pack07BMS

BO_ 2566768080 ECUID_INTERPACK_Pack08BMS: 42 Pack08BMS

BO_ 2566768081 ECUID_INTERPACK_Pack09BMS: 42 Pack09BMS

BO_ 2566768082 ECUID_INTERPACK_Pack10BMS: 42 Pack10BMS

BO_ 2566768083 ECUID_INTERPACK_Pack11BMS: 42 Pack11BMS

BO_ 2566768084 ECUID_INTERPACK_Pack12BMS: 42 Pack12BMS

BO_ 2566768085 ECUID_INTERPACK_Pack13BMS: 42 Pack13BMS

BO_ 2566768086 ECUID_INTERPACK_Pack14BMS: 42 Pack14BMS

BO_ 2566768087 ECUID_INTERPACK_Pack15BMS: 42 Pack15BMS

BO_ 2566768088 ECUID_INTERPACK_Pack16BMS: 42 Pack16BMS

BO_ 2566843338 CI_INTERPACK_Pack02BMS: 39 Pack02BMS

BO_ 2566843339 CI_INTERPACK_Pack03BMS: 39 Pack03BMS

BO_ 2566843340 CI_INTERPACK_Pack04BMS: 39 Pack04BMS

BO_ 2566843341 CI_INTERPACK_Pack05BMS: 39 Pack05BMS

BO_ 2566843342 CI_INTERPACK_Pack06BMS: 39 Pack06BMS

BO_ 2566843343 CI_INTERPACK_Pack07BMS: 39 Pack07BMS

BO_ 2566843344 CI_INTERPACK_Pack08BMS: 39 Pack08BMS

BO_ 2566843345 CI_INTERPACK_Pack09BMS: 39 Pack09BMS

BO_ 2566843346 CI_INTERPACK_Pack10BMS: 39 Pack10BMS

BO_ 2566843347 CI_INTERPACK_Pack11BMS: 39 Pack11BMS

BO_ 2566843348 CI_INTERPACK_Pack12BMS: 39 Pack12BMS

BO_ 2566843349 CI_INTERPACK_Pack13BMS: 39 Pack13BMS

BO_ 2566843350 CI_INTERPACK_Pack14BMS: 39 Pack14BMS

BO_ 2566843351 CI_INTERPACK_Pack15BMS: 39 Pack15BMS

BO_ 2566843352 CI_INTERPACK_Pack16BMS: 39 Pack16BMS

BO_ 2565523717 RQST_ExternalECU_to_Pack01BMSLea: 3 ExternalECU
 SG_ PGN : 0|24@1+ (1,0) [0|16777215] "" Pack01BMSLeader

BO_ 2565523973 RQST_ExternalECU_to_Pack02BMS: 3 ExternalECU
 SG_ PGN : 0|24@1+ (1,0) [0|16777215] "" Pack02BMS

BO_ 2565524229 RQST_ExternalECU_to_Pack03BMS: 3 ExternalECU
 SG_ PGN : 0|24@1+ (1,0) [0|16777215] "" Pack03BMS

BO_ 2565524485 RQST_ExternalECU_to_Pack04BMS: 3 ExternalECU
 SG_ PGN : 0|24@1+ (1,0) [0|16777215] "" Pack04BMS

BO_ 2565524741 RQST_ExternalECU_to_Pack05BMS: 3 ExternalECU
 SG_ PGN : 0|24@1+ (1,0) [0|16777215] "" Pack05BMS

BO_ 2565524997 RQST_ExternalECU_to_Pack06BMS: 3 ExternalECU
 SG_ PGN : 0|24@1+ (1,0) [0|16777215] "" Pack06BMS

BO_ 2565525253 RQST_ExternalECU_to_Pack07BMS: 3 ExternalECU
 SG_ PGN : 0|24@1+ (1,0) [0|16777215] "" Pack07BMS

BO_ 2565525509 RQST_ExternalECU_to_Pack08BMS: 3 ExternalECU
 SG_ PGN : 0|24@1+ (1,0) [0|16777215] "" Pack08BMS

BO_ 2565525765 RQST_ExternalECU_to_Pack09BMS: 3 ExternalECU
 SG_ PGN : 0|24@1+ (1,0) [0|16777215] "" Pack09BMS

BO_ 2565526021 RQST_ExternalECU_to_Pack10BMS: 3 ExternalECU
 SG_ PGN : 0|24@1+ (1,0) [0|16777215] "" Pack10BMS

BO_ 2565526277 RQST_ExternalECU_to_Pack11BMS: 3 ExternalECU
 SG_ PGN : 0|24@1+ (1,0) [0|16777215] "" Pack11BMS

BO_ 2565526533 RQST_ExternalECU_to_Pack12BMS: 3 ExternalECU
 SG_ PGN : 0|24@1+ (1,0) [0|16777215] "" Pack12BMS

BO_ 2565526789 RQST_ExternalECU_to_Pack13BMS: 3 ExternalECU
 SG_ PGN : 0|24@1+ (1,0) [0|16777215] "" Pack13BMS

BO_ 2565527045 RQST_ExternalECU_to_Pack14BMS: 3 ExternalECU
 SG_ PGN : 0|24@1+ (1,0) [0|16777215] "" Pack14BMS

BO_ 2565527301 RQST_ExternalECU_to_Pack15BMS: 3 ExternalECU
 SG_ PGN : 0|24@1+ (1,0) [0|16777215] "" Pack15BMS

BO_ 2565527557 RQST_ExternalECU_to_Pack16BMS: 3 ExternalECU
 SG_ PGN : 0|24@1+ (1,0) [0|16777215] "" Pack16BMS

BO_ 2632777673 TP_CM_Pack01BMSLeader: 8 Pack01BMSLeader
 SG_ Control_Byte : 0|8@1+ (1,0) [0|255] "" Vector__XXX

BO_ 2632712137 TP_DT_Pack01BMSLeader: 8 Pack01BMSLeader
 SG_ Sequence_Number : 0|8@1+ (1,0) [0|255] "" Vector__XXX

BO_ 2632777674 TP_CM_Pack02BMS: 8 Pack02BMS
 SG_ Control_Byte : 0|8@1+ (1,0) [0|255] "" Vector__XXX

BO_ 2632712138 TP_DT_Pack02BMS: 8 Pack02BMS
 SG_ Sequence_Number : 0|8@1+ (1,0) [0|255] "" Vector__XXX

BO_ 2632777675 TP_CM_Pack03BMS: 8 Pack03BMS
 SG_ Control_Byte : 0|8@1+ (1,0) [0|255] "" Vector__XXX

BO_ 2632712139 TP_DT_Pack03BMS: 8 Pack03BMS
 SG_ Sequence_Number : 0|8@1+ (1,0) [0|255] "" Vector__XXX

BO_ 2632777676 TP_CM_Pack04BMS: 8 Pack04BMS
 SG_ Control_Byte : 0|8@1+ (1,0) [0|255] "" Vector__XXX

BO_ 2632712140 TP_DT_Pack04BMS: 8 Pack04BMS
 SG_ Sequence_Number : 0|8@1+ (1,0) [0|255] "" Vector__XXX

BO_ 2632777677 TP_CM_Pack05BMS: 8 Pack05BMS
 SG_ Control_Byte : 0|8@1+ (1,0) [0|255] "" Vector__XXX

BO_ 2632712141 TP_DT_Pack05BMS: 8 Pack05BMS
 SG_ Sequence_Number : 0|8@1+ (1,0) [0|255] "" Vector__XXX

BO_ 2632777678 TP_CM_Pack06BMS: 8 Pack06BMS
 SG_ Control_Byte : 0|8@1+ (1,0) [0|255] "" Vector__XXX

BO_ 2632712142 TP_DT_Pack06BMS: 8 Pack06BMS
 SG_ Sequence_Number : 0|8@1+ (1,0) [0|255] "" Vector__XXX

BO_ 2632777679 TP_CM_Pack07BMS: 8 Pack07BMS
 SG_ Control_Byte : 0|8@1+ (1,0) [0|255] "" Vector__XXX

BO_ 2632712143 TP_DT_Pack07BMS: 8 Pack07BMS
 SG_ Sequence_Number : 0|8@1+ (1,0) [0|255] "" Vector__XXX

BO_ 2632777680 TP_CM_Pack08BMS: 8 Pack08BMS
 SG_ Control_Byte : 0|8@1+ (1,0) [0|255] "" Vector__XXX

BO_ 2632712144 TP_DT_Pack08BMS: 8 Pack08BMS
 SG_ Sequence_Number : 0|8@1+ (1,0) [0|255] "" Vector__XXX

BO_ 2632777681 TP_CM_Pack09BMS: 8 Pack09BMS
 SG_ Control_Byte : 0|8@1+ (1,0) [0|255] "" Vector__XXX

BO_ 2632712145 TP_DT_Pack09BMS: 8 Pack09BMS
 SG_ Sequence_Number : 0|8@1+ (1,0) [0|255] "" Vector__XXX

BO_ 2632777682 TP_CM_Pack10BMS: 8 Pack10BMS
 SG_ Control_Byte : 0|8@1+ (1,0) [0|255] "" Vector__XXX

BO_ 2632712146 TP_DT_Pack10BMS: 8 Pack10BMS
 SG_ Sequence_Number : 0|8@1+ (1,0) [0|255] "" Vector__XXX

BO_ 2632777683 TP_CM_Pack11BMS: 8 Pack11BMS
 SG_ Control_Byte : 0|8@1+ (1,0) [0|255] "" Vector__XXX

BO_ 2632712147 TP_DT_Pack11BMS: 8 Pack11BMS
 SG_ Sequence_Number : 0|8@1+ (1,0) [0|255] "" Vector__XXX

BO_ 2632777684 TP_CM_Pack12BMS: 8 Pack12BMS
 SG_ Control_Byte : 0|8@1+ (1,0) [0|255] "" Vector__XXX

BO_ 2632712148 TP_DT_Pack12BMS: 8 Pack12BMS
 SG_ Sequence_Number : 0|8@1+ (1,0) [0|255] "" Vector__XXX

BO_ 2632777685 TP_CM_Pack13BMS: 8 Pack13BMS
 SG_ Control_Byte : 0|8@1+ (1,0) [0|255] "" Vector__XXX

BO_ 2632712149 TP_DT_Pack13BMS: 8 Pack13BMS
 SG_ Sequence_Number : 0|8@1+ (1,0) [0|255] "" Vector__XXX

BO_ 2632777686 TP_CM_Pack14BMS: 8 Pack14BMS
 SG_ Control_Byte : 0|8@1+ (1,0) [0|255] "" Vector__XXX

BO_ 2632712150 TP_DT_Pack14BMS: 8 Pack14BMS
 SG_ Sequence_Number : 0|8@1+ (1,0) [0|255] "" Vector__XXX

BO_ 2632777687 TP_CM_Pack15BMS: 8 Pack15BMS
 SG_ Control_Byte : 0|8@1+ (1,0) [0|255] "" Vector__XXX

BO_ 2632712151 TP_DT_Pack15BMS: 8 Pack15BMS
 SG_ Sequence_Number : 0|8@1+ (1,0) [0|255] "" Vector__XXX

BO_ 2632777688 TP_CM_Pack16BMS: 8 Pack16BMS
 SG_ Control_Byte : 0|8@1+ (1,0) [0|255] "" Vector__XXX

BO_ 2632712152 TP_DT_Pack16BMS: 8 Pack16BMS
 SG_ Sequence_Number : 0|8@1+ (1,0) [0|255] "" Vector__XXX

CM_ SG_ 2566852817 Remaining_Capacity "Pack charge capacity";
CM_ SG_ 2566852817 Date_of_Manufacture_0 "Date of manufacture encoded as YYYY-MM";
CM_ SG_ 2566852817 Date_of_Manufacture_1 "Date of manufacture encoded as YYYY-MM";
CM_ SG_ 2566852817 Date_of_Manufacture_2 "Date of manufacture encoded as YYYY-MM";
CM_ SG_ 2566852817 Date_of_Manufacture_3 "Date of manufacture encoded as YYYY-MM";
CM_ SG_ 2566852817 Date_of_Manufacture_4 "Date of manufacture encoded as YYYY-MM";
CM_ SG_ 2566852817 Date_of_Manufacture_5 "Date of manufacture encoded as YYYY-MM";
CM_ SG_ 2566852817 Date_of_Manufacture_6 "Date of manufacture encoded as YYYY-MM";
CM_ SG_ 2566852817 Date_of_Putting_Into_Service_0 "Date of putting into service encoded as YYYY-MM";
CM_ SG_ 2566852817 Date_of_Putting_Into_Service_1 "Date of putting into service encoded as YYYY-MM";
CM_ SG_ 2566852817 Date_of_Putting_Into_Service_2 "Date of putting into service encoded as YYYY-MM";
CM_ SG_ 2566852817 Date_of_Putting_Into_Service_3 "Date of putting into service encoded as YYYY-MM";
CM_ SG_ 2566852817 Date_of_Putting_Into_Service_4 "Date of putting into service encoded as YYYY-MM";
CM_ SG_ 2566852817 Date_of_Putting_Into_Service_5 "Date of putting into service encoded as YYYY-MM";
CM_ SG_ 2566852817 Date_of_Putting_Into_Service_6 "Date of putting into service encoded as YYYY-MM";
CM_ SG_ 2566852817 Charge_Energy_Throughput "Battery system charge energy throughput";
CM_ SG_ 2566852817 Discharge_Energy_Throughput "Battery system discharge energy throughput";
CM_ SG_ 2566852817 Total_Energy_Throughput "Battery system total energy throughput";
CM_ SG_ 2566852817 Charged_Capacity_Throughput "Battery system charged capacity throughput";
CM_ SG_ 2566852817 Discharged_Capacity_Throughput "Battery system discharged capacity throughput";
CM_ SG_ 2566852817 Total_Capacity_Throughput "Battery system total capacity throughput";
CM_ SG_ 2566852817 Number_of_Full_Equivalent_Charge0 "Number of full equivalent charge cycles";
CM_ SG_ 2566852817 Number_of_Full_Equivalent_Discha "Number of full equivalent discharge cycles";
CM_ SG_ 2566852817 Number_of_Full_Equivalent_Charge1 "Number of full equivalent charge-discharge cycles";
CM_ SG_ 2566852817 Temperature_Histogram_0 "Battery system temperature histogram (seconds) of the battery pack.";
CM_ SG_ 2566852817 Temperature_Histogram_1 "Battery system temperature histogram (seconds) of the battery pack.";
CM_ SG_ 2566852817 Temperature_Histogram_2 "Battery system temperature histogram (seconds) of the battery pack.";
CM_ SG_ 2566852817 Temperature_Histogram_3 "Battery system temperature histogram (seconds) of the battery pack.";
CM_ SG_ 2566852817 Temperature_Histogram_4 "Battery system temperature histogram (seconds) of the battery pack.";
CM_ SG_ 2566852817 Temperature_Histogram_5 "Battery system temperature histogram (seconds) of the battery pack.";
CM_ SG_ 2566852817 Temperature_Histogram_6 "Battery system temperature histogram (seconds) of the battery pack.";
CM_ SG_ 2566852817 Temperature_Histogram_7 "Battery system temperature histogram (seconds) of the battery pack.";
CM_ SG_ 2566852817 Temperature_Histogram_8 "Battery system temperature histogram (seconds) of the battery pack.";
CM_ SG_ 2566852817 Temperature_Histogram_9 "Battery system temperature histogram (seconds) of the battery pack.";
CM_ SG_ 2566852817 Temperature_Histogram_10 "Battery system temperature histogram (seconds) of the battery pack.";
CM_ SG_ 2566852817 Temperature_Histogram_11 "Battery system temperature histogram (seconds) of the battery pack.";
CM_ SG_ 2566852817 Temperature_Histogram_12 "Battery system temperature histogram (seconds) of the battery pack.";
CM_ SG_ 2566852817 Temperature_Histogram_13 "Battery system temperature histogram (seconds) of the battery pack.";
CM_ SG_ 2566852817 Temperature_Histogram_14 "Battery system temperature histogram (seconds) of the battery pack.";
CM_ SG_ 2566852817 Temperature_Histogram_15 "Battery system temperature histogram (seconds) of the battery pack.";
CM_ SG_ 2566852817 Temperature_Histogram_16 "Battery system temperature histogram (seconds) of the battery pack.";
CM_ SG_ 2566852817 Temperature_Histogram_17 "Battery system temperature histogram (seconds) of the battery pack.";
CM_ SG_ 2566852817 Temperature_Histogram_18 "Battery system temperature histogram (seconds) of the battery pack.";
CM_ SG_ 2566852817 Temperature_Histogram_19 "Battery system temperature histogram (seconds) of the battery pack.";
CM_ SG_ 2566852817 Temperature_Histogram_20 "Battery system temperature histogram (seconds) of the battery pack.";
CM_ SG_ 2566852817 Temperature_Histogram_21 "Battery system temperature histogram (seconds) of the battery pack.";
CM_ SG_ 2566852817 Temperature_Histogram_22 "Battery system temperature histogram (seconds) of the battery pack.";
CM_ SG_ 2566852817 Temperature_Histogram_23 "Battery system temperature histogram (seconds) of the battery pack.";
CM_ SG_ 2566852817 Time_Spent_in_Extreme_Temperatur0 "Time spent in extreme temperatures above boundary (seconds) of the battery pack.";
CM_ SG_ 2566852817 Time_Spent_in_Extreme_Temperatur1 "Time spent in extreme temperatures below boundary (seconds) of the battery pack.";
CM_ SG_ 2566852817 Number_of_Deep_Discharge_Events "Number of deep discharge events of the battery pack.";
CM_ SG_ 2566852817 Time_Spent_Charging_In_Extreme_T "Time spent charging in extreme temperatures (seconds) of the battery pack.";
CM_ SG_ 2566852817 State_of_Charge "Battery system state of charge";
CM_ SG_ 2566852817 State_of_Charge_Histogram_0 "Battery system state of charge histogram (seconds) of the battery pack.";
CM_ SG_ 2566852817 State_of_Charge_Histogram_1 "Battery system state of charge histogram (seconds) of the battery pack.";
CM_ SG_ 2566852817 State_of_Charge_Histogram_2 "Battery system state of charge histogram (seconds) of the battery pack.";
CM_ SG_ 2566852817 State_of_Charge_Histogram_3 "Battery system state of charge histogram (seconds) of the battery pack.";
CM_ SG_ 2566852817 State_of_Charge_Histogram_4 "Battery system state of charge histogram (seconds) of the battery pack.";
CM_ SG_ 2566852817 State_of_Charge_Histogram_5 "Battery system state of charge histogram (seconds) of the battery pack.";
CM_ SG_ 2566852817 State_of_Charge_Histogram_6 "Battery system state of charge histogram (seconds) of the battery pack.";
CM_ SG_ 2566852817 State_of_Charge_Histogram_7 "Battery system state of charge histogram (seconds) of the battery pack.";
CM_ SG_ 2566852817 State_of_Charge_Histogram_8 "Battery system state of charge histogram (seconds) of the battery pack.";
CM_ SG_ 2566852817 State_of_Charge_Histogram_9 "Battery system state of charge histogram (seconds) of the battery pack.";
CM_ SG_ 2566852817 State_of_Charge_Histogram_10 "Battery system state of charge histogram (seconds) of the battery pack.";
CM_ SG_ 2566852817 State_of_Charge_Histogram_11 "Battery system state of charge histogram (seconds) of the battery pack.";
CM_ SG_ 2566852817 State_of_Charge_Histogram_12 "Battery system state of charge histogram (seconds) of the battery pack.";
CM_ SG_ 2566852817 State_of_Charge_Histogram_13 "Battery system state of charge histogram (seconds) of the battery pack.";
CM_ SG_ 2566852817 State_of_Charge_Histogram_14 "Battery system state of charge histogram (seconds) of the battery pack.";
CM_ SG_ 2566852817 State_of_Charge_Histogram_15 "Battery system state of charge histogram (seconds) of the battery pack.";
CM_ SG_ 2566852817 State_of_Charge_Histogram_16 "Battery system state of charge histogram (seconds) of the battery pack.";
CM_ SG_ 2566852817 State_of_Charge_Histogram_17 "Battery system state of charge histogram (seconds) of the battery pack.";
CM_ SG_ 2566852817 State_of_Charge_Histogram_18 "Battery system state of charge histogram (seconds) of the battery pack.";
CM_ SG_ 2566852817 State_of_Charge_Histogram_19 "Battery system state of charge histogram (seconds) of the battery pack.";
CM_ SG_ 2566852818 Remaining_Capacity "Pack charge capacity";
CM_ SG_ 2566852818 Date_of_Manufacture_0 "Date of manufacture encoded as YYYY-MM";
CM_ SG_ 2566852818 Date_of_Manufacture_1 "Date of manufacture encoded as YYYY-MM";
CM_ SG_ 2566852818 Date_of_Manufacture_2 "Date of manufacture encoded as YYYY-MM";
CM_ SG_ 2566852818 Date_of_Manufacture_3 "Date of manufacture encoded as YYYY-MM";
CM_ SG_ 2566852818 Date_of_Manufacture_4 "Date of manufacture encoded as YYYY-MM";
CM_ SG_ 2566852818 Date_of_Manufacture_5 "Date of manufacture encoded as YYYY-MM";
CM_ SG_ 2566852818 Date_of_Manufacture_6 "Date of manufacture encoded as YYYY-MM";
CM_ SG_ 2566852818 Date_of_Putting_Into_Service_0 "Date of putting into service encoded as YYYY-MM";
CM_ SG_ 2566852818 Date_of_Putting_Into_Service_1 "Date of putting into service encoded as YYYY-MM";
CM_ SG_ 2566852818 Date_of_Putting_Into_Service_2 "Date of putting into service encoded as YYYY-MM";
CM_ SG_ 2566852818 Date_of_Putting_Into_Service_3 "Date of putting into service encoded as YYYY-MM";
CM_ SG_ 2566852818 Date_of_Putting_Into_Service_4 "Date of putting into service encoded as YYYY-MM";
CM_ SG_ 2566852818 Date_of_Putting_Into_Service_5 "Date of putting into service encoded as YYYY-MM";
CM_ SG_ 2566852818 Date_of_Putting_Into_Service_6 "Date of putting into service encoded as YYYY-MM";
CM_ SG_ 2566852818 Charge_Energy_Throughput "Battery system charge energy throughput";
CM_ SG_ 2566852818 Discharge_Energy_Throughput "Battery system discharge energy throughput";
CM_ SG_ 2566852818 Total_Energy_Throughput "Battery system total energy throughput";
CM_ SG_ 2566852818 Charged_Capacity_Throughput "Battery system charged capacity throughput";
CM_ SG_ 2566852818 Discharged_Capacity_Throughput "Battery system discharged capacity throughput";
CM_ SG_ 2566852818 Total_Capacity_Throughput "Battery system total capacity throughput";
CM_ SG_ 2566852818 Number_of_Full_Equivalent_Charge0 "Number of full equivalent charge cycles";
CM_ SG_ 2566852818 Number_of_Full_Equivalent_Discha "Number of full equivalent discharge cycles";
CM_ SG_ 2566852818 Number_of_Full_Equivalent_Charge1 "Number of full equivalent charge-discharge cycles";
CM_ SG_ 2566852818 Temperature_Histogram_0 "Battery system temperature histogram (seconds) of the battery pack.";
CM_ SG_ 2566852818 Temperature_Histogram_1 "Battery system temperature histogram (seconds) of the battery pack.";
CM_ SG_ 2566852818 Temperature_Histogram_2 "Battery system temperature histogram (seconds) of the battery pack.";
CM_ SG_ 2566852818 Temperature_Histogram_3 "Battery system temperature histogram (seconds) of the battery pack.";
CM_ SG_ 2566852818 Temperature_Histogram_4 "Battery system temperature histogram (seconds) of the battery pack.";
CM_ SG_ 2566852818 Temperature_Histogram_5 "Battery system temperature histogram (seconds) of the battery pack.";
CM_ SG_ 2566852818 Temperature_Histogram_6 "Battery system temperature histogram (seconds) of the battery pack.";
CM_ SG_ 2566852818 Temperature_Histogram_7 "Battery system temperature histogram (seconds) of the battery pack.";
CM_ SG_ 2566852818 Temperature_Histogram_8 "Battery system temperature histogram (seconds) of the battery pack.";
CM_ SG_ 2566852818 Temperature_Histogram_9 "Battery system temperature histogram (seconds) of the battery pack.";
CM_ SG_ 2566852818 Temperature_Histogram_10 "Battery system temperature histogram (seconds) of the battery pack.";
CM_ SG_ 2566852818 Temperature_Histogram_11 "Battery system temperature histogram (seconds) of the battery pack.";
CM_ SG_ 2566852818 Temperature_Histogram_12 "Battery system temperature histogram (seconds) of the battery pack.";
CM_ SG_ 2566852818 Temperature_Histogram_13 "Battery system temperature histogram (seconds) of the battery pack.";
CM_ SG_ 2566852818 Temperature_Histogram_14 "Battery system temperature histogram (seconds) of the battery pack.";
CM_ SG_ 2566852818 Temperature_Histogram_15 "Battery system temperature histogram (seconds) of the battery pack.";
CM_ SG_ 2566852818 Temperature_Histogram_16 "Battery system temperature histogram (seconds) of the battery pack.";
CM_ SG_ 2566852818 Temperature_Histogram_17 "Battery system temperature histogram (seconds) of the battery pack.";
CM_ SG_ 2566852818 Temperature_Histogram_18 "Battery system temperature histogram (seconds) of the battery pack.";
CM_ SG_ 2566852818 Temperature_Histogram_19 "Battery system temperature histogram (seconds) of the battery pack.";
CM_ SG_ 2566852818 Temperature_Histogram_20 "Battery system temperature histogram (seconds) of the battery pack.";
CM_ SG_ 2566852818 Temperature_Histogram_21 "Battery system temperature histogram (seconds) of the battery pack.";
CM_ SG_ 2566852818 Temperature_Histogram_22 "Battery system temperature histogram (seconds) of the battery pack.";
CM_ SG_ 2566852818 Temperature_Histogram_23 "Battery system temperature histogram (seconds) of the battery pack.";
CM_ SG_ 2566852818 Time_Spent_in_Extreme_Temperatur0 "Time spent in extreme temperatures above boundary (seconds) of the battery pack.";
CM_ SG_ 2566852818 Time_Spent_in_Extreme_Temperatur1 "Time spent in extreme temperatures below boundary (seconds) of the battery pack.";
CM_ SG_ 2566852818 Number_of_Deep_Discharge_Events "Number of deep discharge events of the battery pack.";
CM_ SG_ 2566852818 Time_Spent_Charging_In_Extreme_T "Time spent charging in extreme temperatures (seconds) of the battery pack.";
CM_ SG_ 2566852818 State_of_Charge "Battery system state of charge";
CM_ SG_ 2566852818 State_of_Charge_Histogram_0 "Battery system state of charge histogram (seconds) of the battery pack.";
CM_ SG_ 2566852818 State_of_Charge_Histogram_1 "Battery system state of charge histogram (seconds) of the battery pack.";
CM_ SG_ 2566852818 State_of_Charge_Histogram_2 "Battery system state of charge histogram (seconds) of the battery pack.";
CM_ SG_ 2566852818 State_of_Charge_Histogram_3 "Battery system state of charge histogram (seconds) of the battery pack.";
CM_ SG_ 2566852818 State_of_Charge_Histogram_4 "Battery system state of charge histogram (seconds) of the battery pack.";
CM_ SG_ 2566852818 State_of_Charge_Histogram_5 "Battery system state of charge histogram (seconds) of the battery pack.";
CM_ SG_ 2566852818 State_of_Charge_Histogram_6 "Battery system state of charge histogram (seconds) of the battery pack.";
CM_ SG_ 2566852818 State_of_Charge_Histogram_7 "Battery system state of charge histogram (seconds) of the battery pack.";
CM_ SG_ 2566852818 State_of_Charge_Histogram_8 "Battery system state of charge histogram (seconds) of the battery pack.";
CM_ SG_ 2566852818 State_of_Charge_Histogram_9 "Battery system state of charge histogram (seconds) of the battery pack.";
CM_ SG_ 2566852818 State_of_Charge_Histogram_10 "Battery system state of charge histogram (seconds) of the battery pack.";
CM_ SG_ 2566852818 State_of_Charge_Histogram_11 "Battery system state of charge histogram (seconds) of the battery pack.";
CM_ SG_ 2566852818 State_of_Charge_Histogram_12 "Battery system state of charge histogram (seconds) of the battery pack.";
CM_ SG_ 2566852818 State_of_Charge_Histogram_13 "Battery system state of charge histogram (seconds) of the battery pack.";
CM_ SG_ 2566852818 State_of_Charge_Histogram_14 "Battery system state of charge histogram (seconds) of the battery pack.";
CM_ SG_ 2566852818 State_of_Charge_Histogram_15 "Battery system state of charge histogram (seconds) of the battery pack.";
CM_ SG_ 2566852818 State_of_Charge_Histogram_16 "Battery system state of charge histogram (seconds) of the battery pack.";
CM_ SG_ 2566852818 State_of_Charge_Histogram_17 "Battery system state of charge histogram (seconds) of the battery pack.";
CM_ SG_ 2566852818 State_of_Charge_Histogram_18 "Battery system state of charge histogram (seconds) of the battery pack.";
CM_ SG_ 2566852818 State_of_Charge_Histogram_19 "Battery system state of charge histogram (seconds) of the battery pack.";
CM_ SG_ 2566852819 Remaining_Capacity "Pack charge capacity";
CM_ SG_ 2566852819 Date_of_Manufacture_0 "Date of manufacture encoded as YYYY-MM";
CM_ SG_ 2566852819 Date_of_Manufacture_1 "Date of manufacture encoded as YYYY-MM";
CM_ SG_ 2566852819 Date_of_Manufacture_2 "Date of manufacture encoded as YYYY-MM";
CM_ SG_ 2566852819 Date_of_Manufacture_3 "Date of manufacture encoded as YYYY-MM";
CM_ SG_ 2566852819 Date_of_Manufacture_4 "Date of manufacture encoded as YYYY-MM";
CM_ SG_ 2566852819 Date_of_Manufacture_5 "Date of manufacture encoded as YYYY-MM";
CM_ SG_ 2566852819 Date_of_Manufacture_6 "Date of manufacture encoded as YYYY-MM";
CM_ SG_ 2566852819 Date_of_Putting_Into_Service_0 "Date of putting into service encoded as YYYY-MM";
CM_ SG_ 2566852819 Date_of_Putting_Into_Service_1 "Date of putting into service encoded as YYYY-MM";
CM_ SG_ 2566852819 Date_of_Putting_Into_Service_2 "Date of putting into service encoded as YYYY-MM";
CM_ SG_ 2566852819 Date_of_Putting_Into_Service_3 "Date of putting into service encoded as YYYY-MM";
CM_ SG_ 2566852819 Date_of_Putting_Into_Service_4 "Date of putting into service encoded as YYYY-MM";
CM_ SG_ 2566852819 Date_of_Putting_Into_Service_5 "Date of putting into service encoded as YYYY-MM";
CM_ SG_ 2566852819 Date_of_Putting_Into_Service_6 "Date of putting into service encoded as YYYY-MM";
CM_ SG_ 2566852819 Charge_Energy_Throughput "Battery system charge energy throughput";
CM_ SG_ 2566852819 Discharge_Energy_Throughput "Battery system discharge energy throughput";
CM_ SG_ 2566852819 Total_Energy_Throughput "Battery system total energy throughput";
CM_ SG_ 2566852819 Charged_Capacity_Throughput "Battery system charged capacity throughput";
CM_ SG_ 2566852819 Discharged_Capacity_Throughput "Battery system discharged capacity throughput";
CM_ SG_ 2566852819 Total_Capacity_Throughput "Battery system total capacity throughput";
CM_ SG_ 2566852819 Number_of_Full_Equivalent_Charge0 "Number of full equivalent charge cycles";
CM_ SG_ 2566852819 Number_of_Full_Equivalent_Discha "Number of full equivalent discharge cycles";
CM_ SG_ 2566852819 Number_of_Full_Equivalent_Charge1 "Number of full equivalent charge-discharge cycles";
CM_ SG_ 2566852819 Temperature_Histogram_0 "Battery system temperature histogram (seconds) of the battery pack.";
CM_ SG_ 2566852819 Temperature_Histogram_1 "Battery system temperature histogram (seconds) of the battery pack.";
CM_ SG_ 2566852819 Temperature_Histogram_2 "Battery system temperature histogram (seconds) of the battery pack.";
CM_ SG_ 2566852819 Temperature_Histogram_3 "Battery system temperature histogram (seconds) of the battery pack.";
CM_ SG_ 2566852819 Temperature_Histogram_4 "Battery system temperature histogram (seconds) of the battery pack.";
CM_ SG_ 2566852819 Temperature_Histogram_5 "Battery system temperature histogram (seconds) of the battery pack.";
CM_ SG_ 2566852819 Temperature_Histogram_6 "Battery system temperature histogram (seconds) of the battery pack.";
CM_ SG_ 2566852819 Temperature_Histogram_7 "Battery system temperature histogram (seconds) of the battery pack.";
CM_ SG_ 2566852819 Temperature_Histogram_8 "Battery system temperature histogram (seconds) of the battery pack.";
CM_ SG_ 2566852819 Temperature_Histogram_9 "Battery system temperature histogram (seconds) of the battery pack.";
CM_ SG_ 2566852819 Temperature_Histogram_10 "Battery system temperature histogram (seconds) of the battery pack.";
CM_ SG_ 2566852819 Temperature_Histogram_11 "Battery system temperature histogram (seconds) of the battery pack.";
CM_ SG_ 2566852819 Temperature_Histogram_12 "Battery system temperature histogram (seconds) of the battery pack.";
CM_ SG_ 2566852819 Temperature_Histogram_13 "Battery system temperature histogram (seconds) of the battery pack.";
CM_ SG_ 2566852819 Temperature_Histogram_14 "Battery system temperature histogram (seconds) of the battery pack.";
CM_ SG_ 2566852819 Temperature_Histogram_15 "Battery system temperature histogram (seconds) of the battery pack.";
CM_ SG_ 2566852819 Temperature_Histogram_16 "Battery system temperature histogram (seconds) of the battery pack.";
CM_ SG_ 2566852819 Temperature_Histogram_17 "Battery system temperature histogram (seconds) of the battery pack.";
CM_ SG_ 2566852819 Temperature_Histogram_18 "Battery system temperature histogram (seconds) of the battery pack.";
CM_ SG_ 2566852819 Temperature_Histogram_19 "Battery system temperature histogram (seconds) of the battery pack.";
CM_ SG_ 2566852819 Temperature_Histogram_20 "Battery system temperature histogram (seconds) of the battery pack.";
CM_ SG_ 2566852819 Temperature_Histogram_21 "Battery system temperature histogram (seconds) of the battery pack.";
CM_ SG_ 2566852819 Temperature_Histogram_22 "Battery system temperature histogram (seconds) of the battery pack.";
CM_ SG_ 2566852819 Temperature_Histogram_23 "Battery system temperature histogram (seconds) of the battery pack.";
CM_ SG_ 2566852819 Time_Spent_in_Extreme_Temperatur0 "Time spent in extreme temperatures above boundary (seconds) of the battery pack.";
CM_ SG_ 2566852819 Time_Spent_in_Extreme_Temperatur1 "Time spent in extreme temperatures below boundary (seconds) of the battery pack.";
CM_ SG_ 2566852819 Number_of_Deep_Discharge_Events "Number of deep discharge events of the battery pack.";
CM_ SG_ 2566852819 Time_Spent_Charging_In_Extreme_T "Time spent charging in extreme temperatures (seconds) of the battery pack.";
CM_ SG_ 2566852819 State_of_Charge "Battery system state of charge";
CM_ SG_ 2566852819 State_of_Charge_Histogram_0 "Battery system state of charge histogram (seconds) of the battery pack.";
CM_ SG_ 2566852819 State_of_Charge_Histogram_1 "Battery system state of charge histogram (seconds) of the battery pack.";
CM_ SG_ 2566852819 State_of_Charge_Histogram_2 "Battery system state of charge histogram (seconds) of the battery pack.";
CM_ SG_ 2566852819 State_of_Charge_Histogram_3 "Battery system state of charge histogram (seconds) of the battery pack.";
CM_ SG_ 2566852819 State_of_Charge_Histogram_4 "Battery system state of charge histogram (seconds) of the battery pack.";
CM_ SG_ 2566852819 State_of_Charge_Histogram_5 "Battery system state of charge histogram (seconds) of the battery pack.";
CM_ SG_ 2566852819 State_of_Charge_Histogram_6 "Battery system state of charge histogram (seconds) of the battery pack.";
CM_ SG_ 2566852819 State_of_Charge_Histogram_7 "Battery system state of charge histogram (seconds) of the battery pack.";
CM_ SG_ 2566852819 State_of_Charge_Histogram_8 "Battery system state of charge histogram (seconds) of the battery pack.";
CM_ SG_ 2566852819 State_of_Charge_Histogram_9 "Battery system state of charge histogram (seconds) of the battery pack.";
CM_ SG_ 2566852819 State_of_Charge_Histogram_10 "Battery system state of charge histogram (seconds) of the battery pack.";
CM_ SG_ 2566852819 State_of_Charge_Histogram_11 "Battery system state of charge histogram (seconds) of the battery pack.";
CM_ SG_ 2566852819 State_of_Charge_Histogram_12 "Battery system state of charge histogram (seconds) of the battery pack.";
CM_ SG_ 2566852819 State_of_Charge_Histogram_13 "Battery system state of charge histogram (seconds) of the battery pack.";
CM_ SG_ 2566852819 State_of_Charge_Histogram_14 "Battery system state of charge histogram (seconds) of the battery pack.";
CM_ SG_ 2566852819 State_of_Charge_Histogram_15 "Battery system state of charge histogram (seconds) of the battery pack.";
CM_ SG_ 2566852819 State_of_Charge_Histogram_16 "Battery system state of charge histogram (seconds) of the battery pack.";
CM_ SG_ 2566852819 State_of_Charge_Histogram_17 "Battery system state of charge histogram (seconds) of the battery pack.";
CM_ SG_ 2566852819 State_of_Charge_Histogram_18 "Battery system state of charge histogram (seconds) of the battery pack.";
CM_ SG_ 2566852819 State_of_Charge_Histogram_19 "Battery system state of charge histogram (seconds) of the battery pack.";
CM_ SG_ 2566852820 Remaining_Capacity "Pack charge capacity";
CM_ SG_ 2566852820 Date_of_Manufacture_0 "Date of manufacture encoded as YYYY-MM";
CM_ SG_ 2566852820 Date_of_Manufacture_1 "Date of manufacture encoded as YYYY-MM";
CM_ SG_ 2566852820 Date_of_Manufacture_2 "Date of manufacture encoded as YYYY-MM";
CM_ SG_ 2566852820 Date_of_Manufacture_3 "Date of manufacture encoded as YYYY-MM";
CM_ SG_ 2566852820 Date_of_Manufacture_4 "Date of manufacture encoded as YYYY-MM";
CM_ SG_ 2566852820 Date_of_Manufacture_5 "Date of manufacture encoded as YYYY-MM";
CM_ SG_ 2566852820 Date_of_Manufacture_6 "Date of manufacture encoded as YYYY-MM";
CM_ SG_ 2566852820 Date_of_Putting_Into_Service_0 "Date of putting into service encoded as YYYY-MM";
CM_ SG_ 2566852820 Date_of_Putting_Into_Service_1 "Date of putting into service encoded as YYYY-MM";
CM_ SG_ 2566852820 Date_of_Putting_Into_Service_2 "Date of putting into service encoded as YYYY-MM";
CM_ SG_ 2566852820 Date_of_Putting_Into_Service_3 "Date of putting into service encoded as YYYY-MM";
CM_ SG_ 2566852820 Date_of_Putting_Into_Service_4 "Date of putting into service encoded as YYYY-MM";
CM_ SG_ 2566852820 Date_of_Putting_Into_Service_5 "Date of putting into service encoded as YYYY-MM";
CM_ SG_ 2566852820 Date_of_Putting_Into_Service_6 "Date of putting into service encoded as YYYY-MM";
CM_ SG_ 2566852820 Charge_Energy_Throughput "Battery system charge energy throughput";
CM_ SG_ 2566852820 Discharge_Energy_Throughput "Battery system discharge energy throughput";
CM_ SG_ 2566852820 Total_Energy_Throughput "Battery system total energy throughput";
CM_ SG_ 2566852820 Charged_Capacity_Throughput "Battery system charged capacity throughput";
CM_ SG_ 2566852820 Discharged_Capacity_Throughput "Battery system discharged capacity throughput";
CM_ SG_ 2566852820 Total_Capacity_Throughput "Battery system total capacity throughput";
CM_ SG_ 2566852820 Number_of_Full_Equivalent_Charge0 "Number of full equivalent charge cycles";
CM_ SG_ 2566852820 Number_of_Full_Equivalent_Discha "Number of full equivalent discharge cycles";
CM_ SG_ 2566852820 Number_of_Full_Equivalent_Charge1 "Number of full equivalent charge-discharge cycles";
CM_ SG_ 2566852820 Temperature_Histogram_0 "Battery system temperature histogram (seconds) of the battery pack.";
CM_ SG_ 2566852820 Temperature_Histogram_1 "Battery system temperature histogram (seconds) of the battery pack.";
CM_ SG_ 2566852820 Temperature_Histogram_2 "Battery system temperature histogram (seconds) of the battery pack.";
CM_ SG_ 2566852820 Temperature_Histogram_3 "Battery system temperature histogram (seconds) of the battery pack.";
CM_ SG_ 2566852820 Temperature_Histogram_4 "Battery system temperature histogram (seconds) of the battery pack.";
CM_ SG_ 2566852820 Temperature_Histogram_5 "Battery system temperature histogram (seconds) of the battery pack.";
CM_ SG_ 2566852820 Temperature_Histogram_6 "Battery system temperature histogram (seconds) of the battery pack.";
CM_ SG_ 2566852820 Temperature_Histogram_7 "Battery system temperature histogram (seconds) of the battery pack.";
CM_ SG_ 2566852820 Temperature_Histogram_8 "Battery system temperature histogram (seconds) of the battery pack.";
CM_ SG_ 2566852820 Temperature_Histogram_9 "Battery system temperature histogram (seconds) of the battery pack.";
CM_ SG_ 2566852820 Temperature_Histogram_10 "Battery system temperature histogram (seconds) of the battery pack.";
CM_ SG_ 2566852820 Temperature_Histogram_11 "Battery system temperature histogram (seconds) of the battery pack.";
CM_ SG_ 2566852820 Temperature_Histogram_12 "Battery system temperature histogram (seconds) of the battery pack.";
CM_ SG_ 2566852820 Temperature_Histogram_13 "Battery system temperature histogram (seconds) of the battery pack.";
CM_ SG_ 2566852820 Temperature_Histogram_14 "Battery system temperature histogram (seconds) of the battery pack.";
CM_ SG_ 2566852820 Temperature_Histogram_15 "Battery system temperature histogram (seconds) of the battery pack.";
CM_ SG_ 2566852820 Temperature_Histogram_16 "Battery system temperature histogram (seconds) of the battery pack.";
CM_ SG_ 2566852820 Temperature_Histogram_17 "Battery system temperature histogram (seconds) of the battery pack.";
CM_ SG_ 2566852820 Temperature_Histogram_18 "Battery system temperature histogram (seconds) of the battery pack.";
CM_ SG_ 2566852820 Temperature_Histogram_19 "Battery system temperature histogram (seconds) of the battery pack.";
CM_ SG_ 2566852820 Temperature_Histogram_20 "Battery system temperature histogram (seconds) of the battery pack.";
CM_ SG_ 2566852820 Temperature_Histogram_21 "Battery system temperature histogram (seconds) of the battery pack.";
CM_ SG_ 2566852820 Temperature_Histogram_22 "Battery system temperature histogram (seconds) of the battery pack.";
CM_ SG_ 2566852820 Temperature_Histogram_23 "Battery system temperature histogram (seconds) of the battery pack.";
CM_ SG_ 2566852820 Time_Spent_in_Extreme_Temperatur0 "Time spent in extreme temperatures above boundary (seconds) of the battery pack.";
CM_ SG_ 2566852820 Time_Spent_in_Extreme_Temperatur1 "Time spent in extreme temperatures below boundary (seconds) of the battery pack.";
CM_ SG_ 2566852820 Number_of_Deep_Discharge_Events "Number of deep discharge events of the battery pack.";
CM_ SG_ 2566852820 Time_Spent_Charging_In_Extreme_T "Time spent charging in extreme temperatures (seconds) of the battery pack.";
CM_ SG_ 2566852820 State_of_Charge "Battery system state of charge";
CM_ SG_ 2566852820 State_of_Charge_Histogram_0 "Battery system state of charge histogram (seconds) of the battery pack.";
CM_ SG_ 2566852820 State_of_Charge_Histogram_1 "Battery system state of charge histogram (seconds) of the battery pack.";
CM_ SG_ 2566852820 State_of_Charge_Histogram_2 "Battery system state of charge histogram (seconds) of the battery pack.";
CM_ SG_ 2566852820 State_of_Charge_Histogram_3 "Battery system state of charge histogram (seconds) of the battery pack.";
CM_ SG_ 2566852820 State_of_Charge_Histogram_4 "Battery system state of charge histogram (seconds) of the battery pack.";
CM_ SG_ 2566852820 State_of_Charge_Histogram_5 "Battery system state of charge histogram (seconds) of the battery pack.";
CM_ SG_ 2566852820 State_of_Charge_Histogram_6 "Battery system state of charge histogram (seconds) of the battery pack.";
CM_ SG_ 2566852820 State_of_Charge_Histogram_7 "Battery system state of charge histogram (seconds) of the battery pack.";
CM_ SG_ 2566852820 State_of_Charge_Histogram_8 "Battery system state of charge histogram (seconds) of the battery pack.";
CM_ SG_ 2566852820 State_of_Charge_Histogram_9 "Battery system state of charge histogram (seconds) of the battery pack.";
CM_ SG_ 2566852820 State_of_Charge_Histogram_10 "Battery system state of charge histogram (seconds) of the battery pack.";
CM_ SG_ 2566852820 State_of_Charge_Histogram_11 "Battery system state of charge histogram (seconds) of the battery pack.";
CM_ SG_ 2566852820 State_of_Charge_Histogram_12 "Battery system state of charge histogram (seconds) of the battery pack.";
CM_ SG_ 2566852820 State_of_Charge_Histogram_13 "Battery system state of charge histogram (seconds) of the battery pack.";
CM_ SG_ 2566852820 State_of_Charge_Histogram_14 "Battery system state of charge histogram (seconds) of the battery pack.";
CM_ SG_ 2566852820 State_of_Charge_Histogram_15 "Battery system state of charge histogram (seconds) of the battery pack.";
CM_ SG_ 2566852820 State_of_Charge_Histogram_16 "Battery system state of charge histogram (seconds) of the battery pack.";
CM_ SG_ 2566852820 State_of_Charge_Histogram_17 "Battery system state of charge histogram (seconds) of the battery pack.";
CM_ SG_ 2566852820 State_of_Charge_Histogram_18 "Battery system state of charge histogram (seconds) of the battery pack.";
CM_ SG_ 2566852820 State_of_Charge_Histogram_19 "Battery system state of charge histogram (seconds) of the battery pack.";
CM_ SG_ 2566852821 Remaining_Capacity "Pack charge capacity";
CM_ SG_ 2566852821 Date_of_Manufacture_0 "Date of manufacture encoded as YYYY-MM";
CM_ SG_ 2566852821 Date_of_Manufacture_1 "Date of manufacture encoded as YYYY-MM";
CM_ SG_ 2566852821 Date_of_Manufacture_2 "Date of manufacture encoded as YYYY-MM";
CM_ SG_ 2566852821 Date_of_Manufacture_3 "Date of manufacture encoded as YYYY-MM";
CM_ SG_ 2566852821 Date_of_Manufacture_4 "Date of manufacture encoded as YYYY-MM";
CM_ SG_ 2566852821 Date_of_Manufacture_5 "Date of manufacture encoded as YYYY-MM";
CM_ SG_ 2566852821 Date_of_Manufacture_6 "Date of manufacture encoded as YYYY-MM";
CM_ SG_ 2566852821 Date_of_Putting_Into_Service_0 "Date of putting into service encoded as YYYY-MM";
CM_ SG_ 2566852821 Date_of_Putting_Into_Service_1 "Date of putting into service encoded as YYYY-MM";
CM_ SG_ 2566852821 Date_of_Putting_Into_Service_2 "Date of putting into service encoded as YYYY-MM";
CM_ SG_ 2566852821 Date_of_Putting_Into_Service_3 "Date of putting into service encoded as YYYY-MM";
CM_ SG_ 2566852821 Date_of_Putting_Into_Service_4 "Date of putting into service encoded as YYYY-MM";
CM_ SG_ 2566852821 Date_of_Putting_Into_Service_5 "Date of putting into service encoded as YYYY-MM";
CM_ SG_ 2566852821 Date_of_Putting_Into_Service_6 "Date of putting into service encoded as YYYY-MM";
CM_ SG_ 2566852821 Charge_Energy_Throughput "Battery system charge energy throughput";
CM_ SG_ 2566852821 Discharge_Energy_Throughput "Battery system discharge energy throughput";
CM_ SG_ 2566852821 Total_Energy_Throughput "Battery system total energy throughput";
CM_ SG_ 2566852821 Charged_Capacity_Throughput "Battery system charged capacity throughput";
CM_ SG_ 2566852821 Discharged_Capacity_Throughput "Battery system discharged capacity throughput";
CM_ SG_ 2566852821 Total_Capacity_Throughput "Battery system total capacity throughput";
CM_ SG_ 2566852821 Number_of_Full_Equivalent_Charge0 "Number of full equivalent charge cycles";
CM_ SG_ 2566852821 Number_of_Full_Equivalent_Discha "Number of full equivalent discharge cycles";
CM_ SG_ 2566852821 Number_of_Full_Equivalent_Charge1 "Number of full equivalent charge-discharge cycles";
CM_ SG_ 2566852821 Temperature_Histogram_0 "Battery system temperature histogram (seconds) of the battery pack.";
CM_ SG_ 2566852821 Temperature_Histogram_1 "Battery system temperature histogram (seconds) of the battery pack.";
CM_ SG_ 2566852821 Temperature_Histogram_2 "Battery system temperature histogram (seconds) of the battery pack.";
CM_ SG_ 2566852821 Temperature_Histogram_3 "Battery system temperature histogram (seconds) of the battery pack.";
CM_ SG_ 2566852821 Temperature_Histogram_4 "Battery system temperature histogram (seconds) of the battery pack.";
CM_ SG_ 2566852821 Temperature_Histogram_5 "Battery system temperature histogram (seconds) of the battery pack.";
CM_ SG_ 2566852821 Temperature_Histogram_6 "Battery system temperature histogram (seconds) of the battery pack.";
CM_ SG_ 2566852821 Temperature_Histogram_7 "Battery system temperature histogram (seconds) of the battery pack.";
CM_ SG_ 2566852821 Temperature_Histogram_8 "Battery system temperature histogram (seconds) of the battery pack.";
CM_ SG_ 2566852821 Temperature_Histogram_9 "Battery system temperature histogram (seconds) of the battery pack.";
CM_ SG_ 2566852821 Temperature_Histogram_10 "Battery system temperature histogram (seconds) of the battery pack.";
CM_ SG_ 2566852821 Temperature_Histogram_11 "Battery system temperature histogram (seconds) of the battery pack.";
CM_ SG_ 2566852821 Temperature_Histogram_12 "Battery system temperature histogram (seconds) of the battery pack.";
CM_ SG_ 2566852821 Temperature_Histogram_13 "Battery system temperature histogram (seconds) of the battery pack.";
CM_ SG_ 2566852821 Temperature_Histogram_14 "Battery system temperature histogram (seconds) of the battery pack.";
CM_ SG_ 2566852821 Temperature_Histogram_15 "Battery system temperature histogram (seconds) of the battery pack.";
CM_ SG_ 2566852821 Temperature_Histogram_16 "Battery system temperature histogram (seconds) of the battery pack.";
CM_ SG_ 2566852821 Temperature_Histogram_17 "Battery system temperature histogram (seconds) of the battery pack.";
CM_ SG_ 2566852821 Temperature_Histogram_18 "Battery system temperature histogram (seconds) of the battery pack.";
CM_ SG_ 2566852821 Temperature_Histogram_19 "Battery system temperature histogram (seconds) of the battery pack.";
CM_ SG_ 2566852821 Temperature_Histogram_20 "Battery system temperature histogram (seconds) of the battery pack.";
CM_ SG_ 2566852821 Temperature_Histogram_21 "Battery system temperature histogram (seconds) of the battery pack.";
CM_ SG_ 2566852821 Temperature_Histogram_22 "Battery system temperature histogram (seconds) of the battery pack.";
CM_ SG_ 2566852821 Temperature_Histogram_23 "Battery system temperature histogram (seconds) of the battery pack.";
CM_ SG_ 2566852821 Time_Spent_in_Extreme_Temperatur0 "Time spent in extreme temperatures above boundary (seconds) of the battery pack.";
CM_ SG_ 2566852821 Time_Spent_in_Extreme_Temperatur1 "Time spent in extreme temperatures below boundary (seconds) of the battery pack.";
CM_ SG_ 2566852821 Number_of_Deep_Discharge_Events "Number of deep discharge events of the battery pack.";
CM_ SG_ 2566852821 Time_Spent_Charging_In_Extreme_T "Time spent charging in extreme temperatures (seconds) of the battery pack.";
CM_ SG_ 2566852821 State_of_Charge "Battery system state of charge";
CM_ SG_ 2566852821 State_of_Charge_Histogram_0 "Battery system state of charge histogram (seconds) of the battery pack.";
CM_ SG_ 2566852821 State_of_Charge_Histogram_1 "Battery system state of charge histogram (seconds) of the battery pack.";
CM_ SG_ 2566852821 State_of_Charge_Histogram_2 "Battery system state of charge histogram (seconds) of the battery pack.";
CM_ SG_ 2566852821 State_of_Charge_Histogram_3 "Battery system state of charge histogram (seconds) of the battery pack.";
CM_ SG_ 2566852821 State_of_Charge_Histogram_4 "Battery system state of charge histogram (seconds) of the battery pack.";
CM_ SG_ 2566852821 State_of_Charge_Histogram_5 "Battery system state of charge histogram (seconds) of the battery pack.";
CM_ SG_ 2566852821 State_of_Charge_Histogram_6 "Battery system state of charge histogram (seconds) of the battery pack.";
CM_ SG_ 2566852821 State_of_Charge_Histogram_7 "Battery system state of charge histogram (seconds) of the battery pack.";
CM_ SG_ 2566852821 State_of_Charge_Histogram_8 "Battery system state of charge histogram (seconds) of the battery pack.";
CM_ SG_ 2566852821 State_of_Charge_Histogram_9 "Battery system state of charge histogram (seconds) of the battery pack.";
CM_ SG_ 2566852821 State_of_Charge_Histogram_10 "Battery system state of charge histogram (seconds) of the battery pack.";
CM_ SG_ 2566852821 State_of_Charge_Histogram_11 "Battery system state of charge histogram (seconds) of the battery pack.";
CM_ SG_ 2566852821 State_of_Charge_Histogram_12 "Battery system state of charge histogram (seconds) of the battery pack.";
CM_ SG_ 2566852821 State_of_Charge_Histogram_13 "Battery system state of charge histogram (seconds) of the battery pack.";
CM_ SG_ 2566852821 State_of_Charge_Histogram_14 "Battery system state of charge histogram (seconds) of the battery pack.";
CM_ SG_ 2566852821 State_of_Charge_Histogram_15 "Battery system state of charge histogram (seconds) of the battery pack.";
CM_ SG_ 2566852821 State_of_Charge_Histogram_16 "Battery system state of charge histogram (seconds) of the battery pack.";
CM_ SG_ 2566852821 State_of_Charge_Histogram_17 "Battery system state of charge histogram (seconds) of the battery pack.";
CM_ SG_ 2566852821 State_of_Charge_Histogram_18 "Battery system state of charge histogram (seconds) of the battery pack.";
CM_ SG_ 2566852821 State_of_Charge_Histogram_19 "Battery system state of charge histogram (seconds) of the battery pack.";
CM_ SG_ 2566852822 Remaining_Capacity "Pack charge capacity";
CM_ SG_ 2566852822 Date_of_Manufacture_0 "Date of manufacture encoded as YYYY-MM";
CM_ SG_ 2566852822 Date_of_Manufacture_1 "Date of manufacture encoded as YYYY-MM";
CM_ SG_ 2566852822 Date_of_Manufacture_2 "Date of manufacture encoded as YYYY-MM";
CM_ SG_ 2566852822 Date_of_Manufacture_3 "Date of manufacture encoded as YYYY-MM";
CM_ SG_ 2566852822 Date_of_Manufacture_4 "Date of manufacture encoded as YYYY-MM";
CM_ SG_ 2566852822 Date_of_Manufacture_5 "Date of manufacture encoded as YYYY-MM";
CM_ SG_ 2566852822 Date_of_Manufacture_6 "Date of manufacture encoded as YYYY-MM";
CM_ SG_ 2566852822 Date_of_Putting_Into_Service_0 "Date of putting into service encoded as YYYY-MM";
CM_ SG_ 2566852822 Date_of_Putting_Into_Service_1 "Date of putting into service encoded as YYYY-MM";
CM_ SG_ 2566852822 Date_of_Putting_Into_Service_2 "Date of putting into service encoded as YYYY-MM";
CM_ SG_ 2566852822 Date_of_Putting_Into_Service_3 "Date of putting into service encoded as YYYY-MM";
CM_ SG_ 2566852822 Date_of_Putting_Into_Service_4 "Date of putting into service encoded as YYYY-MM";
CM_ SG_ 2566852822 Date_of_Putting_Into_Service_5 "Date of putting into service encoded as YYYY-MM";
CM_ SG_ 2566852822 Date_of_Putting_Into_Service_6 "Date of putting into service encoded as YYYY-MM";
CM_ SG_ 2566852822 Charge_Energy_Throughput "Battery system charge energy throughput";
CM_ SG_ 2566852822 Discharge_Energy_Throughput "Battery system discharge energy throughput";
CM_ SG_ 2566852822 Total_Energy_Throughput "Battery system total energy throughput";
CM_ SG_ 2566852822 Charged_Capacity_Throughput "Battery system charged capacity throughput";
CM_ SG_ 2566852822 Discharged_Capacity_Throughput "Battery system discharged capacity throughput";
CM_ SG_ 2566852822 Total_Capacity_Throughput "Battery system total capacity throughput";
CM_ SG_ 2566852822 Number_of_Full_Equivalent_Charge0 "Number of full equivalent charge cycles";
CM_ SG_ 2566852822 Number_of_Full_Equivalent_Discha "Number of full equivalent discharge cycles";
CM_ SG_ 2566852822 Number_of_Full_Equivalent_Charge1 "Number of full equivalent charge-discharge cycles";
CM_ SG_ 2566852822 Temperature_Histogram_0 "Battery system temperature histogram (seconds) of the battery pack.";
CM_ SG_ 2566852822 Temperature_Histogram_1 "Battery system temperature histogram (seconds) of the battery pack.";
CM_ SG_ 2566852822 Temperature_Histogram_2 "Battery system temperature histogram (seconds) of the battery pack.";
CM_ SG_ 2566852822 Temperature_Histogram_3 "Battery system temperature histogram (seconds) of the battery pack.";
CM_ SG_ 2566852822 Temperature_Histogram_4 "Battery system temperature histogram (seconds) of the battery pack.";
CM_ SG_ 2566852822 Temperature_Histogram_5 "Battery system temperature histogram (seconds) of the battery pack.";
CM_ SG_ 2566852822 Temperature_Histogram_6 "Battery system temperature histogram (seconds) of the battery pack.";
CM_ SG_ 2566852822 Temperature_Histogram_7 "Battery system temperature histogram (seconds) of the battery pack.";
CM_ SG_ 2566852822 Temperature_Histogram_8 "Battery system temperature histogram (seconds) of the battery pack.";
CM_ SG_ 2566852822 Temperature_Histogram_9 "Battery system temperature histogram (seconds) of the battery pack.";
CM_ SG_ 2566852822 Temperature_Histogram_10 "Battery system temperature histogram (seconds) of the battery pack.";
CM_ SG_ 2566852822 Temperature_Histogram_11 "Battery system temperature histogram (seconds) of the battery pack.";
CM_ SG_ 2566852822 Temperature_Histogram_12 "Battery system temperature histogram (seconds) of the battery pack.";
CM_ SG_ 2566852822 Temperature_Histogram_13 "Battery system temperature histogram (seconds) of the battery pack.";
CM_ SG_ 2566852822 Temperature_Histogram_14 "Battery system temperature histogram (seconds) of the battery pack.";
CM_ SG_ 2566852822 Temperature_Histogram_15 "Battery system temperature histogram (seconds) of the battery pack.";
CM_ SG_ 2566852822 Temperature_Histogram_16 "Battery system temperature histogram (seconds) of the battery pack.";
CM_ SG_ 2566852822 Temperature_Histogram_17 "Battery system temperature histogram (seconds) of the battery pack.";
CM_ SG_ 2566852822 Temperature_Histogram_18 "Battery system temperature histogram (seconds) of the battery pack.";
CM_ SG_ 2566852822 Temperature_Histogram_19 "Battery system temperature histogram (seconds) of the battery pack.";
CM_ SG_ 2566852822 Temperature_Histogram_20 "Battery system temperature histogram (seconds) of the battery pack.";
CM_ SG_ 2566852822 Temperature_Histogram_21 "Battery system temperature histogram (seconds) of the battery pack.";
CM_ SG_ 2566852822 Temperature_Histogram_22 "Battery system temperature histogram (seconds) of the battery pack.";
CM_ SG_ 2566852822 Temperature_Histogram_23 "Battery system temperature histogram (seconds) of the battery pack.";
CM_ SG_ 2566852822 Time_Spent_in_Extreme_Temperatur0 "Time spent in extreme temperatures above boundary (seconds) of the battery pack.";
CM_ SG_ 2566852822 Time_Spent_in_Extreme_Temperatur1 "Time spent in extreme temperatures below boundary (seconds) of the battery pack.";
CM_ SG_ 2566852822 Number_of_Deep_Discharge_Events "Number of deep discharge events of the battery pack.";
CM_ SG_ 2566852822 Time_Spent_Charging_In_Extreme_T "Time spent charging in extreme temperatures (seconds) of the battery pack.";
CM_ SG_ 2566852822 State_of_Charge "Battery system state of charge";
CM_ SG_ 2566852822 State_of_Charge_Histogram_0 "Battery system state of charge histogram (seconds) of the battery pack.";
CM_ SG_ 2566852822 State_of_Charge_Histogram_1 "Battery system state of charge histogram (seconds) of the battery pack.";
CM_ SG_ 2566852822 State_of_Charge_Histogram_2 "Battery system state of charge histogram (seconds) of the battery pack.";
CM_ SG_ 2566852822 State_of_Charge_Histogram_3 "Battery system state of charge histogram (seconds) of the battery pack.";
CM_ SG_ 2566852822 State_of_Charge_Histogram_4 "Battery system state of charge histogram (seconds) of the battery pack.";
CM_ SG_ 2566852822 State_of_Charge_Histogram_5 "Battery system state of charge histogram (seconds) of the battery pack.";
CM_ SG_ 2566852822 State_of_Charge_Histogram_6 "Battery system state of charge histogram (seconds) of the battery pack.";
CM_ SG_ 2566852822 State_of_Charge_Histogram_7 "Battery system state of charge histogram (seconds) of the battery pack.";
CM_ SG_ 2566852822 State_of_Charge_Histogram_8 "Battery system state of charge histogram (seconds) of the battery pack.";
CM_ SG_ 2566852822 State_of_Charge_Histogram_9 "Battery system state of charge histogram (seconds) of the battery pack.";
CM_ SG_ 2566852822 State_of_Charge_Histogram_10 "Battery system state of charge histogram (seconds) of the battery pack.";
CM_ SG_ 2566852822 State_of_Charge_Histogram_11 "Battery system state of charge histogram (seconds) of the battery pack.";
CM_ SG_ 2566852822 State_of_Charge_Histogram_12 "Battery system state of charge histogram (seconds) of the battery pack.";
CM_ SG_ 2566852822 State_of_Charge_Histogram_13 "Battery system state of charge histogram (seconds) of the battery pack.";
CM_ SG_ 2566852822 State_of_Charge_Histogram_14 "Battery system state of charge histogram (seconds) of the battery pack.";
CM_ SG_ 2566852822 State_of_Charge_Histogram_15 "Battery system state of charge histogram (seconds) of the battery pack.";
CM_ SG_ 2566852822 State_of_Charge_Histogram_16 "Battery system state of charge histogram (seconds) of the battery pack.";
CM_ SG_ 2566852822 State_of_Charge_Histogram_17 "Battery system state of charge histogram (seconds) of the battery pack.";
CM_ SG_ 2566852822 State_of_Charge_Histogram_18 "Battery system state of charge histogram (seconds) of the battery pack.";
CM_ SG_ 2566852822 State_of_Charge_Histogram_19 "Battery system state of charge histogram (seconds) of the battery pack.";
CM_ SG_ 2566852823 Remaining_Capacity "Pack charge capacity";
CM_ SG_ 2566852823 Date_of_Manufacture_0 "Date of manufacture encoded as YYYY-MM";
CM_ SG_ 2566852823 Date_of_Manufacture_1 "Date of manufacture encoded as YYYY-MM";
CM_ SG_ 2566852823 Date_of_Manufacture_2 "Date of manufacture encoded as YYYY-MM";
CM_ SG_ 2566852823 Date_of_Manufacture_3 "Date of manufacture encoded as YYYY-MM";
CM_ SG_ 2566852823 Date_of_Manufacture_4 "Date of manufacture encoded as YYYY-MM";
CM_ SG_ 2566852823 Date_of_Manufacture_5 "Date of manufacture encoded as YYYY-MM";
CM_ SG_ 2566852823 Date_of_Manufacture_6 "Date of manufacture encoded as YYYY-MM";
CM_ SG_ 2566852823 Date_of_Putting_Into_Service_0 "Date of putting into service encoded as YYYY-MM";
CM_ SG_ 2566852823 Date_of_Putting_Into_Service_1 "Date of putting into service encoded as YYYY-MM";
CM_ SG_ 2566852823 Date_of_Putting_Into_Service_2 "Date of putting into service encoded as YYYY-MM";
CM_ SG_ 2566852823 Date_of_Putting_Into_Service_3 "Date of putting into service encoded as YYYY-MM";
CM_ SG_ 2566852823 Date_of_Putting_Into_Service_4 "Date of putting into service encoded as YYYY-MM";
CM_ SG_ 2566852823 Date_of_Putting_Into_Service_5 "Date of putting into service encoded as YYYY-MM";
CM_ SG_ 2566852823 Date_of_Putting_Into_Service_6 "Date of putting into service encoded as YYYY-MM";
CM_ SG_ 2566852823 Charge_Energy_Throughput "Battery system charge energy throughput";
CM_ SG_ 2566852823 Discharge_Energy_Throughput "Battery system discharge energy throughput";
CM_ SG_ 2566852823 Total_Energy_Throughput "Battery system total energy throughput";
CM_ SG_ 2566852823 Charged_Capacity_Throughput "Battery system charged capacity throughput";
CM_ SG_ 2566852823 Discharged_Capacity_Throughput "Battery system discharged capacity throughput";
CM_ SG_ 2566852823 Total_Capacity_Throughput "Battery system total capacity throughput";
CM_ SG_ 2566852823 Number_of_Full_Equivalent_Charge0 "Number of full equivalent charge cycles";
CM_ SG_ 2566852823 Number_of_Full_Equivalent_Discha "Number of full equivalent discharge cycles";
CM_ SG_ 2566852823 Number_of_Full_Equivalent_Charge1 "Number of full equivalent charge-discharge cycles";
CM_ SG_ 2566852823 Temperature_Histogram_0 "Battery system temperature histogram (seconds) of the battery pack.";
CM_ SG_ 2566852823 Temperature_Histogram_1 "Battery system temperature histogram (seconds) of the battery pack.";
CM_ SG_ 2566852823 Temperature_Histogram_2 "Battery system temperature histogram (seconds) of the battery pack.";
CM_ SG_ 2566852823 Temperature_Histogram_3 "Battery system temperature histogram (seconds) of the battery pack.";
CM_ SG_ 2566852823 Temperature_Histogram_4 "Battery system temperature histogram (seconds) of the battery pack.";
CM_ SG_ 2566852823 Temperature_Histogram_5 "Battery system temperature histogram (seconds) of the battery pack.";
CM_ SG_ 2566852823 Temperature_Histogram_6 "Battery system temperature histogram (seconds) of the battery pack.";
CM_ SG_ 2566852823 Temperature_Histogram_7 "Battery system temperature histogram (seconds) of the battery pack.";
CM_ SG_ 2566852823 Temperature_Histogram_8 "Battery system temperature histogram (seconds) of the battery pack.";
CM_ SG_ 2566852823 Temperature_Histogram_9 "Battery system temperature histogram (seconds) of the battery pack.";
CM_ SG_ 2566852823 Temperature_Histogram_10 "Battery system temperature histogram (seconds) of the battery pack.";
CM_ SG_ 2566852823 Temperature_Histogram_11 "Battery system temperature histogram (seconds) of the battery pack.";
CM_ SG_ 2566852823 Temperature_Histogram_12 "Battery system temperature histogram (seconds) of the battery pack.";
CM_ SG_ 2566852823 Temperature_Histogram_13 "Battery system temperature histogram (seconds) of the battery pack.";
CM_ SG_ 2566852823 Temperature_Histogram_14 "Battery system temperature histogram (seconds) of the battery pack.";
CM_ SG_ 2566852823 Temperature_Histogram_15 "Battery system temperature histogram (seconds) of the battery pack.";
CM_ SG_ 2566852823 Temperature_Histogram_16 "Battery system temperature histogram (seconds) of the battery pack.";
CM_ SG_ 2566852823 Temperature_Histogram_17 "Battery system temperature histogram (seconds) of the battery pack.";
CM_ SG_ 2566852823 Temperature_Histogram_18 "Battery system temperature histogram (seconds) of the battery pack.";
CM_ SG_ 2566852823 Temperature_Histogram_19 "Battery system temperature histogram (seconds) of the battery pack.";
CM_ SG_ 2566852823 Temperature_Histogram_20 "Battery system temperature histogram (seconds) of the battery pack.";
CM_ SG_ 2566852823 Temperature_Histogram_21 "Battery system temperature histogram (seconds) of the battery pack.";
CM_ SG_ 2566852823 Temperature_Histogram_22 "Battery system temperature histogram (seconds) of the battery pack.";
CM_ SG_ 2566852823 Temperature_Histogram_23 "Battery system temperature histogram (seconds) of the battery pack.";
CM_ SG_ 2566852823 Time_Spent_in_Extreme_Temperatur0 "Time spent in extreme temperatures above boundary (seconds) of the battery pack.";
CM_ SG_ 2566852823 Time_Spent_in_Extreme_Temperatur1 "Time spent in extreme temperatures below boundary (seconds) of the battery pack.";
CM_ SG_ 2566852823 Number_of_Deep_Discharge_Events "Number of deep discharge events of the battery pack.";
CM_ SG_ 2566852823 Time_Spent_Charging_In_Extreme_T "Time spent charging in extreme temperatures (seconds) of the battery pack.";
CM_ SG_ 2566852823 State_of_Charge "Battery system state of charge";
CM_ SG_ 2566852823 State_of_Charge_Histogram_0 "Battery system state of charge histogram (seconds) of the battery pack.";
CM_ SG_ 2566852823 State_of_Charge_Histogram_1 "Battery system state of charge histogram (seconds) of the battery pack.";
CM_ SG_ 2566852823 State_of_Charge_Histogram_2 "Battery system state of charge histogram (seconds) of the battery pack.";
CM_ SG_ 2566852823 State_of_Charge_Histogram_3 "Battery system state of charge histogram (seconds) of the battery pack.";
CM_ SG_ 2566852823 State_of_Charge_Histogram_4 "Battery system state of charge histogram (seconds) of the battery pack.";
CM_ SG_ 2566852823 State_of_Charge_Histogram_5 "Battery system state of charge histogram (seconds) of the battery pack.";
CM_ SG_ 2566852823 State_of_Charge_Histogram_6 "Battery system state of charge histogram (seconds) of the battery pack.";
CM_ SG_ 2566852823 State_of_Charge_Histogram_7 "Battery system state of charge histogram (seconds) of the battery pack.";
CM_ SG_ 2566852823 State_of_Charge_Histogram_8 "Battery system state of charge histogram (seconds) of the battery pack.";
CM_ SG_ 2566852823 State_of_Charge_Histogram_9 "Battery system state of charge histogram (seconds) of the battery pack.";
CM_ SG_ 2566852823 State_of_Charge_Histogram_10 "Battery system state of charge histogram (seconds) of the battery pack.";
CM_ SG_ 2566852823 State_of_Charge_Histogram_11 "Battery system state of charge histogram (seconds) of the battery pack.";
CM_ SG_ 2566852823 State_of_Charge_Histogram_12 "Battery system state of charge histogram (seconds) of the battery pack.";
CM_ SG_ 2566852823 State_of_Charge_Histogram_13 "Battery system state of charge histogram (seconds) of the battery pack.";
CM_ SG_ 2566852823 State_of_Charge_Histogram_14 "Battery system state of charge histogram (seconds) of the battery pack.";
CM_ SG_ 2566852823 State_of_Charge_Histogram_15 "Battery system state of charge histogram (seconds) of the battery pack.";
CM_ SG_ 2566852823 State_of_Charge_Histogram_16 "Battery system state of charge histogram (seconds) of the battery pack.";
CM_ SG_ 2566852823 State_of_Charge_Histogram_17 "Battery system state of charge histogram (seconds) of the battery pack.";
CM_ SG_ 2566852823 State_of_Charge_Histogram_18 "Battery system state of charge histogram (seconds) of the battery pack.";
CM_ SG_ 2566852823 State_of_Charge_Histogram_19 "Battery system state of charge histogram (seconds) of the battery pack.";
CM_ SG_ 2566852824 Remaining_Capacity "Pack charge capacity";
CM_ SG_ 2566852824 Date_of_Manufacture_0 "Date of manufacture encoded as YYYY-MM";
CM_ SG_ 2566852824 Date_of_Manufacture_1 "Date of manufacture encoded as YYYY-MM";
CM_ SG_ 2566852824 Date_of_Manufacture_2 "Date of manufacture encoded as YYYY-MM";
CM_ SG_ 2566852824 Date_of_Manufacture_3 "Date of manufacture encoded as YYYY-MM";
CM_ SG_ 2566852824 Date_of_Manufacture_4 "Date of manufacture encoded as YYYY-MM";
CM_ SG_ 2566852824 Date_of_Manufacture_5 "Date of manufacture encoded as YYYY-MM";
CM_ SG_ 2566852824 Date_of_Manufacture_6 "Date of manufacture encoded as YYYY-MM";
CM_ SG_ 2566852824 Date_of_Putting_Into_Service_0 "Date of putting into service encoded as YYYY-MM";
CM_ SG_ 2566852824 Date_of_Putting_Into_Service_1 "Date of putting into service encoded as YYYY-MM";
CM_ SG_ 2566852824 Date_of_Putting_Into_Service_2 "Date of putting into service encoded as YYYY-MM";
CM_ SG_ 2566852824 Date_of_Putting_Into_Service_3 "Date of putting into service encoded as YYYY-MM";
CM_ SG_ 2566852824 Date_of_Putting_Into_Service_4 "Date of putting into service encoded as YYYY-MM";
CM_ SG_ 2566852824 Date_of_Putting_Into_Service_5 "Date of putting into service encoded as YYYY-MM";
CM_ SG_ 2566852824 Date_of_Putting_Into_Service_6 "Date of putting into service encoded as YYYY-MM";
CM_ SG_ 2566852824 Charge_Energy_Throughput "Battery system charge energy throughput";
CM_ SG_ 2566852824 Discharge_Energy_Throughput "Battery system discharge energy throughput";
CM_ SG_ 2566852824 Total_Energy_Throughput "Battery system total energy throughput";
CM_ SG_ 2566852824 Charged_Capacity_Throughput "Battery system charged capacity throughput";
CM_ SG_ 2566852824 Discharged_Capacity_Throughput "Battery system discharged capacity throughput";
CM_ SG_ 2566852824 Total_Capacity_Throughput "Battery system total capacity throughput";
CM_ SG_ 2566852824 Number_of_Full_Equivalent_Charge0 "Number of full equivalent charge cycles";
CM_ SG_ 2566852824 Number_of_Full_Equivalent_Discha "Number of full equivalent discharge cycles";
CM_ SG_ 2566852824 Number_of_Full_Equivalent_Charge1 "Number of full equivalent charge-discharge cycles";
CM_ SG_ 2566852824 Temperature_Histogram_0 "Battery system temperature histogram (seconds) of the battery pack.";
CM_ SG_ 2566852824 Temperature_Histogram_1 "Battery system temperature histogram (seconds) of the battery pack.";
CM_ SG_ 2566852824 Temperature_Histogram_2 "Battery system temperature histogram (seconds) of the battery pack.";
CM_ SG_ 2566852824 Temperature_Histogram_3 "Battery system temperature histogram (seconds) of the battery pack.";
CM_ SG_ 2566852824 Temperature_Histogram_4 "Battery system temperature histogram (seconds) of the battery pack.";
CM_ SG_ 2566852824 Temperature_Histogram_5 "Battery system temperature histogram (seconds) of the battery pack.";
CM_ SG_ 2566852824 Temperature_Histogram_6 "Battery system temperature histogram (seconds) of the battery pack.";
CM_ SG_ 2566852824 Temperature_Histogram_7 "Battery system temperature histogram (seconds) of the battery pack.";
CM_ SG_ 2566852824 Temperature_Histogram_8 "Battery system temperature histogram (seconds) of the battery pack.";
CM_ SG_ 2566852824 Temperature_Histogram_9 "Battery system temperature histogram (seconds) of the battery pack.";
CM_ SG_ 2566852824 Temperature_Histogram_10 "Battery system temperature histogram (seconds) of the battery pack.";
CM_ SG_ 2566852824 Temperature_Histogram_11 "Battery system temperature histogram (seconds) of the battery pack.";
CM_ SG_ 2566852824 Temperature_Histogram_12 "Battery system temperature histogram (seconds) of the battery pack.";
CM_ SG_ 2566852824 Temperature_Histogram_13 "Battery system temperature histogram (seconds) of the battery pack.";
CM_ SG_ 2566852824 Temperature_Histogram_14 "Battery system temperature histogram (seconds) of the battery pack.";
CM_ SG_ 2566852824 Temperature_Histogram_15 "Battery system temperature histogram (seconds) of the battery pack.";
CM_ SG_ 2566852824 Temperature_Histogram_16 "Battery system temperature histogram (seconds) of the battery pack.";
CM_ SG_ 2566852824 Temperature_Histogram_17 "Battery system temperature histogram (seconds) of the battery pack.";
CM_ SG_ 2566852824 Temperature_Histogram_18 "Battery system temperature histogram (seconds) of the battery pack.";
CM_ SG_ 2566852824 Temperature_Histogram_19 "Battery system temperature histogram (seconds) of the battery pack.";
CM_ SG_ 2566852824 Temperature_Histogram_20 "Battery system temperature histogram (seconds) of the battery pack.";
CM_ SG_ 2566852824 Temperature_Histogram_21 "Battery system temperature histogram (seconds) of the battery pack.";
CM_ SG_ 2566852824 Temperature_Histogram_22 "Battery system temperature histogram (seconds) of the battery pack.";
CM_ SG_ 2566852824 Temperature_Histogram_23 "Battery system temperature histogram (seconds) of the battery pack.";
CM_ SG_ 2566852824 Time_Spent_in_Extreme_Temperatur0 "Time spent in extreme temperatures above boundary (seconds) of the battery pack.";
CM_ SG_ 2566852824 Time_Spent_in_Extreme_Temperatur1 "Time spent in extreme temperatures below boundary (seconds) of the battery pack.";
CM_ SG_ 2566852824 Number_of_Deep_Discharge_Events "Number of deep discharge events of the battery pack.";
CM_ SG_ 2566852824 Time_Spent_Charging_In_Extreme_T "Time spent charging in extreme temperatures (seconds) of the battery pack.";
CM_ SG_ 2566852824 State_of_Charge "Battery system state of charge";
CM_ SG_ 2566852824 State_of_Charge_Histogram_0 "Battery system state of charge histogram (seconds) of the battery pack.";
CM_ SG_ 2566852824 State_of_Charge_Histogram_1 "Battery system state of charge histogram (seconds) of the battery pack.";
CM_ SG_ 2566852824 State_of_Charge_Histogram_2 "Battery system state of charge histogram (seconds) of the battery pack.";
CM_ SG_ 2566852824 State_of_Charge_Histogram_3 "Battery system state of charge histogram (seconds) of the battery pack.";
CM_ SG_ 2566852824 State_of_Charge_Histogram_4 "Battery system state of charge histogram (seconds) of the battery pack.";
CM_ SG_ 2566852824 State_of_Charge_Histogram_5 "Battery system state of charge histogram (seconds) of the battery pack.";
CM_ SG_ 2566852824 State_of_Charge_Histogram_6 "Battery system state of charge histogram (seconds) of the battery pack.";
CM_ SG_ 2566852824 State_of_Charge_Histogram_7 "Battery system state of charge histogram (seconds) of the battery pack.";
CM_ SG_ 2566852824 State_of_Charge_Histogram_8 "Battery system state of charge histogram (seconds) of the battery pack.";
CM_ SG_ 2566852824 State_of_Charge_Histogram_9 "Battery system state of charge histogram (seconds) of the battery pack.";
CM_ SG_ 2566852824 State_of_Charge_Histogram_10 "Battery system state of charge histogram (seconds) of the battery pack.";
CM_ SG_ 2566852824 State_of_Charge_Histogram_11 "Battery system state of charge histogram (seconds) of the battery pack.";
CM_ SG_ 2566852824 State_of_Charge_Histogram_12 "Battery system state of charge histogram (seconds) of the battery pack.";
CM_ SG_ 2566852824 State_of_Charge_Histogram_13 "Battery system state of charge histogram (seconds) of the battery pack.";
CM_ SG_ 2566852824 State_of_Charge_Histogram_14 "Battery system state of charge histogram (seconds) of the battery pack.";
CM_ SG_ 2566852824 State_of_Charge_Histogram_15 "Battery system state of charge histogram (seconds) of the battery pack.";
CM_ SG_ 2566852824 State_of_Charge_Histogram_16 "Battery system state of charge histogram (seconds) of the battery pack.";
CM_ SG_ 2566852824 State_of_Charge_Histogram_17 "Battery system state of charge histogram (seconds) of the battery pack.";
CM_ SG_ 2566852824 State_of_Charge_Histogram_18 "Battery system state of charge histogram (seconds) of the battery pack.";
CM_ SG_ 2566852824 State_of_Charge_Histogram_19 "Battery system state of charge histogram (seconds) of the battery pack.";
CM_ SG_ 2565523717 PGN "PGN of the message being requested";
CM_ SG_ 2565523973 PGN "PGN of the message being requested";
CM_ SG_ 2565524229 PGN "PGN of the message being requested";
CM_ SG_ 2565524485 PGN "PGN of the message being requested";
CM_ SG_ 2565524741 PGN "PGN of the message being requested";
CM_ SG_ 2565524997 PGN "PGN of the message being requested";
CM_ SG_ 2565525253 PGN "PGN of the message being requested";
CM_ SG_ 2565525509 PGN "PGN of the message being requested";
CM_ SG_ 2565525765 PGN "PGN of the message being requested";
CM_ SG_ 2565526021 PGN "PGN of the message being requested";
CM_ SG_ 2565526277 PGN "PGN of the message being requested";
CM_ SG_ 2565526533 PGN "PGN of the message being requested";
CM_ SG_ 2565526789 PGN "PGN of the message being requested";
CM_ SG_ 2565527045 PGN "PGN of the message being requested";
CM_ SG_ 2565527301 PGN "PGN of the message being requested";
CM_ SG_ 2565527557 PGN "PGN of the message being requested";
CM_ SG_ 2632777673 Control_Byte "Control byte indicating the type of TP.CM message, e.g. BAM (Broadcast Announce Message)";
CM_ SG_ 2632712137 Sequence_Number "Sequence number of the data packet";
CM_ SG_ 2632777674 Control_Byte "Control byte indicating the type of TP.CM message, e.g. BAM (Broadcast Announce Message)";
CM_ SG_ 2632712138 Sequence_Number "Sequence number of the data packet";
CM_ SG_ 2632777675 Control_Byte "Control byte indicating the type of TP.CM message, e.g. BAM (Broadcast Announce Message)";
CM_ SG_ 2632712139 Sequence_Number "Sequence number of the data packet";
CM_ SG_ 2632777676 Control_Byte "Control byte indicating the type of TP.CM message, e.g. BAM (Broadcast Announce Message)";
CM_ SG_ 2632712140 Sequence_Number "Sequence number of the data packet";
CM_ SG_ 2632777677 Control_Byte "Control byte indicating the type of TP.CM message, e.g. BAM (Broadcast Announce Message)";
CM_ SG_ 2632712141 Sequence_Number "Sequence number of the data packet";
CM_ SG_ 2632777678 Control_Byte "Control byte indicating the type of TP.CM message, e.g. BAM (Broadcast Announce Message)";
CM_ SG_ 2632712142 Sequence_Number "Sequence number of the data packet";
CM_ SG_ 2632777679 Control_Byte "Control byte indicating the type of TP.CM message, e.g. BAM (Broadcast Announce Message)";
CM_ SG_ 2632712143 Sequence_Number "Sequence number of the data packet";
CM_ SG_ 2632777680 Control_Byte "Control byte indicating the type of TP.CM message, e.g. BAM (Broadcast Announce Message)";
CM_ SG_ 2632712144 Sequence_Number "Sequence number of the data packet";
CM_ SG_ 2632777681 Control_Byte "Control byte indicating the type of TP.CM message, e.g. BAM (Broadcast Announce Message)";
CM_ SG_ 2632712145 Sequence_Number "Sequence number of the data packet";
CM_ SG_ 2632777682 Control_Byte "Control byte indicating the type of TP.CM message, e.g. BAM (Broadcast Announce Message)";
CM_ SG_ 2632712146 Sequence_Number "Sequence number of the data packet";
CM_ SG_ 2632777683 Control_Byte "Control byte indicating the type of TP.CM message, e.g. BAM (Broadcast Announce Message)";
CM_ SG_ 2632712147 Sequence_Number "Sequence number of the data packet";
CM_ SG_ 2632777684 Control_Byte "Control byte indicating the type of TP.CM message, e.g. BAM (Broadcast Announce Message)";
CM_ SG_ 2632712148 Sequence_Number "Sequence number of the data packet";
CM_ SG_ 2632777685 Control_Byte "Control byte indicating the type of TP.CM message, e.g. BAM (Broadcast Announce Message)";
CM_ SG_ 2632712149 Sequence_Number "Sequence number of the data packet";
CM_ SG_ 2632777686 Control_Byte "Control byte indicating the type of TP.CM message, e.g. BAM (Broadcast Announce Message)";
CM_ SG_ 2632712150 Sequence_Number "Sequence number of the data packet";
CM_ SG_ 2632777687 Control_Byte "Control byte indicating the type of TP.CM message, e.g. BAM (Broadcast Announce Message)";
CM_ SG_ 2632712151 Sequence_Number "Sequence number of the data packet";
CM_ SG_ 2632777688 Control_Byte "Control byte indicating the type of TP.CM message, e.g. BAM (Broadcast Announce Message)";
CM_ SG_ 2632712152 Sequence_Number "Sequence number of the data packet";

BA_DEF_ BO_ "GenMsgCycleTime" INT 0 65535;
BA_DEF_ BO_ "VFrameFormat" ENUM  "StandardCAN","ExtendedCAN","reserved","J1939PG";
BA_DEF_ SG_ "GenSigStartValue" FLOAT 0 100000000000;
BA_ "VFrameFormat" BO_ 2566852817 3;
BA_ "VFrameFormat" BO_ 2566852818 3;
BA_ "VFrameFormat" BO_ 2566852819 3;
BA_ "VFrameFormat" BO_ 2566852820 3;
BA_ "VFrameFormat" BO_ 2566852821 3;
BA_ "VFrameFormat" BO_ 2566852822 3;
BA_ "VFrameFormat" BO_ 2566852823 3;
BA_ "VFrameFormat" BO_ 2566852824 3;
BA_ "VFrameFormat" BO_ 2566838986 3;
BA_ "VFrameFormat" BO_ 2566838987 3;
BA_ "VFrameFormat" BO_ 2566838988 3;
BA_ "VFrameFormat" BO_ 2566838989 3;
BA_ "VFrameFormat" BO_ 2566838990 3;
BA_ "VFrameFormat" BO_ 2566838991 3;
BA_ "VFrameFormat" BO_ 2566838992 3;
BA_ "VFrameFormat" BO_ 2566838993 3;
BA_ "VFrameFormat" BO_ 2566838994 3;
BA_ "VFrameFormat" BO_ 2566838995 3;
BA_ "VFrameFormat" BO_ 2566838996 3;
BA_ "VFrameFormat" BO_ 2566838997 3;
BA_ "VFrameFormat" BO_ 2566838998 3;
BA_ "VFrameFormat" BO_ 2566838999 3;
BA_ "VFrameFormat" BO_ 2566839000 3;
BA_ "VFrameFormat" BO_ 2566768074 3;
BA_ "VFrameFormat" BO_ 2566768075 3;
BA_ "VFrameFormat" BO_ 2566768076 3;
BA_ "VFrameFormat" BO_ 2566768077 3;
BA_ "VFrameFormat" BO_ 2566768078 3;
BA_ "VFrameFormat" BO_ 2566768079 3;
BA_ "VFrameFormat" BO_ 2566768080 3;
BA_ "VFrameFormat" BO_ 2566768081 3;
BA_ "VFrameFormat" BO_ 2566768082 3;
BA_ "VFrameFormat" BO_ 2566768083 3;
BA_ "VFrameFormat" BO_ 2566768084 3;
BA_ "VFrameFormat" BO_ 2566768085 3;
BA_ "VFrameFormat" BO_ 2566768086 3;
BA_ "VFrameFormat" BO_ 2566768087 3;
BA_ "VFrameFormat" BO_ 2566768088 3;
BA_ "VFrameFormat" BO_ 2566843338 3;
BA_ "VFrameFormat" BO_ 2566843339 3;
BA_ "VFrameFormat" BO_ 2566843340 3;
BA_ "VFrameFormat" BO_ 2566843341 3;
BA_ "VFrameFormat" BO_ 2566843342 3;
BA_ "VFrameFormat" BO_ 2566843343 3;
BA_ "VFrameFormat" BO_ 2566843344 3;
BA_ "VFrameFormat" BO_ 2566843345 3;
BA_ "VFrameFormat" BO_ 2566843346 3;
BA_ "VFrameFormat" BO_ 2566843347 3;
BA_ "VFrameFormat" BO_ 2566843348 3;
BA_ "VFrameFormat" BO_ 2566843349 3;
BA_ "VFrameFormat" BO_ 2566843350 3;
BA_ "VFrameFormat" BO_ 2566843351 3;
BA_ "VFrameFormat" BO_ 2566843352 3;
BA_ "VFrameFormat" BO_ 2565523717 3;
BA_ "VFrameFormat" BO_ 2565523973 3;
BA_ "VFrameFormat" BO_ 2565524229 3;
BA_ "VFrameFormat" BO_ 2565524485 3;
BA_ "VFrameFormat" BO_ 2565524741 3;
BA_ "VFrameFormat" BO_ 2565524997 3;
BA_ "VFrameFormat" BO_ 2565525253 3;
BA_ "VFrameFormat" BO_ 2565525509 3;
BA_ "VFrameFormat" BO_ 2565525765 3;
BA_ "VFrameFormat" BO_ 2565526021 3;
BA_ "VFrameFormat" BO_ 2565526277 3;
BA_ "VFrameFormat" BO_ 2565526533 3;
BA_ "VFrameFormat" BO_ 2565526789 3;
BA_ "VFrameFormat" BO_ 2565527045 3;
BA_ "VFrameFormat" BO_ 2565527301 3;
BA_ "VFrameFormat" BO_ 2565527557 3;
BA_ "VFrameFormat" BO_ 2632777673 3;
BA_ "VFrameFormat" BO_ 2632712137 3;
BA_ "VFrameFormat" BO_ 2632777674 3;
BA_ "VFrameFormat" BO_ 2632712138 3;
BA_ "VFrameFormat" BO_ 2632777675 3;
BA_ "VFrameFormat" BO_ 2632712139 3;
BA_ "VFrameFormat" BO_ 2632777676 3;
BA_ "VFrameFormat" BO_ 2632712140 3;
BA_ "VFrameFormat" BO_ 2632777677 3;
BA_ "VFrameFormat" BO_ 2632712141 3;
BA_ "VFrameFormat" BO_ 2632777678 3;
BA_ "VFrameFormat" BO_ 2632712142 3;
BA_ "VFrameFormat" BO_ 2632777679 3;
BA_ "VFrameFormat" BO_ 2632712143 3;
BA_ "VFrameFormat" BO_ 2632777680 3;
BA_ "VFrameFormat" BO_ 2632712144 3;
BA_ "VFrameFormat" BO_ 2632777681 3;
BA_ "VFrameFormat" BO_ 2632712145 3;
BA_ "VFrameFormat" BO_ 2632777682 3;
BA_ "VFrameFormat" BO_ 2632712146 3;
BA_ "VFrameFormat" BO_ 2632777683 3;
BA_ "VFrameFormat" BO_ 2632712147 3;
BA_ "VFrameFormat" BO_ 2632777684 3;
BA_ "VFrameFormat" BO_ 2632712148 3;
BA_ "VFrameFormat" BO_ 2632777685 3;
BA_ "VFrameFormat" BO_ 2632712149 3;
BA_ "VFrameFormat" BO_ 2632777686 3;
BA_ "VFrameFormat" BO_ 2632712150 3;
BA_ "VFrameFormat" BO_ 2632777687 3;
BA_ "VFrameFormat" BO_ 2632712151 3;
BA_ "VFrameFormat" BO_ 2632777688 3;
BA_ "VFrameFormat" BO_ 2632712152 3;
VAL_ 2565523717 PGN 64965 "ECUID_INTERPACK" 65242 "SOFT_INTERPACK" 65259 "CI_INTERPACK" 65296 "PropB_16_INTERPACK";
VAL_ 2565523973 PGN 64965 "ECUID_INTERPACK" 65242 "SOFT_INTERPACK" 65259 "CI_INTERPACK" 65296 "PropB_16_INTERPACK";
VAL_ 2565524229 PGN 64965 "ECUID_INTERPACK" 65242 "SOFT_INTERPACK" 65259 "CI_INTERPACK" 65296 "PropB_16_INTERPACK";
VAL_ 2565524485 PGN 64965 "ECUID_INTERPACK" 65242 "SOFT_INTERPACK" 65259 "CI_INTERPACK" 65296 "PropB_16_INTERPACK";
VAL_ 2565524741 PGN 64965 "ECUID_INTERPACK" 65242 "SOFT_INTERPACK" 65259 "CI_INTERPACK" 65296 "PropB_16_INTERPACK";
VAL_ 2565524997 PGN 64965 "ECUID_INTERPACK" 65242 "SOFT_INTERPACK" 65259 "CI_INTERPACK" 65296 "PropB_16_INTERPACK";
VAL_ 2565525253 PGN 64965 "ECUID_INTERPACK" 65242 "SOFT_INTERPACK" 65259 "CI_INTERPACK" 65296 "PropB_16_INTERPACK";
VAL_ 2565525509 PGN 64965 "ECUID_INTERPACK" 65242 "SOFT_INTERPACK" 65259 "CI_INTERPACK" 65296 "PropB_16_INTERPACK";
VAL_ 2565525765 PGN 64965 "ECUID_INTERPACK" 65242 "SOFT_INTERPACK" 65259 "CI_INTERPACK" 65296 "PropB_16_INTERPACK";
VAL_ 2565526021 PGN 64965 "ECUID_INTERPACK" 65242 "SOFT_INTERPACK" 65259 "CI_INTERPACK" 65296 "PropB_16_INTERPACK";
VAL_ 2565526277 PGN 64965 "ECUID_INTERPACK" 65242 "SOFT_INTERPACK" 65259 "CI_INTERPACK" 65296 "PropB_16_INTERPACK";
VAL_ 2565526533 PGN 64965 "ECUID_INTERPACK" 65242 "SOFT_INTERPACK" 65259 "CI_INTERPACK" 65296 "PropB_16_INTERPACK";
VAL_ 2565526789 PGN 64965 "ECUID_INTERPACK" 65242 "SOFT_INTERPACK" 65259 "CI_INTERPACK" 65296 "PropB_16_INTERPACK";
VAL_ 2565527045 PGN 64965 "ECUID_INTERPACK" 65242 "SOFT_INTERPACK" 65259 "CI_INTERPACK" 65296 "PropB_16_INTERPACK";
VAL_ 2565527301 PGN 64965 "ECUID_INTERPACK" 65242 "SOFT_INTERPACK" 65259 "CI_INTERPACK" 65296 "PropB_16_INTERPACK";
VAL_ 2565527557 PGN 64965 "ECUID_INTERPACK" 65242 "SOFT_INTERPACK" 65259 "CI_INTERPACK" 65296 "PropB_16_INTERPACK";
VAL_ 2632777673 Control_Byte 16 "RTS" 17 "CTS" 19 "EndOfMsgACK" 32 "BAM" 255 "Abort";
VAL_ 2632777674 Control_Byte 16 "RTS" 17 "CTS" 19 "EndOfMsgACK" 32 "BAM" 255 "Abort";
VAL_ 2632777675 Control_Byte 16 "RTS" 17 "CTS" 19 "EndOfMsgACK" 32 "BAM" 255 "Abort";
VAL_ 2632777676 Control_Byte 16 "RTS" 17 "CTS" 19 "EndOfMsgACK" 32 "BAM" 255 "Abort";
VAL_ 2632777677 Control_Byte 16 "RTS" 17 "CTS" 19 "EndOfMsgACK" 32 "BAM" 255 "Abort";
VAL_ 2632777678 Control_Byte 16 "RTS" 17 "CTS" 19 "EndOfMsgACK" 32 "BAM" 255 "Abort";
VAL_ 2632777679 Control_Byte 16 "RTS" 17 "CTS" 19 "EndOfMsgACK" 32 "BAM" 255 "Abort";
VAL_ 2632777680 Control_Byte 16 "RTS" 17 "CTS" 19 "EndOfMsgACK" 32 "BAM" 255 "Abort";
VAL_ 2632777681 Control_Byte 16 "RTS" 17 "CTS" 19 "EndOfMsgACK" 32 "BAM" 255 "Abort";
VAL_ 2632777682 Control_Byte 16 "RTS" 17 "CTS" 19 "EndOfMsgACK" 32 "BAM" 255 "Abort";
VAL_ 2632777683 Control_Byte 16 "RTS" 17 "CTS" 19 "EndOfMsgACK" 32 "BAM" 255 "Abort";
VAL_ 2632777684 Control_Byte 16 "RTS" 17 "CTS" 19 "EndOfMsgACK" 32 "BAM" 255 "Abort";
VAL_ 2632777685 Control_Byte 16 "RTS" 17 "CTS" 19 "EndOfMsgACK" 32 "BAM" 255 "Abort";
VAL_ 2632777686 Control_Byte 16 "RTS" 17 "CTS" 19 "EndOfMsgACK" 32 "BAM" 255 "Abort";
VAL_ 2632777687 Control_Byte 16 "RTS" 17 "CTS" 19 "EndOfMsgACK" 32 "BAM" 255 "Abort";
VAL_ 2632777688 Control_Byte 16 "RTS" 17 "CTS" 19 "EndOfMsgACK" 32 "BAM" 255 "Abort";
